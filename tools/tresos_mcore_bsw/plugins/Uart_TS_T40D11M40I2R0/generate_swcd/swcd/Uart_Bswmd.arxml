AUTOSAR XML (schema 00046)
package /AUTOSAR_Uart/BswModuleDescriptions
  bsw module description Uart: module-id=255
    provided-entrys:
      Uart_Abort
      Uart_AsyncReceive
      Uart_AsyncSend
      Uart_Deinit
      Uart_GetBaudrate
      Uart_GetStatus
      Uart_GetVersionInfo
      Uart_Init
      Uart_SetBaudrate
      Uart_SetBuffer
      Uart_SyncReceive
      Uart_SyncSend
      LINFLEXD{0..2}_UART_IRQHandler
    bsw internal behavior InternalBehavior_0
      12 x exclusive area:
        UART_EXCLUSIVE_AREA_{00..11}
      12 x bsw called entity:
        Uart_Abort: can-enter-exclusive-area=[UART_EXCLUSIVE_AREA_00, UART_EXCLUSIVE_AREA_01, UART_EXCLUSIVE_AREA_02], implemented-entry=Uart_Abort
        Uart_AsyncReceive: can-enter-exclusive-area=[UART_EXCLUSIVE_AREA_01, UART_EXCLUSIVE_AREA_02, UART_EXCLUSIVE_AREA_07, UART_EXCLUSIVE_AREA_08, UART_EXCLUSIVE_AREA_09, UART_EXCLUSIVE_AREA_10], implemented-entry=Uart_AsyncReceive
        Uart_AsyncSend: can-enter-exclusive-area=[UART_EXCLUSIVE_AREA_00, UART_EXCLUSIVE_AREA_02, UART_EXCLUSIVE_AREA_04, UART_EXCLUSIVE_AREA_05, UART_EXCLUSIVE_AREA_09, UART_EXCLUSIVE_AREA_11], implemented-entry=Uart_AsyncSend
        Uart_Deinit: can-enter-exclusive-area=[UART_EXCLUSIVE_AREA_02, UART_EXCLUSIVE_AREA_09, UART_EXCLUSIVE_AREA_10, UART_EXCLUSIVE_AREA_11], implemented-entry=Uart_Deinit
        Uart_GetBaudrate: implemented-entry=Uart_GetBaudrate
        Uart_GetStatus: can-enter-exclusive-area=[UART_EXCLUSIVE_AREA_09, UART_EXCLUSIVE_AREA_10, UART_EXCLUSIVE_AREA_11], implemented-entry=Uart_GetStatus
        Uart_GetVersionInfo: implemented-entry=Uart_GetVersionInfo
        Uart_Init: can-enter-exclusive-area=[UART_EXCLUSIVE_AREA_00, UART_EXCLUSIVE_AREA_01], implemented-entry=Uart_Init
        Uart_SetBaudrate: can-enter-exclusive-area=[UART_EXCLUSIVE_AREA_09, UART_EXCLUSIVE_AREA_10, UART_EXCLUSIVE_AREA_11], implemented-entry=Uart_SetBaudrate
        Uart_SetBuffer: implemented-entry=Uart_SetBuffer
        Uart_SyncReceive: can-enter-exclusive-area=[UART_EXCLUSIVE_AREA_01, UART_EXCLUSIVE_AREA_02, UART_EXCLUSIVE_AREA_06, UART_EXCLUSIVE_AREA_09, UART_EXCLUSIVE_AREA_10], implemented-entry=Uart_SyncReceive
        Uart_SyncSend: can-enter-exclusive-area=[UART_EXCLUSIVE_AREA_00, UART_EXCLUSIVE_AREA_02, UART_EXCLUSIVE_AREA_03, UART_EXCLUSIVE_AREA_09, UART_EXCLUSIVE_AREA_11], implemented-entry=Uart_SyncSend
      bsw interrupt entity LINFLEXD{0..2}_UART_IRQHandler: implemented-entry=LINFLEXD{0..2}_UART_IRQHandler, interrupt-category=CAT-2, interrupt-source=Hardware
package /AUTOSAR_Uart/BswModuleEntrys
  15 x bsw module entry, all with sw-service-impl-policy=STANDARD:
    Uart_Abort: service-id=0x04, is-reentrant=true, is-synchronous=true, call-type=REGULAR, execution-context=UNSPECIFIED
    Uart_AsyncReceive: service-id=0x08, is-reentrant=false, is-synchronous=false, call-type=REGULAR, execution-context=UNSPECIFIED
    Uart_AsyncSend: service-id=0x09, is-reentrant=true, is-synchronous=false, call-type=REGULAR, execution-context=UNSPECIFIED
    Uart_Deinit: service-id=0x01, is-reentrant=false, is-synchronous=true, call-type=REGULAR, execution-context=UNSPECIFIED
    Uart_GetBaudrate: service-id=0x03, is-reentrant=false, is-synchronous=true, call-type=REGULAR, execution-context=UNSPECIFIED
    Uart_GetStatus: service-id=0x0a, is-reentrant=true, is-synchronous=true, call-type=REGULAR, execution-context=UNSPECIFIED
    Uart_GetVersionInfo: service-id=0x0b, is-reentrant=false, is-synchronous=true, call-type=REGULAR, execution-context=UNSPECIFIED
    Uart_Init: service-id=0x00, is-reentrant=false, is-synchronous=true, call-type=REGULAR, execution-context=UNSPECIFIED
    Uart_SetBaudrate: service-id=0x02, is-reentrant=false, is-synchronous=true, call-type=REGULAR, execution-context=UNSPECIFIED
    Uart_SetBuffer: service-id=0x05, is-reentrant=true, is-synchronous=true, call-type=REGULAR, execution-context=UNSPECIFIED
    Uart_SyncReceive: service-id=0x07, is-reentrant=true, is-synchronous=true, call-type=REGULAR, execution-context=UNSPECIFIED
    Uart_SyncSend: service-id=0x06, is-reentrant=true, is-synchronous=true, call-type=REGULAR, execution-context=UNSPECIFIED
    LINFLEXD{0..2}_UART_IRQHandler: service-id=0, is-reentrant=false, is-synchronous=true, call-type=INTERRUPT, execution-context=INTERRUPT-CAT-2
package /Uart_TS_T40D11M40I2R0/Implementations
  bsw implementation BswImplementation_0: programming-language=C, sw-version=4.0.2, vendor-id=43, ar-release-version=4.4.0, behavior=InternalBehavior_0, vendor-specific-module-def=Uart
    code-descriptors:
      code Files
        artifact-descriptors:
          short-label=config::Uart.xdm, category=SWCFG
          short-label=doc::RTD_UART_IM.pdf, category=SWDOC
          short-label=doc::RTD_UART_UM.pdf, category=SWDOC
          short-label=examples::EBT::S32G2::Uart_Example_S32G274A_M7::generate::epc::BaseNXP.xdm, category=SWCFG
          short-label=examples::EBT::S32G2::Uart_Example_S32G274A_M7::generate::epc::Dem.xdm, category=SWCFG
          short-label=examples::EBT::S32G2::Uart_Example_S32G274A_M7::generate::epc::EcuC.xdm, category=SWCFG
          short-label=examples::EBT::S32G2::Uart_Example_S32G274A_M7::generate::epc::Mcu.xdm, category=SWCFG
          short-label=examples::EBT::S32G2::Uart_Example_S32G274A_M7::generate::epc::Platform.xdm, category=SWCFG
          short-label=examples::EBT::S32G2::Uart_Example_S32G274A_M7::generate::epc::Port.xdm, category=SWCFG
          short-label=examples::EBT::S32G2::Uart_Example_S32G274A_M7::generate::epc::Resource.xdm, category=SWCFG
          short-label=examples::EBT::S32G2::Uart_Example_S32G274A_M7::generate::epc::Uart.xdm, category=SWCFG
          short-label=examples::EBT::S32G2::Uart_Example_S32G274A_M7::include::check_example.h, category=SWHDR
          short-label=examples::EBT::S32G2::Uart_Example_S32G274A_M7::src::main.c, category=SWSRC
          short-label=examples::EBT::S32G2::Uart_Example_S32G274A_M7::TresosProject::Uart_Example_S32G274A_M7::.prefs::preferences.xdm, category=SWCFG
          short-label=examples::EBT::S32G2::Uart_Example_S32G274A_M7::TresosProject::Uart_Example_S32G274A_M7::config::BaseNXP.xdm, category=SWCFG
          short-label=examples::EBT::S32G2::Uart_Example_S32G274A_M7::TresosProject::Uart_Example_S32G274A_M7::config::Dem.xdm, category=SWCFG
          short-label=examples::EBT::S32G2::Uart_Example_S32G274A_M7::TresosProject::Uart_Example_S32G274A_M7::config::EcuC.xdm, category=SWCFG
          short-label=examples::EBT::S32G2::Uart_Example_S32G274A_M7::TresosProject::Uart_Example_S32G274A_M7::config::Mcu.xdm, category=SWCFG
          short-label=examples::EBT::S32G2::Uart_Example_S32G274A_M7::TresosProject::Uart_Example_S32G274A_M7::config::Platform.xdm, category=SWCFG
          short-label=examples::EBT::S32G2::Uart_Example_S32G274A_M7::TresosProject::Uart_Example_S32G274A_M7::config::Port.xdm, category=SWCFG
          short-label=examples::EBT::S32G2::Uart_Example_S32G274A_M7::TresosProject::Uart_Example_S32G274A_M7::config::Resource.xdm, category=SWCFG
          short-label=examples::EBT::S32G2::Uart_Example_S32G274A_M7::TresosProject::Uart_Example_S32G274A_M7::config::Uart.xdm, category=SWCFG
          short-label=examples::EBT::S32G3::Uart_Example_S32G399A_M7::generate::epc::BaseNXP.xdm, category=SWCFG
          short-label=examples::EBT::S32G3::Uart_Example_S32G399A_M7::generate::epc::Dem.xdm, category=SWCFG
          short-label=examples::EBT::S32G3::Uart_Example_S32G399A_M7::generate::epc::EcuC.xdm, category=SWCFG
          short-label=examples::EBT::S32G3::Uart_Example_S32G399A_M7::generate::epc::Mcu.xdm, category=SWCFG
          short-label=examples::EBT::S32G3::Uart_Example_S32G399A_M7::generate::epc::Platform.xdm, category=SWCFG
          short-label=examples::EBT::S32G3::Uart_Example_S32G399A_M7::generate::epc::Port.xdm, category=SWCFG
          short-label=examples::EBT::S32G3::Uart_Example_S32G399A_M7::generate::epc::Resource.xdm, category=SWCFG
          short-label=examples::EBT::S32G3::Uart_Example_S32G399A_M7::generate::epc::Uart.xdm, category=SWCFG
          short-label=examples::EBT::S32G3::Uart_Example_S32G399A_M7::include::check_example.h, category=SWHDR
          short-label=examples::EBT::S32G3::Uart_Example_S32G399A_M7::src::main.c, category=SWSRC
          short-label=examples::EBT::S32G3::Uart_Example_S32G399A_M7::TresosProject::Uart_Example_S32G399A_M7::.prefs::preferences.xdm, category=SWCFG
          short-label=examples::EBT::S32G3::Uart_Example_S32G399A_M7::TresosProject::Uart_Example_S32G399A_M7::config::BaseNXP.xdm, category=SWCFG
          short-label=examples::EBT::S32G3::Uart_Example_S32G399A_M7::TresosProject::Uart_Example_S32G399A_M7::config::Dem.xdm, category=SWCFG
          short-label=examples::EBT::S32G3::Uart_Example_S32G399A_M7::TresosProject::Uart_Example_S32G399A_M7::config::EcuC.xdm, category=SWCFG
          short-label=examples::EBT::S32G3::Uart_Example_S32G399A_M7::TresosProject::Uart_Example_S32G399A_M7::config::Mcu.xdm, category=SWCFG
          short-label=examples::EBT::S32G3::Uart_Example_S32G399A_M7::TresosProject::Uart_Example_S32G399A_M7::config::Platform.xdm, category=SWCFG
          short-label=examples::EBT::S32G3::Uart_Example_S32G399A_M7::TresosProject::Uart_Example_S32G399A_M7::config::Port.xdm, category=SWCFG
          short-label=examples::EBT::S32G3::Uart_Example_S32G399A_M7::TresosProject::Uart_Example_S32G399A_M7::config::Resource.xdm, category=SWCFG
          short-label=examples::EBT::S32G3::Uart_Example_S32G399A_M7::TresosProject::Uart_Example_S32G399A_M7::config::Uart.xdm, category=SWCFG
          short-label=examples::EBT::S32R45::Uart_Example_S32R45_M7::generate::epc::BaseNXP.xdm, category=SWCFG
          short-label=examples::EBT::S32R45::Uart_Example_S32R45_M7::generate::epc::Dem.xdm, category=SWCFG
          short-label=examples::EBT::S32R45::Uart_Example_S32R45_M7::generate::epc::EcuC.xdm, category=SWCFG
          short-label=examples::EBT::S32R45::Uart_Example_S32R45_M7::generate::epc::Mcu.xdm, category=SWCFG
          short-label=examples::EBT::S32R45::Uart_Example_S32R45_M7::generate::epc::Platform.xdm, category=SWCFG
          short-label=examples::EBT::S32R45::Uart_Example_S32R45_M7::generate::epc::Port.xdm, category=SWCFG
          short-label=examples::EBT::S32R45::Uart_Example_S32R45_M7::generate::epc::Resource.xdm, category=SWCFG
          short-label=examples::EBT::S32R45::Uart_Example_S32R45_M7::generate::epc::Uart.xdm, category=SWCFG
          short-label=examples::EBT::S32R45::Uart_Example_S32R45_M7::include::check_example.h, category=SWHDR
          short-label=examples::EBT::S32R45::Uart_Example_S32R45_M7::src::main.c, category=SWSRC
          short-label=examples::EBT::S32R45::Uart_Example_S32R45_M7::TresosProject::Uart_Example_S32R45_M7::.prefs::preferences.xdm, category=SWCFG
          short-label=examples::EBT::S32R45::Uart_Example_S32R45_M7::TresosProject::Uart_Example_S32R45_M7::config::BaseNXP.xdm, category=SWCFG
          short-label=examples::EBT::S32R45::Uart_Example_S32R45_M7::TresosProject::Uart_Example_S32R45_M7::config::Dem.xdm, category=SWCFG
          short-label=examples::EBT::S32R45::Uart_Example_S32R45_M7::TresosProject::Uart_Example_S32R45_M7::config::EcuC.xdm, category=SWCFG
          short-label=examples::EBT::S32R45::Uart_Example_S32R45_M7::TresosProject::Uart_Example_S32R45_M7::config::Mcu.xdm, category=SWCFG
          short-label=examples::EBT::S32R45::Uart_Example_S32R45_M7::TresosProject::Uart_Example_S32R45_M7::config::Platform.xdm, category=SWCFG
          short-label=examples::EBT::S32R45::Uart_Example_S32R45_M7::TresosProject::Uart_Example_S32R45_M7::config::Port.xdm, category=SWCFG
          short-label=examples::EBT::S32R45::Uart_Example_S32R45_M7::TresosProject::Uart_Example_S32R45_M7::config::Resource.xdm, category=SWCFG
          short-label=examples::EBT::S32R45::Uart_Example_S32R45_M7::TresosProject::Uart_Example_S32R45_M7::config::Uart.xdm, category=SWCFG
          short-label=examples::S32DS::S32G2::Linflexd_Uart_Ip_Example_S32G274A_M7::include::check_example.h, category=SWHDR
          short-label=examples::S32DS::S32G2::Linflexd_Uart_Ip_Example_S32G274A_M7::Project_Settings::Startup_Code::exceptions.c, category=SWSRC
          short-label=examples::S32DS::S32G2::Linflexd_Uart_Ip_Example_S32G274A_M7::Project_Settings::Startup_Code::nvic.c, category=SWSRC
          short-label=examples::S32DS::S32G2::Linflexd_Uart_Ip_Example_S32G274A_M7::Project_Settings::Startup_Code::startup.c, category=SWSRC
          short-label=examples::S32DS::S32G2::Linflexd_Uart_Ip_Example_S32G274A_M7::Project_Settings::Startup_Code::system.c, category=SWSRC
          short-label=examples::S32DS::S32G2::Linflexd_Uart_Ip_Example_S32G274A_M7::src::main.c, category=SWSRC
          short-label=examples::S32DS::S32G2::Uart_Example_S32G274A_M7::include::check_example.h, category=SWHDR
          short-label=examples::S32DS::S32G2::Uart_Example_S32G274A_M7::Project_Settings::Startup_Code::exceptions.c, category=SWSRC
          short-label=examples::S32DS::S32G2::Uart_Example_S32G274A_M7::Project_Settings::Startup_Code::nvic.c, category=SWSRC
          short-label=examples::S32DS::S32G2::Uart_Example_S32G274A_M7::Project_Settings::Startup_Code::startup.c, category=SWSRC
          short-label=examples::S32DS::S32G2::Uart_Example_S32G274A_M7::Project_Settings::Startup_Code::system.c, category=SWSRC
          short-label=examples::S32DS::S32G2::Uart_Example_S32G274A_M7::src::main.c, category=SWSRC
          short-label=examples::S32DS::S32G3::Linflexd_Uart_Ip_Example_S32G399A_M7::include::check_example.h, category=SWHDR
          short-label=examples::S32DS::S32G3::Linflexd_Uart_Ip_Example_S32G399A_M7::Project_Settings::Startup_Code::exceptions.c, category=SWSRC
          short-label=examples::S32DS::S32G3::Linflexd_Uart_Ip_Example_S32G399A_M7::Project_Settings::Startup_Code::nvic.c, category=SWSRC
          short-label=examples::S32DS::S32G3::Linflexd_Uart_Ip_Example_S32G399A_M7::Project_Settings::Startup_Code::startup.c, category=SWSRC
          short-label=examples::S32DS::S32G3::Linflexd_Uart_Ip_Example_S32G399A_M7::Project_Settings::Startup_Code::system.c, category=SWSRC
          short-label=examples::S32DS::S32G3::Linflexd_Uart_Ip_Example_S32G399A_M7::src::main.c, category=SWSRC
          short-label=examples::S32DS::S32G3::Uart_Example_S32G399A_M7::include::check_example.h, category=SWHDR
          short-label=examples::S32DS::S32G3::Uart_Example_S32G399A_M7::Project_Settings::Startup_Code::exceptions.c, category=SWSRC
          short-label=examples::S32DS::S32G3::Uart_Example_S32G399A_M7::Project_Settings::Startup_Code::nvic.c, category=SWSRC
          short-label=examples::S32DS::S32G3::Uart_Example_S32G399A_M7::Project_Settings::Startup_Code::startup.c, category=SWSRC
          short-label=examples::S32DS::S32G3::Uart_Example_S32G399A_M7::Project_Settings::Startup_Code::system.c, category=SWSRC
          short-label=examples::S32DS::S32G3::Uart_Example_S32G399A_M7::src::main.c, category=SWSRC
          short-label=examples::S32DS::S32R45::Linflexd_Uart_Ip_Example_S32R45_M7::include::check_example.h, category=SWHDR
          short-label=examples::S32DS::S32R45::Linflexd_Uart_Ip_Example_S32R45_M7::Project_Settings::Startup_Code::exceptions.c, category=SWSRC
          short-label=examples::S32DS::S32R45::Linflexd_Uart_Ip_Example_S32R45_M7::Project_Settings::Startup_Code::nvic.c, category=SWSRC
          short-label=examples::S32DS::S32R45::Linflexd_Uart_Ip_Example_S32R45_M7::Project_Settings::Startup_Code::startup.c, category=SWSRC
          short-label=examples::S32DS::S32R45::Linflexd_Uart_Ip_Example_S32R45_M7::Project_Settings::Startup_Code::system.c, category=SWSRC
          short-label=examples::S32DS::S32R45::Linflexd_Uart_Ip_Example_S32R45_M7::src::main.c, category=SWSRC
          short-label=examples::S32DS::S32R45::Uart_Example_S32R45_M7::include::check_example.h, category=SWHDR
          short-label=examples::S32DS::S32R45::Uart_Example_S32R45_M7::Project_Settings::Startup_Code::exceptions.c, category=SWSRC
          short-label=examples::S32DS::S32R45::Uart_Example_S32R45_M7::Project_Settings::Startup_Code::nvic.c, category=SWSRC
          short-label=examples::S32DS::S32R45::Uart_Example_S32R45_M7::Project_Settings::Startup_Code::startup.c, category=SWSRC
          short-label=examples::S32DS::S32R45::Uart_Example_S32R45_M7::Project_Settings::Startup_Code::system.c, category=SWSRC
          short-label=examples::S32DS::S32R45::Uart_Example_S32R45_M7::src::main.c, category=SWSRC
          short-label=include::Linflexd_Uart_Ip.h, category=SWHDR
          short-label=include::Linflexd_Uart_Ip_HwAccess.h, category=SWHDR
          short-label=include::Linflexd_Uart_Ip_Irq.h, category=SWHDR
          short-label=include::Linflexd_Uart_Ip_TrustedFunctions.h, category=SWHDR
          short-label=include::Linflexd_Uart_Ip_Types.h, category=SWHDR
          short-label=include::Uart.h, category=SWHDR
          short-label=include::Uart_Ipw.h, category=SWHDR
          short-label=include::Uart_Ipw_Types.h, category=SWHDR
          short-label=include::Uart_Types.h, category=SWHDR
          short-label=src::Linflexd_Uart_Ip.c, category=SWSRC
          short-label=src::Linflexd_Uart_Ip_Irq.c, category=SWSRC
          short-label=src::Uart.c, category=SWSRC
          short-label=src::Uart_Ipw.c, category=SWSRC
    compiler DIAB_Compiler:
      name=Windriver Diab
      options=-tARMCORTEXM7MG:simple -mthumb -std=c99 -Oz -g -fstandalone-debug -Wstrict-prototypes -Wsign-compare -Wdouble-promotion -Wunknown-pragmas -Wundef -Wextra -Wall -pedantic -Werror=implicit-function-declaration -fno-common -fno-signed-char -fno-trigraphs -V -c -DS32XX -DS32G2XX -DS32G3XX -DS32R45 -DDIAB -DUSE_SW_VECTOR_MODE -DD_CACHE_ENABLE -DI_CACHE_ENABLE -DENABLE_FPU -DMCAL_ENABLE_USER_MODE_SUPPORT
      vendor=Windriver
      version=DIAB_7_0_3_0-FCS_20200409_160912
    compiler GCC_Compiler:
      name=GCC Compiler
      options=-mcpu=cortex-m7 -mthumb -mlittle-endian -mfpu=fpv5-sp-d16 -mfloat-abi=hard -std=c99 -Os -ggdb3 -Wall -Wextra -pedantic -Wstrict-prototypes -Wundef -Wunused -Werror=implicit-function-declaration -Wsign-compare -Wdouble-promotion -fno-short-enums -funsigned-char -funsigned-bitfields -fomit-frame-pointer -fno-common -fstack-usage -fdump-ipa-all -c -DS32XX -DS32G2XX -DS32G3XX -DS32R45 -DGCC -DUSE_SW_VECTOR_MODE -DD_CACHE_ENABLE -DI_CACHE_ENABLE -DENABLE_FPU -DMCAL_ENABLE_USER_MODE_SUPPORT
      vendor=GCC Systems
      version=NXP GCC 9.2.0 20190812 (Build 1649 Revision gaf57174)
    compiler GHS_Compiler:
      name=Green Hills
      options=-cpu=cortexm7 -thumb -fpu=vfpv5_d16 -fsingle -C99 --ghstd=last -Osize --gnu_asm -dual_debug -G -keeptempfiles -Wimplicit-int -Wshadow -Wtrigraphs -Wundef --unsigned_chars --unsigned_fields --no_commons --no_exceptions --no_slash_comment --prototype_errors --incorrect_pragma_warnings -c -DS32XX -DS32G2XX -DS32G3XX -DS32R45 -DGHS -DUSE_SW_VECTOR_MODE -DD_CACHE_ENABLE -DI_CACHE_ENABLE -DENABLE_FPU -DMCAL_ENABLE_USER_MODE_SUPPORT
      vendor=Green Hills
      version=Green Hills Multi 7.1.6d / Compiler 2020.1.4
    generated-artifacts:
      11 x dependency on artifact:
        Linflexd_Uart_Ip_PBcfg_h: artifact-descriptor={short-label=generate_PB::include::Linflexd_Uart_Ip_PBcfg.h, category=SWHDR}, usages=EXECUTE
        Uart_Ipw_PBcfg_h: artifact-descriptor={short-label=generate_PB::include::Uart_Ipw_PBcfg.h, category=SWHDR}, usages=EXECUTE
        Uart_PBcfg_h: artifact-descriptor={short-label=generate_PB::include::Uart_PBcfg.h, category=SWHDR}, usages=EXECUTE
        Linflexd_Uart_Ip_PBcfg_c: artifact-descriptor={short-label=generate_PB::src::Linflexd_Uart_Ip_PBcfg.c, category=SWSRC}, usages=EXECUTE
        Uart_Ipw_PBcfg_c: artifact-descriptor={short-label=generate_PB::src::Uart_Ipw_PBcfg.c, category=SWSRC}, usages=EXECUTE
        Uart_PBcfg_c: artifact-descriptor={short-label=generate_PB::src::Uart_PBcfg.c, category=SWSRC}, usages=EXECUTE
        Linflexd_Uart_Ip_Cfg_h: artifact-descriptor={short-label=generate_PC::include::Linflexd_Uart_Ip_Cfg.h, category=SWHDR}, usages=COMPILE
        Linflexd_Uart_Ip_Defines_h: artifact-descriptor={short-label=generate_PC::include::Linflexd_Uart_Ip_Defines.h, category=SWHDR}, usages=COMPILE
        Uart_Cfg_h: artifact-descriptor={short-label=generate_PC::include::Uart_Cfg.h, category=SWHDR}, usages=COMPILE
        Uart_Defines_h: artifact-descriptor={short-label=generate_PC::include::Uart_Defines.h, category=SWHDR}, usages=COMPILE
        Uart_Ipw_Cfg_h: artifact-descriptor={short-label=generate_PC::include::Uart_Ipw_Cfg.h, category=SWHDR}, usages=COMPILE
    linker DIAB_Linker: name=Windriver Diab, options=-e Reset_Handler linker_script_file.dld -m30 -Xstack-usage -Xpreprocess-lecl -Llibrary_path -lc -lm, vendor=Windriver, version=DIAB_7_0_3_0-FCS_20200409_160912
    linker GCC_Linker: name=GCC Compiler, options=-Wl,-Map,filename -T linkerfile --entry=Reset_Handler -nostartfiles -mcpu=cortexm7 -mthumb -mfpu=fpv5-sp-d16 -mfloat-abi=hard -mlittle-endian -ggdb3 -lc -lm -lgcc, vendor=GCC Systems, version=NXP GCC 9.2.0 20190812 (Build 1649 Revision gaf57174)
    linker GHS_Linker: name=Green Hills, options=-e Reset_Handler -T linker_script_file.ld -map -keepmap -Mn -delete -ignore_debug_references -Llibrary_path -larch -lstartup -lind_sd -v -nostartfiles, vendor=Green Hills, version=Green Hills Multi 7.1.6d / Compiler 2020.1.4
    resource consumption ResourceConsumption
      8 x memory section:
        UART_CODE: alignment=UNSPECIFIED, sw-addrmethod=CODE, symbol=CODE
        UART_CONFIG_DATA_UNSPECIFIED: alignment=UNSPECIFIED, sw-addrmethod=CONFIG_DATA, symbol=CONFIG_DATA_UNSPECIFIED
        UART_CONST_BOOLEAN: alignment=BOOLEAN, sw-addrmethod=CONST, symbol=CONST_BOOLEAN
        UART_CONST_UNSPECIFIED: alignment=UNSPECIFIED, sw-addrmethod=CONST, symbol=CONST_UNSPECIFIED
        UART_VAR_CLEARED_32: alignment=32, sw-addrmethod=VAR_CLEARED, symbol=VAR_CLEARED_32
        UART_VAR_CLEARED_UNSPECIFIED: alignment=UNSPECIFIED, sw-addrmethod=VAR_CLEARED, symbol=VAR_CLEARED_UNSPECIFIED
        UART_VAR_CLEARED_UNSPECIFIED_NO_CACHEABLE: alignment=UNSPECIFIED, sw-addrmethod=VAR_CLEARED_NO_CACHEABLE, symbol=VAR_CLEARED_UNSPECIFIED_NO_CACHEABLE
        UART_VAR_INIT_8: alignment=8, sw-addrmethod=VAR_INIT, symbol=VAR_INIT_8
