AUTOSAR XML (schema 00046)
package /AUTOSAR_Fls/BswModuleDescriptions
  bsw module description Fls: module-id=92
    provided-entrys:
      Fls_BlankCheck
      Fls_Cancel
      Fls_Compare
      Fls_Erase
      Fls_GetJobResult
      Fls_GetStatus
      Fls_GetVersionInfo
      Fls_Init
      Fls_MainFunction
      Fls_Read
      Fls_SetMode
      Fls_Write
    bsw internal behavior InternalBehavior_0
      5 x exclusive area:
        FLS_EXCLUSIVE_AREA_{10..14}
      8 x bsw called entity:
        Fls_BlankCheck: can-enter-exclusive-area=FLS_EXCLUSIVE_AREA_14, implemented-entry=Fls_BlankCheck
        Fls_Cancel: implemented-entry=Fls_Cancel
        Fls_Compare: can-enter-exclusive-area=FLS_EXCLUSIVE_AREA_13, implemented-entry=Fls_Compare
        Fls_Erase: can-enter-exclusive-area=FLS_EXCLUSIVE_AREA_10, implemented-entry=Fls_Erase
        Fls_GetJobResult: implemented-entry=Fls_GetJobResult
        Fls_GetStatus: implemented-entry=Fls_GetStatus
        Fls_GetVersionInfo: implemented-entry=Fls_GetVersionInfo
        Fls_Init: implemented-entry=Fls_Init
      bsw schedulable entity Fls_MainFunction: implemented-entry=Fls_MainFunction
      bsw called entity Fls_Read: can-enter-exclusive-area=FLS_EXCLUSIVE_AREA_12, implemented-entry=Fls_Read
      bsw called entity Fls_SetMode: implemented-entry=Fls_SetMode
      bsw called entity Fls_Write: can-enter-exclusive-area=FLS_EXCLUSIVE_AREA_11, implemented-entry=Fls_Write
      bsw timing event Fls_TimingEvent_MainFunction: starts-on-event=Fls_MainFunction, period=0.2
package /AUTOSAR_Fls/BswModuleEntrys
  12 x bsw module entry, all with sw-service-impl-policy=STANDARD:
    Fls_BlankCheck: service-id=0x0a, is-reentrant=false, is-synchronous=false, call-type=REGULAR, execution-context=UNSPECIFIED
    Fls_Cancel: service-id=0x03, is-reentrant=false, is-synchronous=true, call-type=REGULAR, execution-context=UNSPECIFIED
    Fls_Compare: service-id=0x08, is-reentrant=false, is-synchronous=false, call-type=REGULAR, execution-context=UNSPECIFIED
    Fls_Erase: service-id=0x01, is-reentrant=false, is-synchronous=false, call-type=REGULAR, execution-context=UNSPECIFIED
    Fls_GetJobResult: service-id=0x05, is-reentrant=true, is-synchronous=true, call-type=REGULAR, execution-context=UNSPECIFIED
    Fls_GetStatus: service-id=0x04, is-reentrant=true, is-synchronous=true, call-type=REGULAR, execution-context=UNSPECIFIED
    Fls_GetVersionInfo: service-id=0x10, is-reentrant=true, is-synchronous=true, call-type=REGULAR, execution-context=UNSPECIFIED
    Fls_Init: service-id=0x00, is-reentrant=false, is-synchronous=true, call-type=REGULAR, execution-context=UNSPECIFIED
    Fls_MainFunction: service-id=0x06, is-reentrant=false, is-synchronous=true, call-type=SCHEDULED, execution-context=TASK
    Fls_Read: service-id=0x07, is-reentrant=false, is-synchronous=false, call-type=REGULAR, execution-context=UNSPECIFIED
    Fls_SetMode: service-id=0x09, is-reentrant=false, is-synchronous=true, call-type=REGULAR, execution-context=UNSPECIFIED
    Fls_Write: service-id=0x02, is-reentrant=false, is-synchronous=false, call-type=REGULAR, execution-context=UNSPECIFIED
package /Fls_TS_T40D11M40I0R0/Implementations
  bsw implementation BswImplementation_0: programming-language=C, sw-version=4.0.0, vendor-id=43, ar-release-version=4.4.0, behavior=InternalBehavior_0, vendor-specific-module-def=Fls
    code-descriptors:
      code Files
        artifact-descriptors:
          short-label=config::Fls.xdm, category=SWCFG
          short-label=doc::RTD_FLS_IM.pdf, category=SWDOC
          short-label=doc::RTD_FLS_UM.pdf, category=SWDOC
          short-label=examples::EBT::S32G2::Fls_Example_S32G274A_M7::generate::epc::Base.xdm, category=SWCFG
          short-label=examples::EBT::S32G2::Fls_Example_S32G274A_M7::generate::epc::EcuC.xdm, category=SWCFG
          short-label=examples::EBT::S32G2::Fls_Example_S32G274A_M7::generate::epc::Fls.xdm, category=SWCFG
          short-label=examples::EBT::S32G2::Fls_Example_S32G274A_M7::generate::epc::Mcu.xdm, category=SWCFG
          short-label=examples::EBT::S32G2::Fls_Example_S32G274A_M7::generate::epc::Port.xdm, category=SWCFG
          short-label=examples::EBT::S32G2::Fls_Example_S32G274A_M7::generate::epc::Resource.xdm, category=SWCFG
          short-label=examples::EBT::S32G2::Fls_Example_S32G274A_M7::generate::epc::Rm.xdm, category=SWCFG
          short-label=examples::EBT::S32G2::Fls_Example_S32G274A_M7::include::check_example.h, category=SWHDR
          short-label=examples::EBT::S32G2::Fls_Example_S32G274A_M7::src::main.c, category=SWSRC
          short-label=examples::EBT::S32G2::Fls_Example_S32G274A_M7::TresosProject::Fls_Example_S32G274A_M7::.prefs::preferences.xdm, category=SWCFG
          short-label=examples::EBT::S32G2::Fls_Example_S32G274A_M7::TresosProject::Fls_Example_S32G274A_M7::config::Base.xdm, category=SWCFG
          short-label=examples::EBT::S32G2::Fls_Example_S32G274A_M7::TresosProject::Fls_Example_S32G274A_M7::config::EcuC.xdm, category=SWCFG
          short-label=examples::EBT::S32G2::Fls_Example_S32G274A_M7::TresosProject::Fls_Example_S32G274A_M7::config::Fls.xdm, category=SWCFG
          short-label=examples::EBT::S32G2::Fls_Example_S32G274A_M7::TresosProject::Fls_Example_S32G274A_M7::config::Mcu.xdm, category=SWCFG
          short-label=examples::EBT::S32G2::Fls_Example_S32G274A_M7::TresosProject::Fls_Example_S32G274A_M7::config::Port.xdm, category=SWCFG
          short-label=examples::EBT::S32G2::Fls_Example_S32G274A_M7::TresosProject::Fls_Example_S32G274A_M7::config::Resource.xdm, category=SWCFG
          short-label=examples::EBT::S32G2::Fls_Example_S32G274A_M7::TresosProject::Fls_Example_S32G274A_M7::config::Rm.xdm, category=SWCFG
          short-label=examples::EBT::S32G3::Fls_Example_S32G399A_M7::generate::epc::Base.xdm, category=SWCFG
          short-label=examples::EBT::S32G3::Fls_Example_S32G399A_M7::generate::epc::EcuC.xdm, category=SWCFG
          short-label=examples::EBT::S32G3::Fls_Example_S32G399A_M7::generate::epc::Fls.xdm, category=SWCFG
          short-label=examples::EBT::S32G3::Fls_Example_S32G399A_M7::generate::epc::Mcu.xdm, category=SWCFG
          short-label=examples::EBT::S32G3::Fls_Example_S32G399A_M7::generate::epc::Port.xdm, category=SWCFG
          short-label=examples::EBT::S32G3::Fls_Example_S32G399A_M7::generate::epc::Resource.xdm, category=SWCFG
          short-label=examples::EBT::S32G3::Fls_Example_S32G399A_M7::generate::epc::Rm.xdm, category=SWCFG
          short-label=examples::EBT::S32G3::Fls_Example_S32G399A_M7::include::check_example.h, category=SWHDR
          short-label=examples::EBT::S32G3::Fls_Example_S32G399A_M7::src::main.c, category=SWSRC
          short-label=examples::EBT::S32G3::Fls_Example_S32G399A_M7::TresosProject::Fls_Example_S32G399A_M7::.prefs::preferences.xdm, category=SWCFG
          short-label=examples::EBT::S32G3::Fls_Example_S32G399A_M7::TresosProject::Fls_Example_S32G399A_M7::config::Base.xdm, category=SWCFG
          short-label=examples::EBT::S32G3::Fls_Example_S32G399A_M7::TresosProject::Fls_Example_S32G399A_M7::config::EcuC.xdm, category=SWCFG
          short-label=examples::EBT::S32G3::Fls_Example_S32G399A_M7::TresosProject::Fls_Example_S32G399A_M7::config::Fls.xdm, category=SWCFG
          short-label=examples::EBT::S32G3::Fls_Example_S32G399A_M7::TresosProject::Fls_Example_S32G399A_M7::config::Mcu.xdm, category=SWCFG
          short-label=examples::EBT::S32G3::Fls_Example_S32G399A_M7::TresosProject::Fls_Example_S32G399A_M7::config::Port.xdm, category=SWCFG
          short-label=examples::EBT::S32G3::Fls_Example_S32G399A_M7::TresosProject::Fls_Example_S32G399A_M7::config::Resource.xdm, category=SWCFG
          short-label=examples::EBT::S32G3::Fls_Example_S32G399A_M7::TresosProject::Fls_Example_S32G399A_M7::config::Rm.xdm, category=SWCFG
          short-label=examples::EBT::S32R45::Fls_Example_S32R45_M7::generate::epc::Base.xdm, category=SWCFG
          short-label=examples::EBT::S32R45::Fls_Example_S32R45_M7::generate::epc::EcuC.xdm, category=SWCFG
          short-label=examples::EBT::S32R45::Fls_Example_S32R45_M7::generate::epc::Fls.xdm, category=SWCFG
          short-label=examples::EBT::S32R45::Fls_Example_S32R45_M7::generate::epc::Mcu.xdm, category=SWCFG
          short-label=examples::EBT::S32R45::Fls_Example_S32R45_M7::generate::epc::Port.xdm, category=SWCFG
          short-label=examples::EBT::S32R45::Fls_Example_S32R45_M7::generate::epc::Resource.xdm, category=SWCFG
          short-label=examples::EBT::S32R45::Fls_Example_S32R45_M7::generate::epc::Rm.xdm, category=SWCFG
          short-label=examples::EBT::S32R45::Fls_Example_S32R45_M7::include::check_example.h, category=SWHDR
          short-label=examples::EBT::S32R45::Fls_Example_S32R45_M7::src::main.c, category=SWSRC
          short-label=examples::EBT::S32R45::Fls_Example_S32R45_M7::TresosProject::Fls_Example_S32R45_M7::.prefs::preferences.xdm, category=SWCFG
          short-label=examples::EBT::S32R45::Fls_Example_S32R45_M7::TresosProject::Fls_Example_S32R45_M7::config::Base.xdm, category=SWCFG
          short-label=examples::EBT::S32R45::Fls_Example_S32R45_M7::TresosProject::Fls_Example_S32R45_M7::config::EcuC.xdm, category=SWCFG
          short-label=examples::EBT::S32R45::Fls_Example_S32R45_M7::TresosProject::Fls_Example_S32R45_M7::config::Fls.xdm, category=SWCFG
          short-label=examples::EBT::S32R45::Fls_Example_S32R45_M7::TresosProject::Fls_Example_S32R45_M7::config::Mcu.xdm, category=SWCFG
          short-label=examples::EBT::S32R45::Fls_Example_S32R45_M7::TresosProject::Fls_Example_S32R45_M7::config::Port.xdm, category=SWCFG
          short-label=examples::EBT::S32R45::Fls_Example_S32R45_M7::TresosProject::Fls_Example_S32R45_M7::config::Resource.xdm, category=SWCFG
          short-label=examples::EBT::S32R45::Fls_Example_S32R45_M7::TresosProject::Fls_Example_S32R45_M7::config::Rm.xdm, category=SWCFG
          short-label=examples::S32DS::S32G2::Fls_Example_S32G274A_M7::include::check_example.h, category=SWHDR
          short-label=examples::S32DS::S32G2::Fls_Example_S32G274A_M7::Project_Settings::Startup_Code::exceptions.c, category=SWSRC
          short-label=examples::S32DS::S32G2::Fls_Example_S32G274A_M7::Project_Settings::Startup_Code::nvic.c, category=SWSRC
          short-label=examples::S32DS::S32G2::Fls_Example_S32G274A_M7::Project_Settings::Startup_Code::startup.c, category=SWSRC
          short-label=examples::S32DS::S32G2::Fls_Example_S32G274A_M7::Project_Settings::Startup_Code::system.c, category=SWSRC
          short-label=examples::S32DS::S32G2::Fls_Example_S32G274A_M7::src::main.c, category=SWSRC
          short-label=examples::S32DS::S32G2::Qspi_Ip_Example_S32G274A_M7::include::check_example.h, category=SWHDR
          short-label=examples::S32DS::S32G2::Qspi_Ip_Example_S32G274A_M7::Project_Settings::Startup_Code::exceptions.c, category=SWSRC
          short-label=examples::S32DS::S32G2::Qspi_Ip_Example_S32G274A_M7::Project_Settings::Startup_Code::nvic.c, category=SWSRC
          short-label=examples::S32DS::S32G2::Qspi_Ip_Example_S32G274A_M7::Project_Settings::Startup_Code::startup.c, category=SWSRC
          short-label=examples::S32DS::S32G2::Qspi_Ip_Example_S32G274A_M7::Project_Settings::Startup_Code::system.c, category=SWSRC
          short-label=examples::S32DS::S32G2::Qspi_Ip_Example_S32G274A_M7::src::main.c, category=SWSRC
          short-label=examples::S32DS::S32G3::Fls_Example_S32G399A_M7::include::check_example.h, category=SWHDR
          short-label=examples::S32DS::S32G3::Fls_Example_S32G399A_M7::Project_Settings::Startup_Code::exceptions.c, category=SWSRC
          short-label=examples::S32DS::S32G3::Fls_Example_S32G399A_M7::Project_Settings::Startup_Code::nvic.c, category=SWSRC
          short-label=examples::S32DS::S32G3::Fls_Example_S32G399A_M7::Project_Settings::Startup_Code::startup.c, category=SWSRC
          short-label=examples::S32DS::S32G3::Fls_Example_S32G399A_M7::Project_Settings::Startup_Code::system.c, category=SWSRC
          short-label=examples::S32DS::S32G3::Fls_Example_S32G399A_M7::src::main.c, category=SWSRC
          short-label=examples::S32DS::S32G3::Qspi_Ip_Example_S32G399A_M7::include::check_example.h, category=SWHDR
          short-label=examples::S32DS::S32G3::Qspi_Ip_Example_S32G399A_M7::Project_Settings::Startup_Code::exceptions.c, category=SWSRC
          short-label=examples::S32DS::S32G3::Qspi_Ip_Example_S32G399A_M7::Project_Settings::Startup_Code::nvic.c, category=SWSRC
          short-label=examples::S32DS::S32G3::Qspi_Ip_Example_S32G399A_M7::Project_Settings::Startup_Code::startup.c, category=SWSRC
          short-label=examples::S32DS::S32G3::Qspi_Ip_Example_S32G399A_M7::Project_Settings::Startup_Code::system.c, category=SWSRC
          short-label=examples::S32DS::S32G3::Qspi_Ip_Example_S32G399A_M7::src::main.c, category=SWSRC
          short-label=examples::S32DS::S32R45::Fls_Example_S32R45_M7::include::check_example.h, category=SWHDR
          short-label=examples::S32DS::S32R45::Fls_Example_S32R45_M7::Project_Settings::Startup_Code::exceptions.c, category=SWSRC
          short-label=examples::S32DS::S32R45::Fls_Example_S32R45_M7::Project_Settings::Startup_Code::nvic.c, category=SWSRC
          short-label=examples::S32DS::S32R45::Fls_Example_S32R45_M7::Project_Settings::Startup_Code::startup.c, category=SWSRC
          short-label=examples::S32DS::S32R45::Fls_Example_S32R45_M7::Project_Settings::Startup_Code::system.c, category=SWSRC
          short-label=examples::S32DS::S32R45::Fls_Example_S32R45_M7::src::main.c, category=SWSRC
          short-label=examples::S32DS::S32R45::Qspi_Ip_Example_S32R45_M7::include::check_example.h, category=SWHDR
          short-label=examples::S32DS::S32R45::Qspi_Ip_Example_S32R45_M7::Project_Settings::Startup_Code::exceptions.c, category=SWSRC
          short-label=examples::S32DS::S32R45::Qspi_Ip_Example_S32R45_M7::Project_Settings::Startup_Code::nvic.c, category=SWSRC
          short-label=examples::S32DS::S32R45::Qspi_Ip_Example_S32R45_M7::Project_Settings::Startup_Code::startup.c, category=SWSRC
          short-label=examples::S32DS::S32R45::Qspi_Ip_Example_S32R45_M7::Project_Settings::Startup_Code::system.c, category=SWSRC
          short-label=examples::S32DS::S32R45::Qspi_Ip_Example_S32R45_M7::src::main.c, category=SWSRC
          short-label=include::Fls.h, category=SWHDR
          short-label=include::Fls_Api.h, category=SWHDR
          short-label=include::Fls_IPW.h, category=SWHDR
          short-label=include::Fls_Types.h, category=SWHDR
          short-label=include::Qspi_Ip.h, category=SWHDR
          short-label=include::Qspi_Ip_Common.h, category=SWHDR
          short-label=include::Qspi_Ip_Controller.h, category=SWHDR
          short-label=include::Qspi_Ip_HwAccess.h, category=SWHDR
          short-label=include::Qspi_Ip_Types.h, category=SWHDR
          short-label=src::Fls.c, category=SWSRC
          short-label=src::Fls_IPW.c, category=SWSRC
          short-label=src::Qspi_Ip.c, category=SWSRC
          short-label=src::Qspi_Ip_Controller.c, category=SWSRC
          short-label=src::Qspi_Ip_Sfdp.c, category=SWSRC
    compiler DIAB_Compiler:
      name=Windriver Diab
      options=-tARMCORTEXM7MG:simple -mthumb -std=c99 -Oz -g -fstandalone-debug -Wstrict-prototypes -Wsign-compare -Wdouble-promotion -Wunknown-pragmas -Wundef -Wextra -Wall -pedantic -Werror=implicit-function-declaration -fno-common -fno-signed-char -fno-trigraphs -V -c -DS32XX -DS32G2XX -DDIAB -DUSE_SW_VECTOR_MODE -DD_CACHE_ENABLE -DI_CACHE_ENABLE -DENABLE_FPU -DMCAL_ENABLE_USER_MODE_SUPPORT
      vendor=Windriver
      version=DIAB_7_0_3_0-FCS_20200409_160912
    compiler GCC_Compiler:
      name=GCC Compiler
      options=-mcpu=cortex-m7 -mthumb -mlittle-endian -mfpu=fpv5-sp-d16 -mfloat-abi=hard -std=c99 -Os -ggdb3 -Wall -Wextra -pedantic -Wstrict-prototypes -Wundef -Wunused -Werror=implicit-function-declaration -Wsign-compare -Wdouble-promotion -fno-short-enums -funsigned-char -funsigned-bitfields -fomit-frame-pointer -fno-common -fstack-usage -fdump-ipa-all -c -DS32XX -DS32G2XX -DGCC -DUSE_SW_VECTOR_MODE -DD_CACHE_ENABLE -DI_CACHE_ENABLE -DENABLE_FPU -DMCAL_ENABLE_USER_MODE_SUPPORT
      vendor=GCC Systems
      version=NXP GCC 9.2.0 20190812 (Build 1649 Revision gaf57174)
    compiler GHS_Compiler:
      name=Green Hills
      options=-cpu=cortexm7 -thumb -fpu=vfpv5_d16 -fsingle -C99 --ghstd=last -Osize --gnu_asm -dual_debug -G -keeptempfiles -Wimplicit-int -Wshadow -Wtrigraphs -Wundef --unsigned_chars --unsigned_fields --no_commons --no_exceptions --no_slash_comment --prototype_errors --incorrect_pragma_warnings -c -DS32XX -DS32G2XX -DGHS -DUSE_SW_VECTOR_MODE -DD_CACHE_ENABLE -DI_CACHE_ENABLE -DENABLE_FPU -DMCAL_ENABLE_USER_MODE_SUPPORT
      vendor=Green Hills
      version=Green Hills Multi 7.1.6d / Compiler 2020.1.4
    generated-artifacts:
      8 x dependency on artifact:
        Fls_PBcfg_h: artifact-descriptor={short-label=generate_PB::include::Fls_PBcfg.h, category=SWHDR}, usages=EXECUTE
        Qspi_Ip_PBcfg_h: artifact-descriptor={short-label=generate_PB::include::Qspi_Ip_PBcfg.h, category=SWHDR}, usages=EXECUTE
        Fls_PBcfg_c: artifact-descriptor={short-label=generate_PB::src::Fls_PBcfg.c, category=SWSRC}, usages=EXECUTE
        Qspi_Ip_PBcfg_c: artifact-descriptor={short-label=generate_PB::src::Qspi_Ip_PBcfg.c, category=SWSRC}, usages=EXECUTE
        Fls_Cfg_h: artifact-descriptor={short-label=generate_PC::include::Fls_Cfg.h, category=SWHDR}, usages=COMPILE
        Qspi_Ip_Cfg_h: artifact-descriptor={short-label=generate_PC::include::Qspi_Ip_Cfg.h, category=SWHDR}, usages=COMPILE
        Qspi_Ip_Features_h: artifact-descriptor={short-label=generate_PC::include::Qspi_Ip_Features.h, category=SWHDR}, usages=COMPILE
        Fls_Cfg_c: artifact-descriptor={short-label=generate_PC::src::Fls_Cfg.c, category=SWSRC}, usages=COMPILE
    linker DIAB_Linker: name=Windriver Diab, options=-e Reset_Handler linker_script_file.dld -m30 -Xstack-usage -Xpreprocess-lecl -Llibrary_path -lc -lm, vendor=Windriver, version=DIAB_7_0_3_0-FCS_20200409_160912
    linker GCC_Linker: name=GCC Compiler, options=-Wl,-Map,filename -T linkerfile --entry=Reset_Handler -nostartfiles -mcpu=cortexm7 -mthumb -mfpu=fpv5-sp-d16 -mfloat-abi=hard -mlittle-endian -ggdb3 -lc -lm -lgcc, vendor=GCC Systems, version=NXP GCC 9.2.0 20190812 (Build 1649 Revision gaf57174)
    linker GHS_Linker: name=Green Hills, options=-e Reset_Handler -T linker_script_file.ld -map -keepmap -Mn -delete -ignore_debug_references -Llibrary_path -larch -lstartup -lind_sd -v -nostartfiles, vendor=Green Hills, version=Green Hills Multi 7.1.6d / Compiler 2020.1.4
    resource consumption ResourceConsumption
      13 x memory section:
        FLS_CODE: alignment=UNSPECIFIED, sw-addrmethod=CODE, symbol=CODE
        FLS_CONFIG_DATA_8: alignment=8, sw-addrmethod=CONFIG_DATA, symbol=CONFIG_DATA_8
        FLS_CONFIG_DATA_UNSPECIFIED: alignment=UNSPECIFIED, sw-addrmethod=CONFIG_DATA, symbol=CONFIG_DATA_UNSPECIFIED
        FLS_CONST_32: alignment=32, sw-addrmethod=CONST, symbol=CONST_32
        FLS_CONST_UNSPECIFIED: alignment=UNSPECIFIED, sw-addrmethod=CONST, symbol=CONST_UNSPECIFIED
        FLS_VAR_CLEARED_16: alignment=16, sw-addrmethod=VAR_CLEARED, symbol=VAR_CLEARED_16
        FLS_VAR_CLEARED_32: alignment=32, sw-addrmethod=VAR_CLEARED, symbol=VAR_CLEARED_32
        FLS_VAR_CLEARED_8: alignment=8, sw-addrmethod=VAR_CLEARED, symbol=VAR_CLEARED_8
        FLS_VAR_CLEARED_BOOLEAN: alignment=BOOLEAN, sw-addrmethod=VAR_CLEARED, symbol=VAR_CLEARED_BOOLEAN
        FLS_VAR_CLEARED_UNSPECIFIED: alignment=UNSPECIFIED, sw-addrmethod=VAR_CLEARED, symbol=VAR_CLEARED_UNSPECIFIED
        FLS_VAR_INIT_8: alignment=8, sw-addrmethod=VAR_INIT, symbol=VAR_INIT_8
        FLS_VAR_INIT_8_NO_CACHEABLE: alignment=8, sw-addrmethod=VAR_INIT_NO_CACHEABLE, symbol=VAR_INIT_8_NO_CACHEABLE
        FLS_VAR_INIT_UNSPECIFIED: alignment=UNSPECIFIED, sw-addrmethod=VAR_INIT, symbol=VAR_INIT_UNSPECIFIED
