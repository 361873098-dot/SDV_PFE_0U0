AUTOSAR XML (schema 00046)
package /AUTOSAR_Platform/BswModuleDescriptions
  bsw module description Platform: module-id=255
    provided-entrys:
      Platform_AckIrq
      Platform_GetIrqMonitorStatus
      Platform_GetIrqPriority
      Platform_Init
      Platform_InstallIrqHandler
      Platform_ResetIrqMonitorTimer
      Platform_SelectMonitoredIrq
      Platform_SetIrq
      Platform_SetIrqMonitor
      Platform_SetIrqPriority
      Platform_SetMonitoredIrqLatency
    bsw internal behavior InternalBehavior_0
      11 x bsw called entity:
        Platform_AckIrq: implemented-entry=Platform_AckIrq
        Platform_GetIrqMonitorStatus: implemented-entry=Platform_GetIrqMonitorStatus
        Platform_GetIrqPriority: implemented-entry=Platform_GetIrqPriority
        Platform_Init: implemented-entry=Platform_Init
        Platform_InstallIrqHandler: implemented-entry=Platform_InstallIrqHandler
        Platform_ResetIrqMonitorTimer: implemented-entry=Platform_ResetIrqMonitorTimer
        Platform_SelectMonitoredIrq: implemented-entry=Platform_SelectMonitoredIrq
        Platform_SetIrq: implemented-entry=Platform_SetIrq
        Platform_SetIrqMonitor: implemented-entry=Platform_SetIrqMonitor
        Platform_SetIrqPriority: implemented-entry=Platform_SetIrqPriority
        Platform_SetMonitoredIrqLatency: implemented-entry=Platform_SetMonitoredIrqLatency
package /AUTOSAR_Platform/BswModuleEntrys
  11 x bsw module entry, all with is-synchronous=true, call-type=REGULAR, execution-context=UNSPECIFIED, sw-service-impl-policy=STANDARD:
    Platform_AckIrq: service-id=0x26, is-reentrant=true
    Platform_GetIrqMonitorStatus: service-id=0x2a, is-reentrant=true
    Platform_GetIrqPriority: service-id=0x23, is-reentrant=false
    Platform_Init: service-id=0x20, is-reentrant=false
    Platform_InstallIrqHandler: service-id=0x24, is-reentrant=false
    Platform_ResetIrqMonitorTimer: service-id=0x29, is-reentrant=true
    Platform_SelectMonitoredIrq: service-id=0x27, is-reentrant=true
    Platform_SetIrq: service-id=0x21, is-reentrant=false
    Platform_SetIrqMonitor: service-id=0x25, is-reentrant=true
    Platform_SetIrqPriority: service-id=0x22, is-reentrant=false
    Platform_SetMonitoredIrqLatency: service-id=0x28, is-reentrant=true
package /Platform_TS_T40D11M40I2R0/Implementations
  bsw implementation BswImplementation_0: programming-language=C, sw-version=4.0.2, vendor-id=43, ar-release-version=4.4.0, behavior=InternalBehavior_0, vendor-specific-module-def=Platform
    code-descriptors:
      code Files
        artifact-descriptors:
          short-label=config::Platform.xdm, category=SWCFG
          short-label=doc::RTD_PLATFORM_IM.pdf, category=SWDOC
          short-label=doc::RTD_PLATFORM_UM.pdf, category=SWDOC
          short-label=examples::EBT::S32G2::Platform_Multicore_SingleElf_Example_S32G274A_M7::generate::epc::BaseNXP.xdm, category=SWCFG
          short-label=examples::EBT::S32G2::Platform_Multicore_SingleElf_Example_S32G274A_M7::generate::epc::Dio.xdm, category=SWCFG
          short-label=examples::EBT::S32G2::Platform_Multicore_SingleElf_Example_S32G274A_M7::generate::epc::EcuC.xdm, category=SWCFG
          short-label=examples::EBT::S32G2::Platform_Multicore_SingleElf_Example_S32G274A_M7::generate::epc::Gpt.xdm, category=SWCFG
          short-label=examples::EBT::S32G2::Platform_Multicore_SingleElf_Example_S32G274A_M7::generate::epc::Mcu.xdm, category=SWCFG
          short-label=examples::EBT::S32G2::Platform_Multicore_SingleElf_Example_S32G274A_M7::generate::epc::Os.xdm, category=SWCFG
          short-label=examples::EBT::S32G2::Platform_Multicore_SingleElf_Example_S32G274A_M7::generate::epc::Platform.xdm, category=SWCFG
          short-label=examples::EBT::S32G2::Platform_Multicore_SingleElf_Example_S32G274A_M7::generate::epc::Port.xdm, category=SWCFG
          short-label=examples::EBT::S32G2::Platform_Multicore_SingleElf_Example_S32G274A_M7::generate::epc::Resource.xdm, category=SWCFG
          short-label=examples::EBT::S32G2::Platform_Multicore_SingleElf_Example_S32G274A_M7::include::check_example.h, category=SWHDR
          short-label=examples::EBT::S32G2::Platform_Multicore_SingleElf_Example_S32G274A_M7::src::main.c, category=SWSRC
          short-label=examples::EBT::S32G2::Platform_Multicore_SingleElf_Example_S32G274A_M7::TresosProject::Platform_Multicore_SingleElf_Example_S32G274A_M7::.prefs::preferences.xdm, category=SWCFG
          short-label=examples::EBT::S32G2::Platform_Multicore_SingleElf_Example_S32G274A_M7::TresosProject::Platform_Multicore_SingleElf_Example_S32G274A_M7::config::BaseNXP.xdm, category=SWCFG
          short-label=examples::EBT::S32G2::Platform_Multicore_SingleElf_Example_S32G274A_M7::TresosProject::Platform_Multicore_SingleElf_Example_S32G274A_M7::config::Dio.xdm, category=SWCFG
          short-label=examples::EBT::S32G2::Platform_Multicore_SingleElf_Example_S32G274A_M7::TresosProject::Platform_Multicore_SingleElf_Example_S32G274A_M7::config::EcuC.xdm, category=SWCFG
          short-label=examples::EBT::S32G2::Platform_Multicore_SingleElf_Example_S32G274A_M7::TresosProject::Platform_Multicore_SingleElf_Example_S32G274A_M7::config::Gpt.xdm, category=SWCFG
          short-label=examples::EBT::S32G2::Platform_Multicore_SingleElf_Example_S32G274A_M7::TresosProject::Platform_Multicore_SingleElf_Example_S32G274A_M7::config::Mcu.xdm, category=SWCFG
          short-label=examples::EBT::S32G2::Platform_Multicore_SingleElf_Example_S32G274A_M7::TresosProject::Platform_Multicore_SingleElf_Example_S32G274A_M7::config::Os.xdm, category=SWCFG
          short-label=examples::EBT::S32G2::Platform_Multicore_SingleElf_Example_S32G274A_M7::TresosProject::Platform_Multicore_SingleElf_Example_S32G274A_M7::config::Platform.xdm, category=SWCFG
          short-label=examples::EBT::S32G2::Platform_Multicore_SingleElf_Example_S32G274A_M7::TresosProject::Platform_Multicore_SingleElf_Example_S32G274A_M7::config::Port.xdm, category=SWCFG
          short-label=examples::EBT::S32G2::Platform_Multicore_SingleElf_Example_S32G274A_M7::TresosProject::Platform_Multicore_SingleElf_Example_S32G274A_M7::config::Resource.xdm, category=SWCFG
          short-label=examples::EBT::S32G3::Platform_Multicore_SingleElf_Example_S32G399A_M7::generate::epc::BaseNXP.xdm, category=SWCFG
          short-label=examples::EBT::S32G3::Platform_Multicore_SingleElf_Example_S32G399A_M7::generate::epc::Dio.xdm, category=SWCFG
          short-label=examples::EBT::S32G3::Platform_Multicore_SingleElf_Example_S32G399A_M7::generate::epc::EcuC.xdm, category=SWCFG
          short-label=examples::EBT::S32G3::Platform_Multicore_SingleElf_Example_S32G399A_M7::generate::epc::Gpt.xdm, category=SWCFG
          short-label=examples::EBT::S32G3::Platform_Multicore_SingleElf_Example_S32G399A_M7::generate::epc::Mcu.xdm, category=SWCFG
          short-label=examples::EBT::S32G3::Platform_Multicore_SingleElf_Example_S32G399A_M7::generate::epc::Os.xdm, category=SWCFG
          short-label=examples::EBT::S32G3::Platform_Multicore_SingleElf_Example_S32G399A_M7::generate::epc::Platform.xdm, category=SWCFG
          short-label=examples::EBT::S32G3::Platform_Multicore_SingleElf_Example_S32G399A_M7::generate::epc::Port.xdm, category=SWCFG
          short-label=examples::EBT::S32G3::Platform_Multicore_SingleElf_Example_S32G399A_M7::generate::epc::Resource.xdm, category=SWCFG
          short-label=examples::EBT::S32G3::Platform_Multicore_SingleElf_Example_S32G399A_M7::include::check_example.h, category=SWHDR
          short-label=examples::EBT::S32G3::Platform_Multicore_SingleElf_Example_S32G399A_M7::src::main.c, category=SWSRC
          short-label=examples::EBT::S32G3::Platform_Multicore_SingleElf_Example_S32G399A_M7::TresosProject::Platform_Multicore_SingleElf_Example_S32G399A_M7::.prefs::preferences.xdm, category=SWCFG
          short-label=examples::EBT::S32G3::Platform_Multicore_SingleElf_Example_S32G399A_M7::TresosProject::Platform_Multicore_SingleElf_Example_S32G399A_M7::config::BaseNXP.xdm, category=SWCFG
          short-label=examples::EBT::S32G3::Platform_Multicore_SingleElf_Example_S32G399A_M7::TresosProject::Platform_Multicore_SingleElf_Example_S32G399A_M7::config::Dio.xdm, category=SWCFG
          short-label=examples::EBT::S32G3::Platform_Multicore_SingleElf_Example_S32G399A_M7::TresosProject::Platform_Multicore_SingleElf_Example_S32G399A_M7::config::EcuC.xdm, category=SWCFG
          short-label=examples::EBT::S32G3::Platform_Multicore_SingleElf_Example_S32G399A_M7::TresosProject::Platform_Multicore_SingleElf_Example_S32G399A_M7::config::Gpt.xdm, category=SWCFG
          short-label=examples::EBT::S32G3::Platform_Multicore_SingleElf_Example_S32G399A_M7::TresosProject::Platform_Multicore_SingleElf_Example_S32G399A_M7::config::Mcu.xdm, category=SWCFG
          short-label=examples::EBT::S32G3::Platform_Multicore_SingleElf_Example_S32G399A_M7::TresosProject::Platform_Multicore_SingleElf_Example_S32G399A_M7::config::Os.xdm, category=SWCFG
          short-label=examples::EBT::S32G3::Platform_Multicore_SingleElf_Example_S32G399A_M7::TresosProject::Platform_Multicore_SingleElf_Example_S32G399A_M7::config::Platform.xdm, category=SWCFG
          short-label=examples::EBT::S32G3::Platform_Multicore_SingleElf_Example_S32G399A_M7::TresosProject::Platform_Multicore_SingleElf_Example_S32G399A_M7::config::Port.xdm, category=SWCFG
          short-label=examples::EBT::S32G3::Platform_Multicore_SingleElf_Example_S32G399A_M7::TresosProject::Platform_Multicore_SingleElf_Example_S32G399A_M7::config::Resource.xdm, category=SWCFG
          short-label=examples::EBT::S32R45::Platform_Multicore_SingleElf_Example_S32R45_M7::generate::epc::BaseNXP.xdm, category=SWCFG
          short-label=examples::EBT::S32R45::Platform_Multicore_SingleElf_Example_S32R45_M7::generate::epc::Dio.xdm, category=SWCFG
          short-label=examples::EBT::S32R45::Platform_Multicore_SingleElf_Example_S32R45_M7::generate::epc::EcuC.xdm, category=SWCFG
          short-label=examples::EBT::S32R45::Platform_Multicore_SingleElf_Example_S32R45_M7::generate::epc::Gpt.xdm, category=SWCFG
          short-label=examples::EBT::S32R45::Platform_Multicore_SingleElf_Example_S32R45_M7::generate::epc::Mcu.xdm, category=SWCFG
          short-label=examples::EBT::S32R45::Platform_Multicore_SingleElf_Example_S32R45_M7::generate::epc::Os.xdm, category=SWCFG
          short-label=examples::EBT::S32R45::Platform_Multicore_SingleElf_Example_S32R45_M7::generate::epc::Platform.xdm, category=SWCFG
          short-label=examples::EBT::S32R45::Platform_Multicore_SingleElf_Example_S32R45_M7::generate::epc::Port.xdm, category=SWCFG
          short-label=examples::EBT::S32R45::Platform_Multicore_SingleElf_Example_S32R45_M7::generate::epc::Resource.xdm, category=SWCFG
          short-label=examples::EBT::S32R45::Platform_Multicore_SingleElf_Example_S32R45_M7::include::check_example.h, category=SWHDR
          short-label=examples::EBT::S32R45::Platform_Multicore_SingleElf_Example_S32R45_M7::src::main.c, category=SWSRC
          short-label=examples::EBT::S32R45::Platform_Multicore_SingleElf_Example_S32R45_M7::TresosProject::Platform_Multicore_SingleElf_Example_S32R45_M7::.prefs::preferences.xdm, category=SWCFG
          short-label=examples::EBT::S32R45::Platform_Multicore_SingleElf_Example_S32R45_M7::TresosProject::Platform_Multicore_SingleElf_Example_S32R45_M7::config::BaseNXP.xdm, category=SWCFG
          short-label=examples::EBT::S32R45::Platform_Multicore_SingleElf_Example_S32R45_M7::TresosProject::Platform_Multicore_SingleElf_Example_S32R45_M7::config::Dio.xdm, category=SWCFG
          short-label=examples::EBT::S32R45::Platform_Multicore_SingleElf_Example_S32R45_M7::TresosProject::Platform_Multicore_SingleElf_Example_S32R45_M7::config::EcuC.xdm, category=SWCFG
          short-label=examples::EBT::S32R45::Platform_Multicore_SingleElf_Example_S32R45_M7::TresosProject::Platform_Multicore_SingleElf_Example_S32R45_M7::config::Gpt.xdm, category=SWCFG
          short-label=examples::EBT::S32R45::Platform_Multicore_SingleElf_Example_S32R45_M7::TresosProject::Platform_Multicore_SingleElf_Example_S32R45_M7::config::Mcu.xdm, category=SWCFG
          short-label=examples::EBT::S32R45::Platform_Multicore_SingleElf_Example_S32R45_M7::TresosProject::Platform_Multicore_SingleElf_Example_S32R45_M7::config::Os.xdm, category=SWCFG
          short-label=examples::EBT::S32R45::Platform_Multicore_SingleElf_Example_S32R45_M7::TresosProject::Platform_Multicore_SingleElf_Example_S32R45_M7::config::Platform.xdm, category=SWCFG
          short-label=examples::EBT::S32R45::Platform_Multicore_SingleElf_Example_S32R45_M7::TresosProject::Platform_Multicore_SingleElf_Example_S32R45_M7::config::Port.xdm, category=SWCFG
          short-label=examples::EBT::S32R45::Platform_Multicore_SingleElf_Example_S32R45_M7::TresosProject::Platform_Multicore_SingleElf_Example_S32R45_M7::config::Resource.xdm, category=SWCFG
          short-label=examples::S32DS::S32G2::Platform_Multicore_SingleElf_Example_S32G2XX::board::dcd_config.c, category=SWSRC
          short-label=examples::S32DS::S32G2::Platform_Multicore_SingleElf_Example_S32G2XX::board::ivt_config.c, category=SWSRC
          short-label=examples::S32DS::S32G2::Platform_Multicore_SingleElf_Example_S32G2XX::board::quadspi_config.c, category=SWSRC
          short-label=examples::S32DS::S32G2::Platform_Multicore_SingleElf_Example_S32G2XX::Project_Settings::Startup_Code::exceptions.c, category=SWSRC
          short-label=examples::S32DS::S32G2::Platform_Multicore_SingleElf_Example_S32G2XX::Project_Settings::Startup_Code::nvic.c, category=SWSRC
          short-label=examples::S32DS::S32G2::Platform_Multicore_SingleElf_Example_S32G2XX::Project_Settings::Startup_Code::startup.c, category=SWSRC
          short-label=examples::S32DS::S32G2::Platform_Multicore_SingleElf_Example_S32G2XX::Project_Settings::Startup_Code::system.c, category=SWSRC
          short-label=examples::S32DS::S32G2::Platform_Multicore_SingleElf_Example_S32G2XX::src::main.c, category=SWSRC
          short-label=examples::S32DS::S32G3::Platform_Multicore_SingleElf_Example_S32G3XX::board::dcd_config.c, category=SWSRC
          short-label=examples::S32DS::S32G3::Platform_Multicore_SingleElf_Example_S32G3XX::board::ivt_config.c, category=SWSRC
          short-label=examples::S32DS::S32G3::Platform_Multicore_SingleElf_Example_S32G3XX::board::quadspi_config.c, category=SWSRC
          short-label=examples::S32DS::S32G3::Platform_Multicore_SingleElf_Example_S32G3XX::board::Siul2_Port_Ip_Cfg.c, category=SWSRC
          short-label=examples::S32DS::S32G3::Platform_Multicore_SingleElf_Example_S32G3XX::board::Siul2_Port_Ip_Cfg.h, category=SWHDR
          short-label=examples::S32DS::S32G3::Platform_Multicore_SingleElf_Example_S32G3XX::Project_Settings::Startup_Code::exceptions.c, category=SWSRC
          short-label=examples::S32DS::S32G3::Platform_Multicore_SingleElf_Example_S32G3XX::Project_Settings::Startup_Code::nvic.c, category=SWSRC
          short-label=examples::S32DS::S32G3::Platform_Multicore_SingleElf_Example_S32G3XX::Project_Settings::Startup_Code::startup.c, category=SWSRC
          short-label=examples::S32DS::S32G3::Platform_Multicore_SingleElf_Example_S32G3XX::Project_Settings::Startup_Code::system.c, category=SWSRC
          short-label=examples::S32DS::S32G3::Platform_Multicore_SingleElf_Example_S32G3XX::src::main.c, category=SWSRC
          short-label=examples::S32DS::S32R45::Platform_Multicore_SingleElf_Example_S32R45::board::dcd_config.c, category=SWSRC
          short-label=examples::S32DS::S32R45::Platform_Multicore_SingleElf_Example_S32R45::board::ivt_config.c, category=SWSRC
          short-label=examples::S32DS::S32R45::Platform_Multicore_SingleElf_Example_S32R45::board::quadspi_config.c, category=SWSRC
          short-label=examples::S32DS::S32R45::Platform_Multicore_SingleElf_Example_S32R45::board::Siul2_Port_Ip_Cfg.c, category=SWSRC
          short-label=examples::S32DS::S32R45::Platform_Multicore_SingleElf_Example_S32R45::board::Siul2_Port_Ip_Cfg.h, category=SWHDR
          short-label=examples::S32DS::S32R45::Platform_Multicore_SingleElf_Example_S32R45::Project_Settings::Startup_Code::exceptions.c, category=SWSRC
          short-label=examples::S32DS::S32R45::Platform_Multicore_SingleElf_Example_S32R45::Project_Settings::Startup_Code::nvic.c, category=SWSRC
          short-label=examples::S32DS::S32R45::Platform_Multicore_SingleElf_Example_S32R45::Project_Settings::Startup_Code::startup.c, category=SWSRC
          short-label=examples::S32DS::S32R45::Platform_Multicore_SingleElf_Example_S32R45::Project_Settings::Startup_Code::system.c, category=SWSRC
          short-label=examples::S32DS::S32R45::Platform_Multicore_SingleElf_Example_S32R45::src::main.c, category=SWSRC
          short-label=include::IntCtrl_Ip.h, category=SWHDR
          short-label=include::IntCtrl_Ip_TrustedFunctions.h, category=SWHDR
          short-label=include::IntCtrl_Ip_TypesDef.h, category=SWHDR
          short-label=include::Platform.h, category=SWHDR
          short-label=include::Platform_Ipw.h, category=SWHDR
          short-label=include::Platform_Ipw_TypesDef.h, category=SWHDR
          short-label=include::Platform_TypesDef.h, category=SWHDR
          short-label=include::System_Ip.h, category=SWHDR
          short-label=include::System_Ip_DeviceRegisters.h, category=SWHDR
          short-label=include::System_Ip_TrustedFunctions.h, category=SWHDR
          short-label=src::IntCtrl_Ip.c, category=SWSRC
          short-label=src::Platform.c, category=SWSRC
          short-label=src::Platform_Ipw.c, category=SWSRC
          short-label=src::System_Ip.c, category=SWSRC
          short-label=startup::include::core_specific.h, category=SWHDR
          short-label=startup::include::nvic.h, category=SWHDR
          short-label=startup::include::system.h, category=SWHDR
          short-label=startup::include::sys_init.h, category=SWHDR
          short-label=startup::src::m7::exceptions.c, category=SWSRC
          short-label=startup::src::m7::startup.c, category=SWSRC
          short-label=startup::src::nvic.c, category=SWSRC
          short-label=startup::src::system.c, category=SWSRC
          short-label=startup::src::sys_init.c, category=SWSRC
    compiler DIAB_Compiler:
      name=Windriver Diab
      options=-tARMCORTEXM7MG:simple -mthumb -std=c99 -Oz -g -fstandalone-debug -Wstrict-prototypes -Wsign-compare -Wdouble-promotion -Wunknown-pragmas -Wundef -Wextra -Wall -pedantic -Werror=implicit-function-declaration -fno-common -fno-signed-char -fno-trigraphs -V -c -DS32XX -DS32G2XX -DS32G3XX -DS32R45 -DDIAB -DUSE_SW_VECTOR_MODE -DD_CACHE_ENABLE -DI_CACHE_ENABLE -DENABLE_FPU -DMCAL_ENABLE_USER_MODE_SUPPORT
      vendor=Windriver
      version=DIAB_7_0_3_0-FCS_20200409_160912
    compiler GCC_Compiler:
      name=GCC Compiler
      options=-mcpu=cortex-m7 -mthumb -mlittle-endian -mfpu=fpv5-sp-d16 -mfloat-abi=hard -std=c99 -Os -ggdb3 -Wall -Wextra -pedantic -Wstrict-prototypes -Wundef -Wunused -Werror=implicit-function-declaration -Wsign-compare -Wdouble-promotion -fno-short-enums -funsigned-char -funsigned-bitfields -fomit-frame-pointer -fno-common -fstack-usage -fdump-ipa-all -c -DS32XX -DS32G2XX -DS32G3XX -DS32R45 -DGCC -DUSE_SW_VECTOR_MODE -DD_CACHE_ENABLE -DI_CACHE_ENABLE -DENABLE_FPU -DMCAL_ENABLE_USER_MODE_SUPPORT
      vendor=GCC Systems
      version=NXP GCC 9.2.0 20190812 (Build 1649 Revision gaf57174)
    compiler GHS_Compiler:
      name=Green Hills
      options=-cpu=cortexm7 -thumb -fpu=vfpv5_d16 -fsingle -C99 --ghstd=last -Osize --gnu_asm -dual_debug -G -keeptempfiles -Wimplicit-int -Wshadow -Wtrigraphs -Wundef --unsigned_chars --unsigned_fields --no_commons --no_exceptions --no_slash_comment --prototype_errors --incorrect_pragma_warnings -c -DS32XX -DS32G2XX -DS32G3XX -DS32R45 -DGHS -DUSE_SW_VECTOR_MODE -DD_CACHE_ENABLE -DI_CACHE_ENABLE -DENABLE_FPU -DMCAL_ENABLE_USER_MODE_SUPPORT
      vendor=Green Hills
      version=Green Hills Multi 7.1.6d / Compiler 2020.1.4
    generated-artifacts:
      10 x dependency on artifact, all with usages=COMPILE:
        IntCtrl_Ip_Cfg_h: artifact-descriptor={short-label=generate::include::IntCtrl_Ip_Cfg.h, category=SWHDR}
        IntCtrl_Ip_CfgDefines_h: artifact-descriptor={short-label=generate::include::IntCtrl_Ip_CfgDefines.h, category=SWHDR}
        Platform_Cfg_h: artifact-descriptor={short-label=generate::include::Platform_Cfg.h, category=SWHDR}
        Platform_CfgDefines_h: artifact-descriptor={short-label=generate::include::Platform_CfgDefines.h, category=SWHDR}
        Platform_Ipw_Cfg_h: artifact-descriptor={short-label=generate::include::Platform_Ipw_Cfg.h, category=SWHDR}
        System_Ip_Cfg_h: artifact-descriptor={short-label=generate::include::System_Ip_Cfg.h, category=SWHDR}
        System_Ip_CfgDefines_h: artifact-descriptor={short-label=generate::include::System_Ip_CfgDefines.h, category=SWHDR}
        IntCtrl_Ip_Cfg_c: artifact-descriptor={short-label=generate::src::IntCtrl_Ip_Cfg.c, category=SWSRC}
        Platform_Cfg_c: artifact-descriptor={short-label=generate::src::Platform_Cfg.c, category=SWSRC}
        Platform_Ipw_Cfg_c: artifact-descriptor={short-label=generate::src::Platform_Ipw_Cfg.c, category=SWSRC}
    linker DIAB_Linker: name=Windriver Diab, options=-e Reset_Handler linker_script_file.dld -m30 -Xstack-usage -Xpreprocess-lecl -Llibrary_path -lc -lm, vendor=Windriver, version=DIAB_7_0_3_0-FCS_20200409_160912
    linker GCC_Linker: name=GCC Compiler, options=-Wl,-Map,filename -T linkerfile --entry=Reset_Handler -nostartfiles -mcpu=cortexm7 -mthumb -mfpu=fpv5-sp-d16 -mfloat-abi=hard -mlittle-endian -ggdb3 -lc -lm -lgcc, vendor=GCC Systems, version=NXP GCC 9.2.0 20190812 (Build 1649 Revision gaf57174)
    linker GHS_Linker: name=Green Hills, options=-e Reset_Handler -T linker_script_file.ld -map -keepmap -Mn -delete -ignore_debug_references -Llibrary_path -larch -lstartup -lind_sd -v -nostartfiles, vendor=Green Hills, version=Green Hills Multi 7.1.6d / Compiler 2020.1.4
    resource consumption ResourceConsumption
      5 x memory section:
        PLATFORM_CODE: alignment=UNSPECIFIED, sw-addrmethod=CODE, symbol=CODE
        PLATFORM_CONFIG_DATA_UNSPECIFIED: alignment=UNSPECIFIED, sw-addrmethod=CONFIG_DATA, symbol=CONFIG_DATA_UNSPECIFIED
        PLATFORM_CONST_8: alignment=8, sw-addrmethod=CONST, symbol=CONST_8
        PLATFORM_VAR_CLEARED_32: alignment=32, sw-addrmethod=VAR_CLEARED, symbol=VAR_CLEARED_32
        PLATFORM_VAR_INIT_8_NO_CACHEABLE: alignment=8, sw-addrmethod=VAR_INIT_NO_CACHEABLE, symbol=VAR_INIT_8_NO_CACHEABLE
