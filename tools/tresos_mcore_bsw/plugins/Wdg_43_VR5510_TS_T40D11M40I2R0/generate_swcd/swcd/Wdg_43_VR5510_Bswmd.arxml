AUTOSAR XML (schema 00046)
package /AUTOSAR_Wdg_43_VR5510/BswModuleDescriptions
  bsw module description Wdg: module-id=102
    provided-entrys:
      Wdg_43_VR5510_GetVersionInfo
      Wdg_43_VR5510_Init
      Wdg_43_VR5510_SetMode
      Wdg_43_VR5510_SetTriggerCondition
      Wdg_43_VR5510_Trigger
      Wdg_VR5510_Cbk_GptNotification0
    bsw internal behavior InternalBehavior_0
      6 x exclusive area:
        WDG_EXCLUSIVE_AREA_{00..05}
      6 x bsw called entity:
        Wdg_43_VR5510_GetVersionInfo: implemented-entry=Wdg_43_VR5510_GetVersionInfo
        Wdg_43_VR5510_Init: can-enter-exclusive-area=[WDG_EXCLUSIVE_AREA_03, WDG_EXCLUSIVE_AREA_04], implemented-entry=Wdg_43_VR5510_Init
        Wdg_43_VR5510_SetMode: can-enter-exclusive-area=[WDG_EXCLUSIVE_AREA_01, WDG_EXCLUSIVE_AREA_03, WDG_EXCLUSIVE_AREA_04, WDG_EXCLUSIVE_AREA_05], implemented-entry=Wdg_43_VR5510_SetMode
        Wdg_43_VR5510_SetTriggerCondition: can-enter-exclusive-area=WDG_EXCLUSIVE_AREA_02, implemented-entry=Wdg_43_VR5510_SetTriggerCondition
        Wdg_43_VR5510_Trigger: can-enter-exclusive-area=[WDG_EXCLUSIVE_AREA_00, WDG_EXCLUSIVE_AREA_03, WDG_EXCLUSIVE_AREA_04], implemented-entry=Wdg_43_VR5510_Trigger
        Wdg_VR5510_Cbk_GptNotification0: can-enter-exclusive-area=[WDG_EXCLUSIVE_AREA_00, WDG_EXCLUSIVE_AREA_03, WDG_EXCLUSIVE_AREA_04], implemented-entry=Wdg_VR5510_Cbk_GptNotification0
package /AUTOSAR_Wdg_43_VR5510/BswModuleEntrys
  6 x bsw module entry, all with is-synchronous=true, call-type=REGULAR, execution-context=UNSPECIFIED, sw-service-impl-policy=STANDARD:
    Wdg_43_VR5510_GetVersionInfo: service-id=0x04, is-reentrant=true
    Wdg_43_VR5510_Init: service-id=0x00, is-reentrant=false
    Wdg_43_VR5510_SetMode: service-id=0x01, is-reentrant=false
    Wdg_43_VR5510_SetTriggerCondition: service-id=0x03, is-reentrant=false
    Wdg_43_VR5510_Trigger: service-id=0x02, is-reentrant=false
    Wdg_VR5510_Cbk_GptNotification0: service-id=0x02, is-reentrant=false
package /Wdg_43_VR5510_TS_T40D11M40I2R0/Implementations
  bsw implementation BswImplementation_0: programming-language=C, sw-version=4.0.2, vendor-id=43, ar-release-version=4.4.0, behavior=InternalBehavior_0, vendor-api-infix=VR5510, vendor-specific-module-def=Wdg
    code-descriptors:
      code Files
        artifact-descriptors:
          short-label=config::Wdg_43_VR5510.xdm, category=SWCFG
          short-label=doc::RTD_WDG_43_VR5510_IM.pdf, category=SWDOC
          short-label=doc::RTD_WDG_43_VR5510_UM.pdf, category=SWDOC
          short-label=examples::EBT::S32G2::Wdg_VR5510_Example_S32G274A_M7::generate::epc::BaseNXP.xdm, category=SWCFG
          short-label=examples::EBT::S32G2::Wdg_VR5510_Example_S32G274A_M7::generate::epc::Dem.xdm, category=SWCFG
          short-label=examples::EBT::S32G2::Wdg_VR5510_Example_S32G274A_M7::generate::epc::Dio.xdm, category=SWCFG
          short-label=examples::EBT::S32G2::Wdg_VR5510_Example_S32G274A_M7::generate::epc::EcuC.xdm, category=SWCFG
          short-label=examples::EBT::S32G2::Wdg_VR5510_Example_S32G274A_M7::generate::epc::Gpt.xdm, category=SWCFG
          short-label=examples::EBT::S32G2::Wdg_VR5510_Example_S32G274A_M7::generate::epc::I2c.xdm, category=SWCFG
          short-label=examples::EBT::S32G2::Wdg_VR5510_Example_S32G274A_M7::generate::epc::Mcu.xdm, category=SWCFG
          short-label=examples::EBT::S32G2::Wdg_VR5510_Example_S32G274A_M7::generate::epc::Platform.xdm, category=SWCFG
          short-label=examples::EBT::S32G2::Wdg_VR5510_Example_S32G274A_M7::generate::epc::Pmic.xdm, category=SWCFG
          short-label=examples::EBT::S32G2::Wdg_VR5510_Example_S32G274A_M7::generate::epc::Port.xdm, category=SWCFG
          short-label=examples::EBT::S32G2::Wdg_VR5510_Example_S32G274A_M7::generate::epc::Resource.xdm, category=SWCFG
          short-label=examples::EBT::S32G2::Wdg_VR5510_Example_S32G274A_M7::generate::epc::Wdg_43_vr5510.xdm, category=SWCFG
          short-label=examples::EBT::S32G2::Wdg_VR5510_Example_S32G274A_M7::include::check_example.h, category=SWHDR
          short-label=examples::EBT::S32G2::Wdg_VR5510_Example_S32G274A_M7::src::main.c, category=SWSRC
          short-label=examples::EBT::S32G2::Wdg_VR5510_Example_S32G274A_M7::TresosProject::Wdg_VR5510_Example_S32G274A_M7::.prefs::preferences.xdm, category=SWCFG
          short-label=examples::EBT::S32G2::Wdg_VR5510_Example_S32G274A_M7::TresosProject::Wdg_VR5510_Example_S32G274A_M7::config::BaseNXP.xdm, category=SWCFG
          short-label=examples::EBT::S32G2::Wdg_VR5510_Example_S32G274A_M7::TresosProject::Wdg_VR5510_Example_S32G274A_M7::config::Dem.xdm, category=SWCFG
          short-label=examples::EBT::S32G2::Wdg_VR5510_Example_S32G274A_M7::TresosProject::Wdg_VR5510_Example_S32G274A_M7::config::Dio.xdm, category=SWCFG
          short-label=examples::EBT::S32G2::Wdg_VR5510_Example_S32G274A_M7::TresosProject::Wdg_VR5510_Example_S32G274A_M7::config::EcuC.xdm, category=SWCFG
          short-label=examples::EBT::S32G2::Wdg_VR5510_Example_S32G274A_M7::TresosProject::Wdg_VR5510_Example_S32G274A_M7::config::Gpt.xdm, category=SWCFG
          short-label=examples::EBT::S32G2::Wdg_VR5510_Example_S32G274A_M7::TresosProject::Wdg_VR5510_Example_S32G274A_M7::config::I2c.xdm, category=SWCFG
          short-label=examples::EBT::S32G2::Wdg_VR5510_Example_S32G274A_M7::TresosProject::Wdg_VR5510_Example_S32G274A_M7::config::Mcu.xdm, category=SWCFG
          short-label=examples::EBT::S32G2::Wdg_VR5510_Example_S32G274A_M7::TresosProject::Wdg_VR5510_Example_S32G274A_M7::config::Platform.xdm, category=SWCFG
          short-label=examples::EBT::S32G2::Wdg_VR5510_Example_S32G274A_M7::TresosProject::Wdg_VR5510_Example_S32G274A_M7::config::Pmic.xdm, category=SWCFG
          short-label=examples::EBT::S32G2::Wdg_VR5510_Example_S32G274A_M7::TresosProject::Wdg_VR5510_Example_S32G274A_M7::config::Port.xdm, category=SWCFG
          short-label=examples::EBT::S32G2::Wdg_VR5510_Example_S32G274A_M7::TresosProject::Wdg_VR5510_Example_S32G274A_M7::config::Resource.xdm, category=SWCFG
          short-label=examples::EBT::S32G2::Wdg_VR5510_Example_S32G274A_M7::TresosProject::Wdg_VR5510_Example_S32G274A_M7::config::Wdg_43_vr5510.xdm, category=SWCFG
          short-label=examples::EBT::S32G3::Wdg_VR5510_Example_S32G399A_M7::generate::epc::BaseNXP.xdm, category=SWCFG
          short-label=examples::EBT::S32G3::Wdg_VR5510_Example_S32G399A_M7::generate::epc::Dem.xdm, category=SWCFG
          short-label=examples::EBT::S32G3::Wdg_VR5510_Example_S32G399A_M7::generate::epc::Dio.xdm, category=SWCFG
          short-label=examples::EBT::S32G3::Wdg_VR5510_Example_S32G399A_M7::generate::epc::EcuC.xdm, category=SWCFG
          short-label=examples::EBT::S32G3::Wdg_VR5510_Example_S32G399A_M7::generate::epc::Gpt.xdm, category=SWCFG
          short-label=examples::EBT::S32G3::Wdg_VR5510_Example_S32G399A_M7::generate::epc::I2c.xdm, category=SWCFG
          short-label=examples::EBT::S32G3::Wdg_VR5510_Example_S32G399A_M7::generate::epc::Mcu.xdm, category=SWCFG
          short-label=examples::EBT::S32G3::Wdg_VR5510_Example_S32G399A_M7::generate::epc::Platform.xdm, category=SWCFG
          short-label=examples::EBT::S32G3::Wdg_VR5510_Example_S32G399A_M7::generate::epc::Pmic.xdm, category=SWCFG
          short-label=examples::EBT::S32G3::Wdg_VR5510_Example_S32G399A_M7::generate::epc::Port.xdm, category=SWCFG
          short-label=examples::EBT::S32G3::Wdg_VR5510_Example_S32G399A_M7::generate::epc::Resource.xdm, category=SWCFG
          short-label=examples::EBT::S32G3::Wdg_VR5510_Example_S32G399A_M7::generate::epc::Wdg_43_vr5510.xdm, category=SWCFG
          short-label=examples::EBT::S32G3::Wdg_VR5510_Example_S32G399A_M7::include::check_example.h, category=SWHDR
          short-label=examples::EBT::S32G3::Wdg_VR5510_Example_S32G399A_M7::src::main.c, category=SWSRC
          short-label=examples::EBT::S32G3::Wdg_VR5510_Example_S32G399A_M7::TresosProject::Wdg_VR5510_Example_S32G399A_M7::.prefs::preferences.xdm, category=SWCFG
          short-label=examples::EBT::S32G3::Wdg_VR5510_Example_S32G399A_M7::TresosProject::Wdg_VR5510_Example_S32G399A_M7::config::BaseNXP.xdm, category=SWCFG
          short-label=examples::EBT::S32G3::Wdg_VR5510_Example_S32G399A_M7::TresosProject::Wdg_VR5510_Example_S32G399A_M7::config::Dem.xdm, category=SWCFG
          short-label=examples::EBT::S32G3::Wdg_VR5510_Example_S32G399A_M7::TresosProject::Wdg_VR5510_Example_S32G399A_M7::config::Dio.xdm, category=SWCFG
          short-label=examples::EBT::S32G3::Wdg_VR5510_Example_S32G399A_M7::TresosProject::Wdg_VR5510_Example_S32G399A_M7::config::EcuC.xdm, category=SWCFG
          short-label=examples::EBT::S32G3::Wdg_VR5510_Example_S32G399A_M7::TresosProject::Wdg_VR5510_Example_S32G399A_M7::config::Gpt.xdm, category=SWCFG
          short-label=examples::EBT::S32G3::Wdg_VR5510_Example_S32G399A_M7::TresosProject::Wdg_VR5510_Example_S32G399A_M7::config::I2c.xdm, category=SWCFG
          short-label=examples::EBT::S32G3::Wdg_VR5510_Example_S32G399A_M7::TresosProject::Wdg_VR5510_Example_S32G399A_M7::config::Mcu.xdm, category=SWCFG
          short-label=examples::EBT::S32G3::Wdg_VR5510_Example_S32G399A_M7::TresosProject::Wdg_VR5510_Example_S32G399A_M7::config::Platform.xdm, category=SWCFG
          short-label=examples::EBT::S32G3::Wdg_VR5510_Example_S32G399A_M7::TresosProject::Wdg_VR5510_Example_S32G399A_M7::config::Pmic.xdm, category=SWCFG
          short-label=examples::EBT::S32G3::Wdg_VR5510_Example_S32G399A_M7::TresosProject::Wdg_VR5510_Example_S32G399A_M7::config::Port.xdm, category=SWCFG
          short-label=examples::EBT::S32G3::Wdg_VR5510_Example_S32G399A_M7::TresosProject::Wdg_VR5510_Example_S32G399A_M7::config::Resource.xdm, category=SWCFG
          short-label=examples::EBT::S32G3::Wdg_VR5510_Example_S32G399A_M7::TresosProject::Wdg_VR5510_Example_S32G399A_M7::config::Wdg_43_vr5510.xdm, category=SWCFG
          short-label=examples::S32DS::S32G2::Wdg_VR5510_HLD_Example_S32G274A_M7::include::check_example.h, category=SWHDR
          short-label=examples::S32DS::S32G2::Wdg_VR5510_HLD_Example_S32G274A_M7::Project_Settings::Startup_Code::exceptions.c, category=SWSRC
          short-label=examples::S32DS::S32G2::Wdg_VR5510_HLD_Example_S32G274A_M7::Project_Settings::Startup_Code::nvic.c, category=SWSRC
          short-label=examples::S32DS::S32G2::Wdg_VR5510_HLD_Example_S32G274A_M7::Project_Settings::Startup_Code::startup.c, category=SWSRC
          short-label=examples::S32DS::S32G2::Wdg_VR5510_HLD_Example_S32G274A_M7::Project_Settings::Startup_Code::system.c, category=SWSRC
          short-label=examples::S32DS::S32G2::Wdg_VR5510_HLD_Example_S32G274A_M7::src::main.c, category=SWSRC
          short-label=examples::S32DS::S32G2::Wdg_VR5510_IP_Example_S32G274A_M7::include::check_example.h, category=SWHDR
          short-label=examples::S32DS::S32G2::Wdg_VR5510_IP_Example_S32G274A_M7::Project_Settings::Startup_Code::exceptions.c, category=SWSRC
          short-label=examples::S32DS::S32G2::Wdg_VR5510_IP_Example_S32G274A_M7::Project_Settings::Startup_Code::nvic.c, category=SWSRC
          short-label=examples::S32DS::S32G2::Wdg_VR5510_IP_Example_S32G274A_M7::Project_Settings::Startup_Code::startup.c, category=SWSRC
          short-label=examples::S32DS::S32G2::Wdg_VR5510_IP_Example_S32G274A_M7::Project_Settings::Startup_Code::system.c, category=SWSRC
          short-label=examples::S32DS::S32G2::Wdg_VR5510_IP_Example_S32G274A_M7::src::main.c, category=SWSRC
          short-label=examples::S32DS::S32G3::Wdg_VR5510_HLD_Example_S32G399A_M7::include::check_example.h, category=SWHDR
          short-label=examples::S32DS::S32G3::Wdg_VR5510_HLD_Example_S32G399A_M7::Project_Settings::Startup_Code::exceptions.c, category=SWSRC
          short-label=examples::S32DS::S32G3::Wdg_VR5510_HLD_Example_S32G399A_M7::Project_Settings::Startup_Code::nvic.c, category=SWSRC
          short-label=examples::S32DS::S32G3::Wdg_VR5510_HLD_Example_S32G399A_M7::Project_Settings::Startup_Code::startup.c, category=SWSRC
          short-label=examples::S32DS::S32G3::Wdg_VR5510_HLD_Example_S32G399A_M7::Project_Settings::Startup_Code::system.c, category=SWSRC
          short-label=examples::S32DS::S32G3::Wdg_VR5510_HLD_Example_S32G399A_M7::src::main.c, category=SWSRC
          short-label=examples::S32DS::S32G3::Wdg_VR5510_IP_Example_S32G399A_M7::include::check_example.h, category=SWHDR
          short-label=examples::S32DS::S32G3::Wdg_VR5510_IP_Example_S32G399A_M7::Project_Settings::Startup_Code::exceptions.c, category=SWSRC
          short-label=examples::S32DS::S32G3::Wdg_VR5510_IP_Example_S32G399A_M7::Project_Settings::Startup_Code::nvic.c, category=SWSRC
          short-label=examples::S32DS::S32G3::Wdg_VR5510_IP_Example_S32G399A_M7::Project_Settings::Startup_Code::startup.c, category=SWSRC
          short-label=examples::S32DS::S32G3::Wdg_VR5510_IP_Example_S32G399A_M7::Project_Settings::Startup_Code::system.c, category=SWSRC
          short-label=examples::S32DS::S32G3::Wdg_VR5510_IP_Example_S32G399A_M7::src::main.c, category=SWSRC
          short-label=include::Wdg_43_VR5510.h, category=SWHDR
          short-label=include::Wdg_43_VR5510_EnvCfg.h, category=SWHDR
          short-label=include::Wdg_43_VR5510_IPW.h, category=SWHDR
          short-label=include::Wdg_43_VR5510_IPW_Types.h, category=SWHDR
          short-label=include::Wdg_VR5510_VR55XX.h, category=SWHDR
          short-label=include::Wdg_VR5510_VR55XX_Types.h, category=SWHDR
          short-label=src::Wdg_43_VR5510.c, category=SWSRC
          short-label=src::Wdg_VR5510_VR55XX.c, category=SWSRC
    compiler DIAB_Compiler:
      name=Windriver Diab
      options=-tARMCORTEXM7MG:simple -mthumb -std=c99 -Oz -g -fstandalone-debug -Wstrict-prototypes -Wsign-compare -Wdouble-promotion -Wunknown-pragmas -Wundef -Wextra -Wall -pedantic -Werror=implicit-function-declaration -fno-common -fno-signed-char -fno-trigraphs -V -c -DS32XX -DS32G2XX -DS32G3XX -DS32R45 -DDIAB -DUSE_SW_VECTOR_MODE -DD_CACHE_ENABLE -DI_CACHE_ENABLE -DENABLE_FPU -DMCAL_ENABLE_USER_MODE_SUPPORT
      vendor=Windriver
      version=DIAB_7_0_3_0-FCS_20200409_160912
    compiler GCC_Compiler:
      name=GCC Compiler
      options=-mcpu=cortex-m7 -mthumb -mlittle-endian -mfpu=fpv5-sp-d16 -mfloat-abi=hard -std=c99 -Os -ggdb3 -Wall -Wextra -pedantic -Wstrict-prototypes -Wundef -Wunused -Werror=implicit-function-declaration -Wsign-compare -Wdouble-promotion -fno-short-enums -funsigned-char -funsigned-bitfields -fomit-frame-pointer -fno-common -fstack-usage -fdump-ipa-all -c -DS32XX -DS32G2XX -DS32G3XX -DS32R45 -DGCC -DUSE_SW_VECTOR_MODE -DD_CACHE_ENABLE -DI_CACHE_ENABLE -DENABLE_FPU -DMCAL_ENABLE_USER_MODE_SUPPORT
      vendor=GCC Systems
      version=NXP GCC 9.2.0 20190812 (Build 1649 Revision gaf57174)
    compiler GHS_Compiler:
      name=Green Hills
      options=-cpu=cortexm7 -thumb -fpu=vfpv5_d16 -fsingle -C99 --ghstd=last -Osize --gnu_asm -dual_debug -G -keeptempfiles -Wimplicit-int -Wshadow -Wtrigraphs -Wundef --unsigned_chars --unsigned_fields --no_commons --no_exceptions --no_slash_comment --prototype_errors --incorrect_pragma_warnings -c -DS32XX -DS32G2XX -DS32G3XX -DS32R45 -DGHS -DUSE_SW_VECTOR_MODE -DD_CACHE_ENABLE -DI_CACHE_ENABLE -DENABLE_FPU -DMCAL_ENABLE_USER_MODE_SUPPORT
      vendor=Green Hills
      version=Green Hills Multi 7.1.6d / Compiler 2020.1.4
    generated-artifacts:
      7 x dependency on artifact:
        Wdg_43_VR5510_Cfg_h: artifact-descriptor={short-label=generate::include::Wdg_43_VR5510_Cfg.h, category=SWHDR}, usages=COMPILE
        Wdg_43_VR5510_CfgExt_h: artifact-descriptor={short-label=generate::include::Wdg_43_VR5510_CfgExt.h, category=SWHDR}, usages=COMPILE
        Wdg_43_VR5510_PBcfg_h: artifact-descriptor={short-label=generate::include::Wdg_43_VR5510_PBcfg.h, category=SWHDR}, usages=COMPILE
        Wdg_43_VR5510_CfgExt_c: artifact-descriptor={short-label=generate::src::Wdg_43_VR5510_CfgExt.c, category=SWSRC}, usages=COMPILE
        Wdg_43_VR5510_Lcfg_c: artifact-descriptor={short-label=generate_LT::src::Wdg_43_VR5510_Lcfg.c, category=SWSRC}, usages=LINK
        Wdg_43_VR5510_PBcfg_c: artifact-descriptor={short-label=generate_PB::src::Wdg_43_VR5510_PBcfg.c, category=SWSRC}, usages=EXECUTE
        Wdg_43_VR5510_Cfg_c: artifact-descriptor={short-label=generate_PC::src::Wdg_43_VR5510_Cfg.c, category=SWSRC}, usages=COMPILE
    linker DIAB_Linker: name=Windriver Diab, options=-e Reset_Handler linker_script_file.dld -m30 -Xstack-usage -Xpreprocess-lecl -Llibrary_path -lc -lm, vendor=Windriver, version=DIAB_7_0_3_0-FCS_20200409_160912
    linker GCC_Linker: name=GCC Compiler, options=-Wl,-Map,filename -T linkerfile --entry=Reset_Handler -nostartfiles -mcpu=cortexm7 -mthumb -mfpu=fpv5-sp-d16 -mfloat-abi=hard -mlittle-endian -ggdb3 -lc -lm -lgcc, vendor=GCC Systems, version=NXP GCC 9.2.0 20190812 (Build 1649 Revision gaf57174)
    linker GHS_Linker: name=Green Hills, options=-e Reset_Handler -T linker_script_file.ld -map -keepmap -Mn -delete -ignore_debug_references -Llibrary_path -larch -lstartup -lind_sd -v -nostartfiles, vendor=Green Hills, version=Green Hills Multi 7.1.6d / Compiler 2020.1.4
    resource consumption ResourceConsumption
      8 x memory section:
        WDG_43_VR5510_CODE: alignment=UNSPECIFIED, sw-addrmethod=CODE, symbol=CODE
        WDG_43_VR5510_CONFIG_DATA_UNSPECIFIED: alignment=UNSPECIFIED, sw-addrmethod=CONFIG_DATA, symbol=CONFIG_DATA_UNSPECIFIED
        WDG_43_VR5510_CONST_UNSPECIFIED: alignment=UNSPECIFIED, sw-addrmethod=CONST, symbol=CONST_UNSPECIFIED
        WDG_43_VR5510_RAMCODE: alignment=UNSPECIFIED, sw-addrmethod=RAMCODE, symbol=RAMCODE
        WDG_43_VR5510_VAR_CLEARED_32: alignment=32, sw-addrmethod=VAR_CLEARED, symbol=VAR_CLEARED_32
        WDG_43_VR5510_VAR_CLEARED_BOOLEAN: alignment=BOOLEAN, sw-addrmethod=VAR_CLEARED, symbol=VAR_CLEARED_BOOLEAN
        WDG_43_VR5510_VAR_CLEARED_UNSPECIFIED: alignment=UNSPECIFIED, sw-addrmethod=VAR_CLEARED, symbol=VAR_CLEARED_UNSPECIFIED
        WDG_43_VR5510_VAR_INIT_UNSPECIFIED: alignment=UNSPECIFIED, sw-addrmethod=VAR_INIT, symbol=VAR_INIT_UNSPECIFIED
