AUTOSAR XML (schema 00046)
package /AUTOSAR_Wdg/BswModuleDescriptions
  bsw module description Wdg: module-id=102
    provided-entrys:
      Wdg_43_Instance0_ClearResetRequest
      Wdg_43_Instance0_GetVersionInfo
      Wdg_43_Instance0_Init
      Wdg_43_Instance0_Service
      Wdg_43_Instance0_SetMode
      Wdg_43_Instance0_SetTriggerCondition
      Wdg_43_Instance10_ClearResetRequest
      Wdg_43_Instance10_GetVersionInfo
      Wdg_43_Instance10_Init
      Wdg_43_Instance10_Service
      Wdg_43_Instance10_SetMode
      Wdg_43_Instance10_SetTriggerCondition
      Wdg_43_Instance11_ClearResetRequest
      Wdg_43_Instance11_GetVersionInfo
      Wdg_43_Instance11_Init
      Wdg_43_Instance11_Service
      Wdg_43_Instance11_SetMode
      Wdg_43_Instance11_SetTriggerCondition
      Wdg_43_Instance1_ClearResetRequest
      Wdg_43_Instance1_GetVersionInfo
      Wdg_43_Instance1_Init
      Wdg_43_Instance1_Service
      Wdg_43_Instance1_SetMode
      Wdg_43_Instance1_SetTriggerCondition
      Wdg_43_Instance2_ClearResetRequest
      Wdg_43_Instance2_GetVersionInfo
      Wdg_43_Instance2_Init
      Wdg_43_Instance2_Service
      Wdg_43_Instance2_SetMode
      Wdg_43_Instance2_SetTriggerCondition
      Wdg_43_Instance3_ClearResetRequest
      Wdg_43_Instance3_GetVersionInfo
      Wdg_43_Instance3_Init
      Wdg_43_Instance3_Service
      Wdg_43_Instance3_SetMode
      Wdg_43_Instance3_SetTriggerCondition
      Wdg_43_Instance4_ClearResetRequest
      Wdg_43_Instance4_GetVersionInfo
      Wdg_43_Instance4_Init
      Wdg_43_Instance4_Service
      Wdg_43_Instance4_SetMode
      Wdg_43_Instance4_SetTriggerCondition
      Wdg_43_Instance5_ClearResetRequest
      Wdg_43_Instance5_GetVersionInfo
      Wdg_43_Instance5_Init
      Wdg_43_Instance5_Service
      Wdg_43_Instance5_SetMode
      Wdg_43_Instance5_SetTriggerCondition
      Wdg_43_Instance6_ClearResetRequest
      Wdg_43_Instance6_GetVersionInfo
      Wdg_43_Instance6_Init
      Wdg_43_Instance6_Service
      Wdg_43_Instance6_SetMode
      Wdg_43_Instance6_SetTriggerCondition
      Wdg_43_Instance7_ClearResetRequest
      Wdg_43_Instance7_GetVersionInfo
      Wdg_43_Instance7_Init
      Wdg_43_Instance7_Service
      Wdg_43_Instance7_SetMode
      Wdg_43_Instance7_SetTriggerCondition
      Wdg_43_Instance8_ClearResetRequest
      Wdg_43_Instance8_GetVersionInfo
      Wdg_43_Instance8_Init
      Wdg_43_Instance8_Service
      Wdg_43_Instance8_SetMode
      Wdg_43_Instance8_SetTriggerCondition
      Wdg_43_Instance9_ClearResetRequest
      Wdg_43_Instance9_GetVersionInfo
      Wdg_43_Instance9_Init
      Wdg_43_Instance9_Service
      Wdg_43_Instance9_SetMode
      Wdg_43_Instance9_SetTriggerCondition
      Wdg_Cbk_GptNotification0
      Wdg_Cbk_GptNotification1
      Wdg_Cbk_GptNotification10
      Wdg_Cbk_GptNotification11
      Wdg_Cbk_GptNotification{2..9}
      Swt_Ip_Swt0_Isr
      Swt_Ip_Swt10_Isr
      Swt_Ip_Swt11_Isr
      Swt_Ip_Swt{1..9}_Isr
    bsw internal behavior InternalBehavior_0
      12 x exclusive area:
        WDG_EXCLUSIVE_AREA_{00..11}
      84 x bsw called entity:
        Wdg_43_Instance0_ClearResetRequest: can-enter-exclusive-area=WDG_EXCLUSIVE_AREA_08, implemented-entry=Wdg_43_Instance0_ClearResetRequest
        Wdg_43_Instance0_GetVersionInfo: implemented-entry=Wdg_43_Instance0_GetVersionInfo
        Wdg_43_Instance0_Init: can-enter-exclusive-area=[WDG_EXCLUSIVE_AREA_01, WDG_EXCLUSIVE_AREA_02, WDG_EXCLUSIVE_AREA_06, WDG_EXCLUSIVE_AREA_07], implemented-entry=Wdg_43_Instance0_Init
        Wdg_43_Instance0_Service: can-enter-exclusive-area=[WDG_EXCLUSIVE_AREA_06, WDG_EXCLUSIVE_AREA_07, WDG_EXCLUSIVE_AREA_09], implemented-entry=Wdg_43_Instance0_Service
        Wdg_43_Instance0_SetMode: can-enter-exclusive-area=[WDG_EXCLUSIVE_AREA_03, WDG_EXCLUSIVE_AREA_04, WDG_EXCLUSIVE_AREA_06, WDG_EXCLUSIVE_AREA_07, WDG_EXCLUSIVE_AREA_10, WDG_EXCLUSIVE_AREA_11], implemented-entry=Wdg_43_Instance0_SetMode
        Wdg_43_Instance0_SetTriggerCondition: can-enter-exclusive-area=WDG_EXCLUSIVE_AREA_05, implemented-entry=Wdg_43_Instance0_SetTriggerCondition
        Wdg_43_Instance10_ClearResetRequest: can-enter-exclusive-area=WDG_EXCLUSIVE_AREA_08, implemented-entry=Wdg_43_Instance10_ClearResetRequest
        Wdg_43_Instance10_GetVersionInfo: implemented-entry=Wdg_43_Instance10_GetVersionInfo
        Wdg_43_Instance10_Init: can-enter-exclusive-area=[WDG_EXCLUSIVE_AREA_01, WDG_EXCLUSIVE_AREA_02, WDG_EXCLUSIVE_AREA_06, WDG_EXCLUSIVE_AREA_07], implemented-entry=Wdg_43_Instance10_Init
        Wdg_43_Instance10_Service: can-enter-exclusive-area=[WDG_EXCLUSIVE_AREA_06, WDG_EXCLUSIVE_AREA_07, WDG_EXCLUSIVE_AREA_09], implemented-entry=Wdg_43_Instance10_Service
        Wdg_43_Instance10_SetMode: can-enter-exclusive-area=[WDG_EXCLUSIVE_AREA_03, WDG_EXCLUSIVE_AREA_04, WDG_EXCLUSIVE_AREA_06, WDG_EXCLUSIVE_AREA_07, WDG_EXCLUSIVE_AREA_10, WDG_EXCLUSIVE_AREA_11], implemented-entry=Wdg_43_Instance10_SetMode
        Wdg_43_Instance10_SetTriggerCondition: can-enter-exclusive-area=WDG_EXCLUSIVE_AREA_05, implemented-entry=Wdg_43_Instance10_SetTriggerCondition
        Wdg_43_Instance11_ClearResetRequest: can-enter-exclusive-area=WDG_EXCLUSIVE_AREA_08, implemented-entry=Wdg_43_Instance11_ClearResetRequest
        Wdg_43_Instance11_GetVersionInfo: implemented-entry=Wdg_43_Instance11_GetVersionInfo
        Wdg_43_Instance11_Init: can-enter-exclusive-area=[WDG_EXCLUSIVE_AREA_01, WDG_EXCLUSIVE_AREA_02, WDG_EXCLUSIVE_AREA_06, WDG_EXCLUSIVE_AREA_07], implemented-entry=Wdg_43_Instance11_Init
        Wdg_43_Instance11_Service: can-enter-exclusive-area=[WDG_EXCLUSIVE_AREA_06, WDG_EXCLUSIVE_AREA_07, WDG_EXCLUSIVE_AREA_09], implemented-entry=Wdg_43_Instance11_Service
        Wdg_43_Instance11_SetMode: can-enter-exclusive-area=[WDG_EXCLUSIVE_AREA_03, WDG_EXCLUSIVE_AREA_04, WDG_EXCLUSIVE_AREA_06, WDG_EXCLUSIVE_AREA_07, WDG_EXCLUSIVE_AREA_10, WDG_EXCLUSIVE_AREA_11], implemented-entry=Wdg_43_Instance11_SetMode
        Wdg_43_Instance11_SetTriggerCondition: can-enter-exclusive-area=WDG_EXCLUSIVE_AREA_05, implemented-entry=Wdg_43_Instance11_SetTriggerCondition
        Wdg_43_Instance1_ClearResetRequest: can-enter-exclusive-area=WDG_EXCLUSIVE_AREA_08, implemented-entry=Wdg_43_Instance1_ClearResetRequest
        Wdg_43_Instance1_GetVersionInfo: implemented-entry=Wdg_43_Instance1_GetVersionInfo
        Wdg_43_Instance1_Init: can-enter-exclusive-area=[WDG_EXCLUSIVE_AREA_01, WDG_EXCLUSIVE_AREA_02, WDG_EXCLUSIVE_AREA_06, WDG_EXCLUSIVE_AREA_07], implemented-entry=Wdg_43_Instance1_Init
        Wdg_43_Instance1_Service: can-enter-exclusive-area=[WDG_EXCLUSIVE_AREA_06, WDG_EXCLUSIVE_AREA_07, WDG_EXCLUSIVE_AREA_09], implemented-entry=Wdg_43_Instance1_Service
        Wdg_43_Instance1_SetMode: can-enter-exclusive-area=[WDG_EXCLUSIVE_AREA_03, WDG_EXCLUSIVE_AREA_04, WDG_EXCLUSIVE_AREA_06, WDG_EXCLUSIVE_AREA_07, WDG_EXCLUSIVE_AREA_10, WDG_EXCLUSIVE_AREA_11], implemented-entry=Wdg_43_Instance1_SetMode
        Wdg_43_Instance1_SetTriggerCondition: can-enter-exclusive-area=WDG_EXCLUSIVE_AREA_05, implemented-entry=Wdg_43_Instance1_SetTriggerCondition
        Wdg_43_Instance2_ClearResetRequest: can-enter-exclusive-area=WDG_EXCLUSIVE_AREA_08, implemented-entry=Wdg_43_Instance2_ClearResetRequest
        Wdg_43_Instance2_GetVersionInfo: implemented-entry=Wdg_43_Instance2_GetVersionInfo
        Wdg_43_Instance2_Init: can-enter-exclusive-area=[WDG_EXCLUSIVE_AREA_01, WDG_EXCLUSIVE_AREA_02, WDG_EXCLUSIVE_AREA_06, WDG_EXCLUSIVE_AREA_07], implemented-entry=Wdg_43_Instance2_Init
        Wdg_43_Instance2_Service: can-enter-exclusive-area=[WDG_EXCLUSIVE_AREA_06, WDG_EXCLUSIVE_AREA_07, WDG_EXCLUSIVE_AREA_09], implemented-entry=Wdg_43_Instance2_Service
        Wdg_43_Instance2_SetMode: can-enter-exclusive-area=[WDG_EXCLUSIVE_AREA_03, WDG_EXCLUSIVE_AREA_04, WDG_EXCLUSIVE_AREA_06, WDG_EXCLUSIVE_AREA_07, WDG_EXCLUSIVE_AREA_10, WDG_EXCLUSIVE_AREA_11], implemented-entry=Wdg_43_Instance2_SetMode
        Wdg_43_Instance2_SetTriggerCondition: can-enter-exclusive-area=WDG_EXCLUSIVE_AREA_05, implemented-entry=Wdg_43_Instance2_SetTriggerCondition
        Wdg_43_Instance3_ClearResetRequest: can-enter-exclusive-area=WDG_EXCLUSIVE_AREA_08, implemented-entry=Wdg_43_Instance3_ClearResetRequest
        Wdg_43_Instance3_GetVersionInfo: implemented-entry=Wdg_43_Instance3_GetVersionInfo
        Wdg_43_Instance3_Init: can-enter-exclusive-area=[WDG_EXCLUSIVE_AREA_01, WDG_EXCLUSIVE_AREA_02, WDG_EXCLUSIVE_AREA_06, WDG_EXCLUSIVE_AREA_07], implemented-entry=Wdg_43_Instance3_Init
        Wdg_43_Instance3_Service: can-enter-exclusive-area=[WDG_EXCLUSIVE_AREA_06, WDG_EXCLUSIVE_AREA_07, WDG_EXCLUSIVE_AREA_09], implemented-entry=Wdg_43_Instance3_Service
        Wdg_43_Instance3_SetMode: can-enter-exclusive-area=[WDG_EXCLUSIVE_AREA_03, WDG_EXCLUSIVE_AREA_04, WDG_EXCLUSIVE_AREA_06, WDG_EXCLUSIVE_AREA_07, WDG_EXCLUSIVE_AREA_10, WDG_EXCLUSIVE_AREA_11], implemented-entry=Wdg_43_Instance3_SetMode
        Wdg_43_Instance3_SetTriggerCondition: can-enter-exclusive-area=WDG_EXCLUSIVE_AREA_05, implemented-entry=Wdg_43_Instance3_SetTriggerCondition
        Wdg_43_Instance4_ClearResetRequest: can-enter-exclusive-area=WDG_EXCLUSIVE_AREA_08, implemented-entry=Wdg_43_Instance4_ClearResetRequest
        Wdg_43_Instance4_GetVersionInfo: implemented-entry=Wdg_43_Instance4_GetVersionInfo
        Wdg_43_Instance4_Init: can-enter-exclusive-area=[WDG_EXCLUSIVE_AREA_01, WDG_EXCLUSIVE_AREA_02, WDG_EXCLUSIVE_AREA_06, WDG_EXCLUSIVE_AREA_07], implemented-entry=Wdg_43_Instance4_Init
        Wdg_43_Instance4_Service: can-enter-exclusive-area=[WDG_EXCLUSIVE_AREA_06, WDG_EXCLUSIVE_AREA_07, WDG_EXCLUSIVE_AREA_09], implemented-entry=Wdg_43_Instance4_Service
        Wdg_43_Instance4_SetMode: can-enter-exclusive-area=[WDG_EXCLUSIVE_AREA_03, WDG_EXCLUSIVE_AREA_04, WDG_EXCLUSIVE_AREA_06, WDG_EXCLUSIVE_AREA_07, WDG_EXCLUSIVE_AREA_10, WDG_EXCLUSIVE_AREA_11], implemented-entry=Wdg_43_Instance4_SetMode
        Wdg_43_Instance4_SetTriggerCondition: can-enter-exclusive-area=WDG_EXCLUSIVE_AREA_05, implemented-entry=Wdg_43_Instance4_SetTriggerCondition
        Wdg_43_Instance5_ClearResetRequest: can-enter-exclusive-area=WDG_EXCLUSIVE_AREA_08, implemented-entry=Wdg_43_Instance5_ClearResetRequest
        Wdg_43_Instance5_GetVersionInfo: implemented-entry=Wdg_43_Instance5_GetVersionInfo
        Wdg_43_Instance5_Init: can-enter-exclusive-area=[WDG_EXCLUSIVE_AREA_01, WDG_EXCLUSIVE_AREA_02, WDG_EXCLUSIVE_AREA_06, WDG_EXCLUSIVE_AREA_07], implemented-entry=Wdg_43_Instance5_Init
        Wdg_43_Instance5_Service: can-enter-exclusive-area=[WDG_EXCLUSIVE_AREA_06, WDG_EXCLUSIVE_AREA_07, WDG_EXCLUSIVE_AREA_09], implemented-entry=Wdg_43_Instance5_Service
        Wdg_43_Instance5_SetMode: can-enter-exclusive-area=[WDG_EXCLUSIVE_AREA_03, WDG_EXCLUSIVE_AREA_04, WDG_EXCLUSIVE_AREA_06, WDG_EXCLUSIVE_AREA_07, WDG_EXCLUSIVE_AREA_10, WDG_EXCLUSIVE_AREA_11], implemented-entry=Wdg_43_Instance5_SetMode
        Wdg_43_Instance5_SetTriggerCondition: can-enter-exclusive-area=WDG_EXCLUSIVE_AREA_05, implemented-entry=Wdg_43_Instance5_SetTriggerCondition
        Wdg_43_Instance6_ClearResetRequest: can-enter-exclusive-area=WDG_EXCLUSIVE_AREA_08, implemented-entry=Wdg_43_Instance6_ClearResetRequest
        Wdg_43_Instance6_GetVersionInfo: implemented-entry=Wdg_43_Instance6_GetVersionInfo
        Wdg_43_Instance6_Init: can-enter-exclusive-area=[WDG_EXCLUSIVE_AREA_01, WDG_EXCLUSIVE_AREA_02, WDG_EXCLUSIVE_AREA_06, WDG_EXCLUSIVE_AREA_07], implemented-entry=Wdg_43_Instance6_Init
        Wdg_43_Instance6_Service: can-enter-exclusive-area=[WDG_EXCLUSIVE_AREA_06, WDG_EXCLUSIVE_AREA_07, WDG_EXCLUSIVE_AREA_09], implemented-entry=Wdg_43_Instance6_Service
        Wdg_43_Instance6_SetMode: can-enter-exclusive-area=[WDG_EXCLUSIVE_AREA_03, WDG_EXCLUSIVE_AREA_04, WDG_EXCLUSIVE_AREA_06, WDG_EXCLUSIVE_AREA_07, WDG_EXCLUSIVE_AREA_10, WDG_EXCLUSIVE_AREA_11], implemented-entry=Wdg_43_Instance6_SetMode
        Wdg_43_Instance6_SetTriggerCondition: can-enter-exclusive-area=WDG_EXCLUSIVE_AREA_05, implemented-entry=Wdg_43_Instance6_SetTriggerCondition
        Wdg_43_Instance7_ClearResetRequest: can-enter-exclusive-area=WDG_EXCLUSIVE_AREA_08, implemented-entry=Wdg_43_Instance7_ClearResetRequest
        Wdg_43_Instance7_GetVersionInfo: implemented-entry=Wdg_43_Instance7_GetVersionInfo
        Wdg_43_Instance7_Init: can-enter-exclusive-area=[WDG_EXCLUSIVE_AREA_01, WDG_EXCLUSIVE_AREA_02, WDG_EXCLUSIVE_AREA_06, WDG_EXCLUSIVE_AREA_07], implemented-entry=Wdg_43_Instance7_Init
        Wdg_43_Instance7_Service: can-enter-exclusive-area=[WDG_EXCLUSIVE_AREA_06, WDG_EXCLUSIVE_AREA_07, WDG_EXCLUSIVE_AREA_09], implemented-entry=Wdg_43_Instance7_Service
        Wdg_43_Instance7_SetMode: can-enter-exclusive-area=[WDG_EXCLUSIVE_AREA_03, WDG_EXCLUSIVE_AREA_04, WDG_EXCLUSIVE_AREA_06, WDG_EXCLUSIVE_AREA_07, WDG_EXCLUSIVE_AREA_10, WDG_EXCLUSIVE_AREA_11], implemented-entry=Wdg_43_Instance7_SetMode
        Wdg_43_Instance7_SetTriggerCondition: can-enter-exclusive-area=WDG_EXCLUSIVE_AREA_05, implemented-entry=Wdg_43_Instance7_SetTriggerCondition
        Wdg_43_Instance8_ClearResetRequest: can-enter-exclusive-area=WDG_EXCLUSIVE_AREA_08, implemented-entry=Wdg_43_Instance8_ClearResetRequest
        Wdg_43_Instance8_GetVersionInfo: implemented-entry=Wdg_43_Instance8_GetVersionInfo
        Wdg_43_Instance8_Init: can-enter-exclusive-area=[WDG_EXCLUSIVE_AREA_01, WDG_EXCLUSIVE_AREA_02, WDG_EXCLUSIVE_AREA_06, WDG_EXCLUSIVE_AREA_07], implemented-entry=Wdg_43_Instance8_Init
        Wdg_43_Instance8_Service: can-enter-exclusive-area=[WDG_EXCLUSIVE_AREA_06, WDG_EXCLUSIVE_AREA_07, WDG_EXCLUSIVE_AREA_09], implemented-entry=Wdg_43_Instance8_Service
        Wdg_43_Instance8_SetMode: can-enter-exclusive-area=[WDG_EXCLUSIVE_AREA_03, WDG_EXCLUSIVE_AREA_04, WDG_EXCLUSIVE_AREA_06, WDG_EXCLUSIVE_AREA_07, WDG_EXCLUSIVE_AREA_10, WDG_EXCLUSIVE_AREA_11], implemented-entry=Wdg_43_Instance8_SetMode
        Wdg_43_Instance8_SetTriggerCondition: can-enter-exclusive-area=WDG_EXCLUSIVE_AREA_05, implemented-entry=Wdg_43_Instance8_SetTriggerCondition
        Wdg_43_Instance9_ClearResetRequest: can-enter-exclusive-area=WDG_EXCLUSIVE_AREA_08, implemented-entry=Wdg_43_Instance9_ClearResetRequest
        Wdg_43_Instance9_GetVersionInfo: implemented-entry=Wdg_43_Instance9_GetVersionInfo
        Wdg_43_Instance9_Init: can-enter-exclusive-area=[WDG_EXCLUSIVE_AREA_01, WDG_EXCLUSIVE_AREA_02, WDG_EXCLUSIVE_AREA_06, WDG_EXCLUSIVE_AREA_07], implemented-entry=Wdg_43_Instance9_Init
        Wdg_43_Instance9_Service: can-enter-exclusive-area=[WDG_EXCLUSIVE_AREA_06, WDG_EXCLUSIVE_AREA_07, WDG_EXCLUSIVE_AREA_09], implemented-entry=Wdg_43_Instance9_Service
        Wdg_43_Instance9_SetMode: can-enter-exclusive-area=[WDG_EXCLUSIVE_AREA_03, WDG_EXCLUSIVE_AREA_04, WDG_EXCLUSIVE_AREA_06, WDG_EXCLUSIVE_AREA_07, WDG_EXCLUSIVE_AREA_10, WDG_EXCLUSIVE_AREA_11], implemented-entry=Wdg_43_Instance9_SetMode
        Wdg_43_Instance9_SetTriggerCondition: can-enter-exclusive-area=WDG_EXCLUSIVE_AREA_05, implemented-entry=Wdg_43_Instance9_SetTriggerCondition
        Wdg_Cbk_GptNotification0: can-enter-exclusive-area=WDG_EXCLUSIVE_AREA_00, implemented-entry=Wdg_Cbk_GptNotification0
        Wdg_Cbk_GptNotification1: can-enter-exclusive-area=WDG_EXCLUSIVE_AREA_00, implemented-entry=Wdg_Cbk_GptNotification1
        Wdg_Cbk_GptNotification10: can-enter-exclusive-area=WDG_EXCLUSIVE_AREA_00, implemented-entry=Wdg_Cbk_GptNotification10
        Wdg_Cbk_GptNotification11: can-enter-exclusive-area=WDG_EXCLUSIVE_AREA_00, implemented-entry=Wdg_Cbk_GptNotification11
        Wdg_Cbk_GptNotification{2..9}: can-enter-exclusive-area=WDG_EXCLUSIVE_AREA_00, implemented-entry=Wdg_Cbk_GptNotification{2..9}
      12 x bsw interrupt entity, all with interrupt-category=CAT-2, interrupt-source=Hardware:
        Swt_Ip_Swt0_Isr: implemented-entry=Swt_Ip_Swt0_Isr
        Swt_Ip_Swt10_Isr: implemented-entry=Swt_Ip_Swt10_Isr
        Swt_Ip_Swt11_Isr: implemented-entry=Swt_Ip_Swt11_Isr
        Swt_Ip_Swt{1..9}_Isr: implemented-entry=Swt_Ip_Swt{1..9}_Isr
package /AUTOSAR_Wdg/BswModuleEntrys
  96 x bsw module entry, all with is-synchronous=true, sw-service-impl-policy=STANDARD:
    Wdg_43_Instance0_ClearResetRequest: service-id=0x06, is-reentrant=false, call-type=REGULAR, execution-context=UNSPECIFIED
    Wdg_43_Instance0_GetVersionInfo: service-id=0x04, is-reentrant=true, call-type=REGULAR, execution-context=UNSPECIFIED
    Wdg_43_Instance0_Init: service-id=0x00, is-reentrant=false, call-type=REGULAR, execution-context=UNSPECIFIED
    Wdg_43_Instance0_Service: service-id=0x05, is-reentrant=false, call-type=REGULAR, execution-context=UNSPECIFIED
    Wdg_43_Instance0_SetMode: service-id=0x01, is-reentrant=false, call-type=REGULAR, execution-context=UNSPECIFIED
    Wdg_43_Instance0_SetTriggerCondition: service-id=0x03, is-reentrant=false, call-type=REGULAR, execution-context=UNSPECIFIED
    Wdg_43_Instance10_ClearResetRequest: service-id=0x06, is-reentrant=false, call-type=REGULAR, execution-context=UNSPECIFIED
    Wdg_43_Instance10_GetVersionInfo: service-id=0x04, is-reentrant=true, call-type=REGULAR, execution-context=UNSPECIFIED
    Wdg_43_Instance10_Init: service-id=0x00, is-reentrant=false, call-type=REGULAR, execution-context=UNSPECIFIED
    Wdg_43_Instance10_Service: service-id=0x05, is-reentrant=false, call-type=REGULAR, execution-context=UNSPECIFIED
    Wdg_43_Instance10_SetMode: service-id=0x01, is-reentrant=false, call-type=REGULAR, execution-context=UNSPECIFIED
    Wdg_43_Instance10_SetTriggerCondition: service-id=0x03, is-reentrant=false, call-type=REGULAR, execution-context=UNSPECIFIED
    Wdg_43_Instance11_ClearResetRequest: service-id=0x06, is-reentrant=false, call-type=REGULAR, execution-context=UNSPECIFIED
    Wdg_43_Instance11_GetVersionInfo: service-id=0x04, is-reentrant=true, call-type=REGULAR, execution-context=UNSPECIFIED
    Wdg_43_Instance11_Init: service-id=0x00, is-reentrant=false, call-type=REGULAR, execution-context=UNSPECIFIED
    Wdg_43_Instance11_Service: service-id=0x05, is-reentrant=false, call-type=REGULAR, execution-context=UNSPECIFIED
    Wdg_43_Instance11_SetMode: service-id=0x01, is-reentrant=false, call-type=REGULAR, execution-context=UNSPECIFIED
    Wdg_43_Instance11_SetTriggerCondition: service-id=0x03, is-reentrant=false, call-type=REGULAR, execution-context=UNSPECIFIED
    Wdg_43_Instance1_ClearResetRequest: service-id=0x06, is-reentrant=false, call-type=REGULAR, execution-context=UNSPECIFIED
    Wdg_43_Instance1_GetVersionInfo: service-id=0x04, is-reentrant=true, call-type=REGULAR, execution-context=UNSPECIFIED
    Wdg_43_Instance1_Init: service-id=0x00, is-reentrant=false, call-type=REGULAR, execution-context=UNSPECIFIED
    Wdg_43_Instance1_Service: service-id=0x05, is-reentrant=false, call-type=REGULAR, execution-context=UNSPECIFIED
    Wdg_43_Instance1_SetMode: service-id=0x01, is-reentrant=false, call-type=REGULAR, execution-context=UNSPECIFIED
    Wdg_43_Instance1_SetTriggerCondition: service-id=0x03, is-reentrant=false, call-type=REGULAR, execution-context=UNSPECIFIED
    Wdg_43_Instance2_ClearResetRequest: service-id=0x06, is-reentrant=false, call-type=REGULAR, execution-context=UNSPECIFIED
    Wdg_43_Instance2_GetVersionInfo: service-id=0x04, is-reentrant=true, call-type=REGULAR, execution-context=UNSPECIFIED
    Wdg_43_Instance2_Init: service-id=0x00, is-reentrant=false, call-type=REGULAR, execution-context=UNSPECIFIED
    Wdg_43_Instance2_Service: service-id=0x05, is-reentrant=false, call-type=REGULAR, execution-context=UNSPECIFIED
    Wdg_43_Instance2_SetMode: service-id=0x01, is-reentrant=false, call-type=REGULAR, execution-context=UNSPECIFIED
    Wdg_43_Instance2_SetTriggerCondition: service-id=0x03, is-reentrant=false, call-type=REGULAR, execution-context=UNSPECIFIED
    Wdg_43_Instance3_ClearResetRequest: service-id=0x06, is-reentrant=false, call-type=REGULAR, execution-context=UNSPECIFIED
    Wdg_43_Instance3_GetVersionInfo: service-id=0x04, is-reentrant=true, call-type=REGULAR, execution-context=UNSPECIFIED
    Wdg_43_Instance3_Init: service-id=0x00, is-reentrant=false, call-type=REGULAR, execution-context=UNSPECIFIED
    Wdg_43_Instance3_Service: service-id=0x05, is-reentrant=false, call-type=REGULAR, execution-context=UNSPECIFIED
    Wdg_43_Instance3_SetMode: service-id=0x01, is-reentrant=false, call-type=REGULAR, execution-context=UNSPECIFIED
    Wdg_43_Instance3_SetTriggerCondition: service-id=0x03, is-reentrant=false, call-type=REGULAR, execution-context=UNSPECIFIED
    Wdg_43_Instance4_ClearResetRequest: service-id=0x06, is-reentrant=false, call-type=REGULAR, execution-context=UNSPECIFIED
    Wdg_43_Instance4_GetVersionInfo: service-id=0x04, is-reentrant=true, call-type=REGULAR, execution-context=UNSPECIFIED
    Wdg_43_Instance4_Init: service-id=0x00, is-reentrant=false, call-type=REGULAR, execution-context=UNSPECIFIED
    Wdg_43_Instance4_Service: service-id=0x05, is-reentrant=false, call-type=REGULAR, execution-context=UNSPECIFIED
    Wdg_43_Instance4_SetMode: service-id=0x01, is-reentrant=false, call-type=REGULAR, execution-context=UNSPECIFIED
    Wdg_43_Instance4_SetTriggerCondition: service-id=0x03, is-reentrant=false, call-type=REGULAR, execution-context=UNSPECIFIED
    Wdg_43_Instance5_ClearResetRequest: service-id=0x06, is-reentrant=false, call-type=REGULAR, execution-context=UNSPECIFIED
    Wdg_43_Instance5_GetVersionInfo: service-id=0x04, is-reentrant=true, call-type=REGULAR, execution-context=UNSPECIFIED
    Wdg_43_Instance5_Init: service-id=0x00, is-reentrant=false, call-type=REGULAR, execution-context=UNSPECIFIED
    Wdg_43_Instance5_Service: service-id=0x05, is-reentrant=false, call-type=REGULAR, execution-context=UNSPECIFIED
    Wdg_43_Instance5_SetMode: service-id=0x01, is-reentrant=false, call-type=REGULAR, execution-context=UNSPECIFIED
    Wdg_43_Instance5_SetTriggerCondition: service-id=0x03, is-reentrant=false, call-type=REGULAR, execution-context=UNSPECIFIED
    Wdg_43_Instance6_ClearResetRequest: service-id=0x06, is-reentrant=false, call-type=REGULAR, execution-context=UNSPECIFIED
    Wdg_43_Instance6_GetVersionInfo: service-id=0x04, is-reentrant=true, call-type=REGULAR, execution-context=UNSPECIFIED
    Wdg_43_Instance6_Init: service-id=0x00, is-reentrant=false, call-type=REGULAR, execution-context=UNSPECIFIED
    Wdg_43_Instance6_Service: service-id=0x05, is-reentrant=false, call-type=REGULAR, execution-context=UNSPECIFIED
    Wdg_43_Instance6_SetMode: service-id=0x01, is-reentrant=false, call-type=REGULAR, execution-context=UNSPECIFIED
    Wdg_43_Instance6_SetTriggerCondition: service-id=0x03, is-reentrant=false, call-type=REGULAR, execution-context=UNSPECIFIED
    Wdg_43_Instance7_ClearResetRequest: service-id=0x06, is-reentrant=false, call-type=REGULAR, execution-context=UNSPECIFIED
    Wdg_43_Instance7_GetVersionInfo: service-id=0x04, is-reentrant=true, call-type=REGULAR, execution-context=UNSPECIFIED
    Wdg_43_Instance7_Init: service-id=0x00, is-reentrant=false, call-type=REGULAR, execution-context=UNSPECIFIED
    Wdg_43_Instance7_Service: service-id=0x05, is-reentrant=false, call-type=REGULAR, execution-context=UNSPECIFIED
    Wdg_43_Instance7_SetMode: service-id=0x01, is-reentrant=false, call-type=REGULAR, execution-context=UNSPECIFIED
    Wdg_43_Instance7_SetTriggerCondition: service-id=0x03, is-reentrant=false, call-type=REGULAR, execution-context=UNSPECIFIED
    Wdg_43_Instance8_ClearResetRequest: service-id=0x06, is-reentrant=false, call-type=REGULAR, execution-context=UNSPECIFIED
    Wdg_43_Instance8_GetVersionInfo: service-id=0x04, is-reentrant=true, call-type=REGULAR, execution-context=UNSPECIFIED
    Wdg_43_Instance8_Init: service-id=0x00, is-reentrant=false, call-type=REGULAR, execution-context=UNSPECIFIED
    Wdg_43_Instance8_Service: service-id=0x05, is-reentrant=false, call-type=REGULAR, execution-context=UNSPECIFIED
    Wdg_43_Instance8_SetMode: service-id=0x01, is-reentrant=false, call-type=REGULAR, execution-context=UNSPECIFIED
    Wdg_43_Instance8_SetTriggerCondition: service-id=0x03, is-reentrant=false, call-type=REGULAR, execution-context=UNSPECIFIED
    Wdg_43_Instance9_ClearResetRequest: service-id=0x06, is-reentrant=false, call-type=REGULAR, execution-context=UNSPECIFIED
    Wdg_43_Instance9_GetVersionInfo: service-id=0x04, is-reentrant=true, call-type=REGULAR, execution-context=UNSPECIFIED
    Wdg_43_Instance9_Init: service-id=0x00, is-reentrant=false, call-type=REGULAR, execution-context=UNSPECIFIED
    Wdg_43_Instance9_Service: service-id=0x05, is-reentrant=false, call-type=REGULAR, execution-context=UNSPECIFIED
    Wdg_43_Instance9_SetMode: service-id=0x01, is-reentrant=false, call-type=REGULAR, execution-context=UNSPECIFIED
    Wdg_43_Instance9_SetTriggerCondition: service-id=0x03, is-reentrant=false, call-type=REGULAR, execution-context=UNSPECIFIED
    Wdg_Cbk_GptNotification0: service-id=0x02, is-reentrant=false, call-type=REGULAR, execution-context=UNSPECIFIED
    Wdg_Cbk_GptNotification1: service-id=0x02, is-reentrant=false, call-type=REGULAR, execution-context=UNSPECIFIED
    Wdg_Cbk_GptNotification10: service-id=0x02, is-reentrant=false, call-type=REGULAR, execution-context=UNSPECIFIED
    Wdg_Cbk_GptNotification11: service-id=0x02, is-reentrant=false, call-type=REGULAR, execution-context=UNSPECIFIED
    Wdg_Cbk_GptNotification{2..9}: service-id=0x02, is-reentrant=false, call-type=REGULAR, execution-context=UNSPECIFIED
    Swt_Ip_Swt0_Isr: service-id=0, is-reentrant=false, call-type=INTERRUPT, execution-context=INTERRUPT-CAT-2
    Swt_Ip_Swt10_Isr: service-id=0, is-reentrant=false, call-type=INTERRUPT, execution-context=INTERRUPT-CAT-2
    Swt_Ip_Swt11_Isr: service-id=0, is-reentrant=false, call-type=INTERRUPT, execution-context=INTERRUPT-CAT-2
    Swt_Ip_Swt{1..9}_Isr: service-id=0, is-reentrant=false, call-type=INTERRUPT, execution-context=INTERRUPT-CAT-2
package /Wdg_TS_T40D11M40I2R0/Implementations
  bsw implementation BswImplementation_0: programming-language=C, sw-version=4.0.2, vendor-id=43, ar-release-version=4.4.0, behavior=InternalBehavior_0, vendor-specific-module-def=Wdg
    code-descriptors:
      code Files
        artifact-descriptors:
          short-label=config::Wdg.xdm, category=SWCFG
          short-label=doc::RTD_WDG_IM.pdf, category=SWDOC
          short-label=doc::RTD_WDG_UM.pdf, category=SWDOC
          short-label=examples::EBT::S32G2::Wdg_Example_S32G274A_M7::generate::epc::BaseNXP.xdm, category=SWCFG
          short-label=examples::EBT::S32G2::Wdg_Example_S32G274A_M7::generate::epc::Dem.xdm, category=SWCFG
          short-label=examples::EBT::S32G2::Wdg_Example_S32G274A_M7::generate::epc::EcuC.xdm, category=SWCFG
          short-label=examples::EBT::S32G2::Wdg_Example_S32G274A_M7::generate::epc::Gpt.xdm, category=SWCFG
          short-label=examples::EBT::S32G2::Wdg_Example_S32G274A_M7::generate::epc::Mcu.xdm, category=SWCFG
          short-label=examples::EBT::S32G2::Wdg_Example_S32G274A_M7::generate::epc::Os.xdm, category=SWCFG
          short-label=examples::EBT::S32G2::Wdg_Example_S32G274A_M7::generate::epc::Platform.xdm, category=SWCFG
          short-label=examples::EBT::S32G2::Wdg_Example_S32G274A_M7::generate::epc::Resource.xdm, category=SWCFG
          short-label=examples::EBT::S32G2::Wdg_Example_S32G274A_M7::generate::epc::Wdg.xdm, category=SWCFG
          short-label=examples::EBT::S32G2::Wdg_Example_S32G274A_M7::include::check_example.h, category=SWHDR
          short-label=examples::EBT::S32G2::Wdg_Example_S32G274A_M7::src::main.c, category=SWSRC
          short-label=examples::EBT::S32G2::Wdg_Example_S32G274A_M7::TresosProject::Wdg_Example_S32G274A_M7::.prefs::preferences.xdm, category=SWCFG
          short-label=examples::EBT::S32G2::Wdg_Example_S32G274A_M7::TresosProject::Wdg_Example_S32G274A_M7::config::BaseNXP.xdm, category=SWCFG
          short-label=examples::EBT::S32G2::Wdg_Example_S32G274A_M7::TresosProject::Wdg_Example_S32G274A_M7::config::Dem.xdm, category=SWCFG
          short-label=examples::EBT::S32G2::Wdg_Example_S32G274A_M7::TresosProject::Wdg_Example_S32G274A_M7::config::EcuC.xdm, category=SWCFG
          short-label=examples::EBT::S32G2::Wdg_Example_S32G274A_M7::TresosProject::Wdg_Example_S32G274A_M7::config::Gpt.xdm, category=SWCFG
          short-label=examples::EBT::S32G2::Wdg_Example_S32G274A_M7::TresosProject::Wdg_Example_S32G274A_M7::config::Mcu.xdm, category=SWCFG
          short-label=examples::EBT::S32G2::Wdg_Example_S32G274A_M7::TresosProject::Wdg_Example_S32G274A_M7::config::Os.xdm, category=SWCFG
          short-label=examples::EBT::S32G2::Wdg_Example_S32G274A_M7::TresosProject::Wdg_Example_S32G274A_M7::config::Platform.xdm, category=SWCFG
          short-label=examples::EBT::S32G2::Wdg_Example_S32G274A_M7::TresosProject::Wdg_Example_S32G274A_M7::config::Resource.xdm, category=SWCFG
          short-label=examples::EBT::S32G2::Wdg_Example_S32G274A_M7::TresosProject::Wdg_Example_S32G274A_M7::config::Wdg.xdm, category=SWCFG
          short-label=examples::EBT::S32G3::Wdg_Example_S32G399A_M7::generate::epc::BaseNXP.xdm, category=SWCFG
          short-label=examples::EBT::S32G3::Wdg_Example_S32G399A_M7::generate::epc::Dem.xdm, category=SWCFG
          short-label=examples::EBT::S32G3::Wdg_Example_S32G399A_M7::generate::epc::EcuC.xdm, category=SWCFG
          short-label=examples::EBT::S32G3::Wdg_Example_S32G399A_M7::generate::epc::Gpt.xdm, category=SWCFG
          short-label=examples::EBT::S32G3::Wdg_Example_S32G399A_M7::generate::epc::Mcu.xdm, category=SWCFG
          short-label=examples::EBT::S32G3::Wdg_Example_S32G399A_M7::generate::epc::Os.xdm, category=SWCFG
          short-label=examples::EBT::S32G3::Wdg_Example_S32G399A_M7::generate::epc::Platform.xdm, category=SWCFG
          short-label=examples::EBT::S32G3::Wdg_Example_S32G399A_M7::generate::epc::Resource.xdm, category=SWCFG
          short-label=examples::EBT::S32G3::Wdg_Example_S32G399A_M7::generate::epc::Wdg.xdm, category=SWCFG
          short-label=examples::EBT::S32G3::Wdg_Example_S32G399A_M7::include::check_example.h, category=SWHDR
          short-label=examples::EBT::S32G3::Wdg_Example_S32G399A_M7::src::main.c, category=SWSRC
          short-label=examples::EBT::S32G3::Wdg_Example_S32G399A_M7::TresosProject::Wdg_Example_S32G399A_M7::.prefs::preferences.xdm, category=SWCFG
          short-label=examples::EBT::S32G3::Wdg_Example_S32G399A_M7::TresosProject::Wdg_Example_S32G399A_M7::config::BaseNXP.xdm, category=SWCFG
          short-label=examples::EBT::S32G3::Wdg_Example_S32G399A_M7::TresosProject::Wdg_Example_S32G399A_M7::config::Dem.xdm, category=SWCFG
          short-label=examples::EBT::S32G3::Wdg_Example_S32G399A_M7::TresosProject::Wdg_Example_S32G399A_M7::config::EcuC.xdm, category=SWCFG
          short-label=examples::EBT::S32G3::Wdg_Example_S32G399A_M7::TresosProject::Wdg_Example_S32G399A_M7::config::Gpt.xdm, category=SWCFG
          short-label=examples::EBT::S32G3::Wdg_Example_S32G399A_M7::TresosProject::Wdg_Example_S32G399A_M7::config::Mcu.xdm, category=SWCFG
          short-label=examples::EBT::S32G3::Wdg_Example_S32G399A_M7::TresosProject::Wdg_Example_S32G399A_M7::config::Os.xdm, category=SWCFG
          short-label=examples::EBT::S32G3::Wdg_Example_S32G399A_M7::TresosProject::Wdg_Example_S32G399A_M7::config::Platform.xdm, category=SWCFG
          short-label=examples::EBT::S32G3::Wdg_Example_S32G399A_M7::TresosProject::Wdg_Example_S32G399A_M7::config::Resource.xdm, category=SWCFG
          short-label=examples::EBT::S32G3::Wdg_Example_S32G399A_M7::TresosProject::Wdg_Example_S32G399A_M7::config::Wdg.xdm, category=SWCFG
          short-label=examples::EBT::S32R45::Wdg_Example_S32R45_M7::generate::epc::BaseNXP.xdm, category=SWCFG
          short-label=examples::EBT::S32R45::Wdg_Example_S32R45_M7::generate::epc::Dem.xdm, category=SWCFG
          short-label=examples::EBT::S32R45::Wdg_Example_S32R45_M7::generate::epc::EcuC.xdm, category=SWCFG
          short-label=examples::EBT::S32R45::Wdg_Example_S32R45_M7::generate::epc::Gpt.xdm, category=SWCFG
          short-label=examples::EBT::S32R45::Wdg_Example_S32R45_M7::generate::epc::Mcu.xdm, category=SWCFG
          short-label=examples::EBT::S32R45::Wdg_Example_S32R45_M7::generate::epc::Os.xdm, category=SWCFG
          short-label=examples::EBT::S32R45::Wdg_Example_S32R45_M7::generate::epc::Platform.xdm, category=SWCFG
          short-label=examples::EBT::S32R45::Wdg_Example_S32R45_M7::generate::epc::Resource.xdm, category=SWCFG
          short-label=examples::EBT::S32R45::Wdg_Example_S32R45_M7::generate::epc::Wdg.xdm, category=SWCFG
          short-label=examples::EBT::S32R45::Wdg_Example_S32R45_M7::include::check_example.h, category=SWHDR
          short-label=examples::EBT::S32R45::Wdg_Example_S32R45_M7::src::main.c, category=SWSRC
          short-label=examples::EBT::S32R45::Wdg_Example_S32R45_M7::TresosProject::Wdg_Example_S32R45_M7::.prefs::preferences.xdm, category=SWCFG
          short-label=examples::EBT::S32R45::Wdg_Example_S32R45_M7::TresosProject::Wdg_Example_S32R45_M7::config::BaseNXP.xdm, category=SWCFG
          short-label=examples::EBT::S32R45::Wdg_Example_S32R45_M7::TresosProject::Wdg_Example_S32R45_M7::config::Dem.xdm, category=SWCFG
          short-label=examples::EBT::S32R45::Wdg_Example_S32R45_M7::TresosProject::Wdg_Example_S32R45_M7::config::EcuC.xdm, category=SWCFG
          short-label=examples::EBT::S32R45::Wdg_Example_S32R45_M7::TresosProject::Wdg_Example_S32R45_M7::config::Gpt.xdm, category=SWCFG
          short-label=examples::EBT::S32R45::Wdg_Example_S32R45_M7::TresosProject::Wdg_Example_S32R45_M7::config::Mcu.xdm, category=SWCFG
          short-label=examples::EBT::S32R45::Wdg_Example_S32R45_M7::TresosProject::Wdg_Example_S32R45_M7::config::Os.xdm, category=SWCFG
          short-label=examples::EBT::S32R45::Wdg_Example_S32R45_M7::TresosProject::Wdg_Example_S32R45_M7::config::Platform.xdm, category=SWCFG
          short-label=examples::EBT::S32R45::Wdg_Example_S32R45_M7::TresosProject::Wdg_Example_S32R45_M7::config::Resource.xdm, category=SWCFG
          short-label=examples::EBT::S32R45::Wdg_Example_S32R45_M7::TresosProject::Wdg_Example_S32R45_M7::config::Wdg.xdm, category=SWCFG
          short-label=examples::S32DS::S32G2::Swt_Ip_Example_S32G274A_M7::include::check_example.h, category=SWHDR
          short-label=examples::S32DS::S32G2::Swt_Ip_Example_S32G274A_M7::Project_Settings::Startup_Code::exceptions.c, category=SWSRC
          short-label=examples::S32DS::S32G2::Swt_Ip_Example_S32G274A_M7::Project_Settings::Startup_Code::nvic.c, category=SWSRC
          short-label=examples::S32DS::S32G2::Swt_Ip_Example_S32G274A_M7::Project_Settings::Startup_Code::startup.c, category=SWSRC
          short-label=examples::S32DS::S32G2::Swt_Ip_Example_S32G274A_M7::Project_Settings::Startup_Code::system.c, category=SWSRC
          short-label=examples::S32DS::S32G2::Swt_Ip_Example_S32G274A_M7::src::main.c, category=SWSRC
          short-label=examples::S32DS::S32G2::Wdg_Example_S32G274A_M7::include::check_example.h, category=SWHDR
          short-label=examples::S32DS::S32G2::Wdg_Example_S32G274A_M7::Project_Settings::Startup_Code::exceptions.c, category=SWSRC
          short-label=examples::S32DS::S32G2::Wdg_Example_S32G274A_M7::Project_Settings::Startup_Code::nvic.c, category=SWSRC
          short-label=examples::S32DS::S32G2::Wdg_Example_S32G274A_M7::Project_Settings::Startup_Code::startup.c, category=SWSRC
          short-label=examples::S32DS::S32G2::Wdg_Example_S32G274A_M7::Project_Settings::Startup_Code::system.c, category=SWSRC
          short-label=examples::S32DS::S32G2::Wdg_Example_S32G274A_M7::src::main.c, category=SWSRC
          short-label=examples::S32DS::S32G3::Swt_Ip_Example_S32G399A_M7::include::check_example.h, category=SWHDR
          short-label=examples::S32DS::S32G3::Swt_Ip_Example_S32G399A_M7::Project_Settings::Startup_Code::exceptions.c, category=SWSRC
          short-label=examples::S32DS::S32G3::Swt_Ip_Example_S32G399A_M7::Project_Settings::Startup_Code::nvic.c, category=SWSRC
          short-label=examples::S32DS::S32G3::Swt_Ip_Example_S32G399A_M7::Project_Settings::Startup_Code::startup.c, category=SWSRC
          short-label=examples::S32DS::S32G3::Swt_Ip_Example_S32G399A_M7::Project_Settings::Startup_Code::system.c, category=SWSRC
          short-label=examples::S32DS::S32G3::Swt_Ip_Example_S32G399A_M7::src::main.c, category=SWSRC
          short-label=examples::S32DS::S32G3::Wdg_Example_S32G399A_M7::include::check_example.h, category=SWHDR
          short-label=examples::S32DS::S32G3::Wdg_Example_S32G399A_M7::Project_Settings::Startup_Code::exceptions.c, category=SWSRC
          short-label=examples::S32DS::S32G3::Wdg_Example_S32G399A_M7::Project_Settings::Startup_Code::nvic.c, category=SWSRC
          short-label=examples::S32DS::S32G3::Wdg_Example_S32G399A_M7::Project_Settings::Startup_Code::startup.c, category=SWSRC
          short-label=examples::S32DS::S32G3::Wdg_Example_S32G399A_M7::Project_Settings::Startup_Code::system.c, category=SWSRC
          short-label=examples::S32DS::S32G3::Wdg_Example_S32G399A_M7::src::main.c, category=SWSRC
          short-label=examples::S32DS::S32R45::Swt_Ip_Example_S32R45_M7::include::check_example.h, category=SWHDR
          short-label=examples::S32DS::S32R45::Swt_Ip_Example_S32R45_M7::Project_Settings::Startup_Code::exceptions.c, category=SWSRC
          short-label=examples::S32DS::S32R45::Swt_Ip_Example_S32R45_M7::Project_Settings::Startup_Code::nvic.c, category=SWSRC
          short-label=examples::S32DS::S32R45::Swt_Ip_Example_S32R45_M7::Project_Settings::Startup_Code::startup.c, category=SWSRC
          short-label=examples::S32DS::S32R45::Swt_Ip_Example_S32R45_M7::Project_Settings::Startup_Code::system.c, category=SWSRC
          short-label=examples::S32DS::S32R45::Swt_Ip_Example_S32R45_M7::src::main.c, category=SWSRC
          short-label=examples::S32DS::S32R45::Wdg_Example_S32R45_M7::include::check_example.h, category=SWHDR
          short-label=examples::S32DS::S32R45::Wdg_Example_S32R45_M7::Project_Settings::Startup_Code::exceptions.c, category=SWSRC
          short-label=examples::S32DS::S32R45::Wdg_Example_S32R45_M7::Project_Settings::Startup_Code::nvic.c, category=SWSRC
          short-label=examples::S32DS::S32R45::Wdg_Example_S32R45_M7::Project_Settings::Startup_Code::startup.c, category=SWSRC
          short-label=examples::S32DS::S32R45::Wdg_Example_S32R45_M7::Project_Settings::Startup_Code::system.c, category=SWSRC
          short-label=examples::S32DS::S32R45::Wdg_Example_S32R45_M7::src::main.c, category=SWSRC
          short-label=include::Swt_Ip.h, category=SWHDR
          short-label=include::Swt_Ip_FeatureDefines.h, category=SWHDR
          short-label=include::Swt_Ip_Irq.h, category=SWHDR
          short-label=include::Swt_Ip_Types.h, category=SWHDR
          short-label=include::Wdg_43_Instance0.h, category=SWHDR
          short-label=include::Wdg_43_Instance1.h, category=SWHDR
          short-label=include::Wdg_43_Instance10.h, category=SWHDR
          short-label=include::Wdg_43_Instance11.h, category=SWHDR
          short-label=include::Wdg_43_Instance{2..9}.h, category=SWHDR
          short-label=include::Wdg_Channel.h, category=SWHDR
          short-label=include::Wdg_ChannelTypes.h, category=SWHDR
          short-label=include::Wdg_EnvCfg.h, category=SWHDR
          short-label=include::Wdg_Ipw.h, category=SWHDR
          short-label=include::Wdg_Ipw_Types.h, category=SWHDR
          short-label=src::Swt_Ip.c, category=SWSRC
          short-label=src::Swt_Ip_Irq.c, category=SWSRC
          short-label=src::Wdg_43_Instance0.c, category=SWSRC
          short-label=src::Wdg_43_Instance1.c, category=SWSRC
          short-label=src::Wdg_43_Instance10.c, category=SWSRC
          short-label=src::Wdg_43_Instance11.c, category=SWSRC
          short-label=src::Wdg_43_Instance{2..9}.c, category=SWSRC
          short-label=src::Wdg_Channel.c, category=SWSRC
          short-label=src::Wdg_Ipw.c, category=SWSRC
    compiler DIAB_Compiler:
      name=Windriver Diab
      options=-tARMCORTEXM7MG:simple -mthumb -std=c99 -Oz -g -fstandalone-debug -Wstrict-prototypes -Wsign-compare -Wdouble-promotion -Wunknown-pragmas -Wundef -Wextra -Wall -pedantic -Werror=implicit-function-declaration -fno-common -fno-signed-char -fno-trigraphs -V -c -DS32XX -DS32G2XX -DS32G3XX -DS32R45 -DDIAB -DUSE_SW_VECTOR_MODE -DD_CACHE_ENABLE -DI_CACHE_ENABLE -DENABLE_FPU -DMCAL_ENABLE_USER_MODE_SUPPORT
      vendor=Windriver
      version=DIAB_7_0_3_0-FCS_20200409_160912
    compiler GCC_Compiler:
      name=GCC Compiler
      options=-mcpu=cortex-m7 -mthumb -mlittle-endian -mfpu=fpv5-sp-d16 -mfloat-abi=hard -std=c99 -Os -ggdb3 -Wall -Wextra -pedantic -Wstrict-prototypes -Wundef -Wunused -Werror=implicit-function-declaration -Wsign-compare -Wdouble-promotion -fno-short-enums -funsigned-char -funsigned-bitfields -fomit-frame-pointer -fno-common -fstack-usage -fdump-ipa-all -c -DS32XX -DS32G2XX -DS32G3XX -DS32R45 -DGCC -DUSE_SW_VECTOR_MODE -DD_CACHE_ENABLE -DI_CACHE_ENABLE -DENABLE_FPU -DMCAL_ENABLE_USER_MODE_SUPPORT
      vendor=GCC Systems
      version=NXP GCC 9.2.0 20190812 (Build 1649 Revision gaf57174)
    compiler GHS_Compiler:
      name=Green Hills
      options=-cpu=cortexm7 -thumb -fpu=vfpv5_d16 -fsingle -C99 --ghstd=last -Osize --gnu_asm -dual_debug -G -keeptempfiles -Wimplicit-int -Wshadow -Wtrigraphs -Wundef --unsigned_chars --unsigned_fields --no_commons --no_exceptions --no_slash_comment --prototype_errors --incorrect_pragma_warnings -c -DS32XX -DS32G2XX -DS32G3XX -DS32R45 -DGHS -DUSE_SW_VECTOR_MODE -DD_CACHE_ENABLE -DI_CACHE_ENABLE -DENABLE_FPU -DMCAL_ENABLE_USER_MODE_SUPPORT
      vendor=Green Hills
      version=Green Hills Multi 7.1.6d / Compiler 2020.1.4
    generated-artifacts:
      103 x dependency on artifact:
        Swt_Ip_Cfg_Defines_h: artifact-descriptor={short-label=generate::include::Swt_Ip_Cfg_Defines.h, category=SWHDR}, usages=COMPILE
        Swt_Ip_DeviceRegisters_h: artifact-descriptor={short-label=generate::include::Swt_Ip_DeviceRegisters.h, category=SWHDR}, usages=COMPILE
        Wdg_Cfg_h: artifact-descriptor={short-label=generate::include::Wdg_Cfg.h, category=SWHDR}, usages=COMPILE
        Wdg_CfgExt_h: artifact-descriptor={short-label=generate::include::Wdg_CfgExt.h, category=SWHDR}, usages=COMPILE
        Wdg_Cfg_Defines_h: artifact-descriptor={short-label=generate::include::Wdg_Cfg_Defines.h, category=SWHDR}, usages=COMPILE
        Wdg_Ipw_Cfg_Defines_h: artifact-descriptor={short-label=generate::include::Wdg_Ipw_Cfg_Defines.h, category=SWHDR}, usages=COMPILE
        Wdg_CfgExt_c: artifact-descriptor={short-label=generate::src::Wdg_CfgExt.c, category=SWSRC}, usages=COMPILE
        Wdg_43_Instance0_Lcfg_c: artifact-descriptor={short-label=generate_LT::src::Wdg_43_Instance0_Lcfg.c, category=SWSRC}, usages=LINK
        Wdg_43_Instance10_Lcfg_c: artifact-descriptor={short-label=generate_LT::src::Wdg_43_Instance10_Lcfg.c, category=SWSRC}, usages=LINK
        Wdg_43_Instance11_Lcfg_c: artifact-descriptor={short-label=generate_LT::src::Wdg_43_Instance11_Lcfg.c, category=SWSRC}, usages=LINK
        Wdg_43_Instance{1..9}_Lcfg_c: artifact-descriptor={short-label=generate_LT::src::Wdg_43_Instance{1..9}_Lcfg.c, category=SWSRC}, usages=LINK
        Swt_43_Instance0_Ip_PBcfg_h: artifact-descriptor={short-label=generate_PB::include::Swt_43_Instance0_Ip_PBcfg.h, category=SWHDR}, usages=EXECUTE
        Swt_43_Instance10_Ip_PBcfg_h: artifact-descriptor={short-label=generate_PB::include::Swt_43_Instance10_Ip_PBcfg.h, category=SWHDR}, usages=EXECUTE
        Swt_43_Instance11_Ip_PBcfg_h: artifact-descriptor={short-label=generate_PB::include::Swt_43_Instance11_Ip_PBcfg.h, category=SWHDR}, usages=EXECUTE
        Swt_43_Instance{1..9}_Ip_PBcfg_h: artifact-descriptor={short-label=generate_PB::include::Swt_43_Instance{1..9}_Ip_PBcfg.h, category=SWHDR}, usages=EXECUTE
        Wdg_43_Instance0_Ipw_PBcfg_h: artifact-descriptor={short-label=generate_PB::include::Wdg_43_Instance0_Ipw_PBcfg.h, category=SWHDR}, usages=EXECUTE
        Wdg_43_Instance0_PBcfg_h: artifact-descriptor={short-label=generate_PB::include::Wdg_43_Instance0_PBcfg.h, category=SWHDR}, usages=EXECUTE
        Wdg_43_Instance10_Ipw_PBcfg_h: artifact-descriptor={short-label=generate_PB::include::Wdg_43_Instance10_Ipw_PBcfg.h, category=SWHDR}, usages=EXECUTE
        Wdg_43_Instance10_PBcfg_h: artifact-descriptor={short-label=generate_PB::include::Wdg_43_Instance10_PBcfg.h, category=SWHDR}, usages=EXECUTE
        Wdg_43_Instance11_Ipw_PBcfg_h: artifact-descriptor={short-label=generate_PB::include::Wdg_43_Instance11_Ipw_PBcfg.h, category=SWHDR}, usages=EXECUTE
        Wdg_43_Instance11_PBcfg_h: artifact-descriptor={short-label=generate_PB::include::Wdg_43_Instance11_PBcfg.h, category=SWHDR}, usages=EXECUTE
        Wdg_43_Instance1_Ipw_PBcfg_h: artifact-descriptor={short-label=generate_PB::include::Wdg_43_Instance1_Ipw_PBcfg.h, category=SWHDR}, usages=EXECUTE
        Wdg_43_Instance1_PBcfg_h: artifact-descriptor={short-label=generate_PB::include::Wdg_43_Instance1_PBcfg.h, category=SWHDR}, usages=EXECUTE
        Wdg_43_Instance2_Ipw_PBcfg_h: artifact-descriptor={short-label=generate_PB::include::Wdg_43_Instance2_Ipw_PBcfg.h, category=SWHDR}, usages=EXECUTE
        Wdg_43_Instance2_PBcfg_h: artifact-descriptor={short-label=generate_PB::include::Wdg_43_Instance2_PBcfg.h, category=SWHDR}, usages=EXECUTE
        Wdg_43_Instance3_Ipw_PBcfg_h: artifact-descriptor={short-label=generate_PB::include::Wdg_43_Instance3_Ipw_PBcfg.h, category=SWHDR}, usages=EXECUTE
        Wdg_43_Instance3_PBcfg_h: artifact-descriptor={short-label=generate_PB::include::Wdg_43_Instance3_PBcfg.h, category=SWHDR}, usages=EXECUTE
        Wdg_43_Instance4_Ipw_PBcfg_h: artifact-descriptor={short-label=generate_PB::include::Wdg_43_Instance4_Ipw_PBcfg.h, category=SWHDR}, usages=EXECUTE
        Wdg_43_Instance4_PBcfg_h: artifact-descriptor={short-label=generate_PB::include::Wdg_43_Instance4_PBcfg.h, category=SWHDR}, usages=EXECUTE
        Wdg_43_Instance5_Ipw_PBcfg_h: artifact-descriptor={short-label=generate_PB::include::Wdg_43_Instance5_Ipw_PBcfg.h, category=SWHDR}, usages=EXECUTE
        Wdg_43_Instance5_PBcfg_h: artifact-descriptor={short-label=generate_PB::include::Wdg_43_Instance5_PBcfg.h, category=SWHDR}, usages=EXECUTE
        Wdg_43_Instance6_Ipw_PBcfg_h: artifact-descriptor={short-label=generate_PB::include::Wdg_43_Instance6_Ipw_PBcfg.h, category=SWHDR}, usages=EXECUTE
        Wdg_43_Instance6_PBcfg_h: artifact-descriptor={short-label=generate_PB::include::Wdg_43_Instance6_PBcfg.h, category=SWHDR}, usages=EXECUTE
        Wdg_43_Instance7_Ipw_PBcfg_h: artifact-descriptor={short-label=generate_PB::include::Wdg_43_Instance7_Ipw_PBcfg.h, category=SWHDR}, usages=EXECUTE
        Wdg_43_Instance7_PBcfg_h: artifact-descriptor={short-label=generate_PB::include::Wdg_43_Instance7_PBcfg.h, category=SWHDR}, usages=EXECUTE
        Wdg_43_Instance8_Ipw_PBcfg_h: artifact-descriptor={short-label=generate_PB::include::Wdg_43_Instance8_Ipw_PBcfg.h, category=SWHDR}, usages=EXECUTE
        Wdg_43_Instance8_PBcfg_h: artifact-descriptor={short-label=generate_PB::include::Wdg_43_Instance8_PBcfg.h, category=SWHDR}, usages=EXECUTE
        Wdg_43_Instance9_Ipw_PBcfg_h: artifact-descriptor={short-label=generate_PB::include::Wdg_43_Instance9_Ipw_PBcfg.h, category=SWHDR}, usages=EXECUTE
        Wdg_43_Instance9_PBcfg_h: artifact-descriptor={short-label=generate_PB::include::Wdg_43_Instance9_PBcfg.h, category=SWHDR}, usages=EXECUTE
        Swt_43_Instance0_Ip_PBcfg_c: artifact-descriptor={short-label=generate_PB::src::Swt_43_Instance0_Ip_PBcfg.c, category=SWSRC}, usages=EXECUTE
        Swt_43_Instance10_Ip_PBcfg_c: artifact-descriptor={short-label=generate_PB::src::Swt_43_Instance10_Ip_PBcfg.c, category=SWSRC}, usages=EXECUTE
        Swt_43_Instance11_Ip_PBcfg_c: artifact-descriptor={short-label=generate_PB::src::Swt_43_Instance11_Ip_PBcfg.c, category=SWSRC}, usages=EXECUTE
        Swt_43_Instance{1..9}_Ip_PBcfg_c: artifact-descriptor={short-label=generate_PB::src::Swt_43_Instance{1..9}_Ip_PBcfg.c, category=SWSRC}, usages=EXECUTE
        Wdg_43_Instance0_Ipw_PBcfg_c: artifact-descriptor={short-label=generate_PB::src::Wdg_43_Instance0_Ipw_PBcfg.c, category=SWSRC}, usages=EXECUTE
        Wdg_43_Instance0_PBcfg_c: artifact-descriptor={short-label=generate_PB::src::Wdg_43_Instance0_PBcfg.c, category=SWSRC}, usages=EXECUTE
        Wdg_43_Instance10_Ipw_PBcfg_c: artifact-descriptor={short-label=generate_PB::src::Wdg_43_Instance10_Ipw_PBcfg.c, category=SWSRC}, usages=EXECUTE
        Wdg_43_Instance10_PBcfg_c: artifact-descriptor={short-label=generate_PB::src::Wdg_43_Instance10_PBcfg.c, category=SWSRC}, usages=EXECUTE
        Wdg_43_Instance11_Ipw_PBcfg_c: artifact-descriptor={short-label=generate_PB::src::Wdg_43_Instance11_Ipw_PBcfg.c, category=SWSRC}, usages=EXECUTE
        Wdg_43_Instance11_PBcfg_c: artifact-descriptor={short-label=generate_PB::src::Wdg_43_Instance11_PBcfg.c, category=SWSRC}, usages=EXECUTE
        Wdg_43_Instance1_Ipw_PBcfg_c: artifact-descriptor={short-label=generate_PB::src::Wdg_43_Instance1_Ipw_PBcfg.c, category=SWSRC}, usages=EXECUTE
        Wdg_43_Instance1_PBcfg_c: artifact-descriptor={short-label=generate_PB::src::Wdg_43_Instance1_PBcfg.c, category=SWSRC}, usages=EXECUTE
        Wdg_43_Instance2_Ipw_PBcfg_c: artifact-descriptor={short-label=generate_PB::src::Wdg_43_Instance2_Ipw_PBcfg.c, category=SWSRC}, usages=EXECUTE
        Wdg_43_Instance2_PBcfg_c: artifact-descriptor={short-label=generate_PB::src::Wdg_43_Instance2_PBcfg.c, category=SWSRC}, usages=EXECUTE
        Wdg_43_Instance3_Ipw_PBcfg_c: artifact-descriptor={short-label=generate_PB::src::Wdg_43_Instance3_Ipw_PBcfg.c, category=SWSRC}, usages=EXECUTE
        Wdg_43_Instance3_PBcfg_c: artifact-descriptor={short-label=generate_PB::src::Wdg_43_Instance3_PBcfg.c, category=SWSRC}, usages=EXECUTE
        Wdg_43_Instance4_Ipw_PBcfg_c: artifact-descriptor={short-label=generate_PB::src::Wdg_43_Instance4_Ipw_PBcfg.c, category=SWSRC}, usages=EXECUTE
        Wdg_43_Instance4_PBcfg_c: artifact-descriptor={short-label=generate_PB::src::Wdg_43_Instance4_PBcfg.c, category=SWSRC}, usages=EXECUTE
        Wdg_43_Instance5_Ipw_PBcfg_c: artifact-descriptor={short-label=generate_PB::src::Wdg_43_Instance5_Ipw_PBcfg.c, category=SWSRC}, usages=EXECUTE
        Wdg_43_Instance5_PBcfg_c: artifact-descriptor={short-label=generate_PB::src::Wdg_43_Instance5_PBcfg.c, category=SWSRC}, usages=EXECUTE
        Wdg_43_Instance6_Ipw_PBcfg_c: artifact-descriptor={short-label=generate_PB::src::Wdg_43_Instance6_Ipw_PBcfg.c, category=SWSRC}, usages=EXECUTE
        Wdg_43_Instance6_PBcfg_c: artifact-descriptor={short-label=generate_PB::src::Wdg_43_Instance6_PBcfg.c, category=SWSRC}, usages=EXECUTE
        Wdg_43_Instance7_Ipw_PBcfg_c: artifact-descriptor={short-label=generate_PB::src::Wdg_43_Instance7_Ipw_PBcfg.c, category=SWSRC}, usages=EXECUTE
        Wdg_43_Instance7_PBcfg_c: artifact-descriptor={short-label=generate_PB::src::Wdg_43_Instance7_PBcfg.c, category=SWSRC}, usages=EXECUTE
        Wdg_43_Instance8_Ipw_PBcfg_c: artifact-descriptor={short-label=generate_PB::src::Wdg_43_Instance8_Ipw_PBcfg.c, category=SWSRC}, usages=EXECUTE
        Wdg_43_Instance8_PBcfg_c: artifact-descriptor={short-label=generate_PB::src::Wdg_43_Instance8_PBcfg.c, category=SWSRC}, usages=EXECUTE
        Wdg_43_Instance9_Ipw_PBcfg_c: artifact-descriptor={short-label=generate_PB::src::Wdg_43_Instance9_Ipw_PBcfg.c, category=SWSRC}, usages=EXECUTE
        Wdg_43_Instance9_PBcfg_c: artifact-descriptor={short-label=generate_PB::src::Wdg_43_Instance9_PBcfg.c, category=SWSRC}, usages=EXECUTE
        Wdg_43_Instance0_Cfg_c: artifact-descriptor={short-label=generate_PC::src::Wdg_43_Instance0_Cfg.c, category=SWSRC}, usages=COMPILE
        Wdg_43_Instance10_Cfg_c: artifact-descriptor={short-label=generate_PC::src::Wdg_43_Instance10_Cfg.c, category=SWSRC}, usages=COMPILE
        Wdg_43_Instance11_Cfg_c: artifact-descriptor={short-label=generate_PC::src::Wdg_43_Instance11_Cfg.c, category=SWSRC}, usages=COMPILE
        Wdg_43_Instance{1..9}_Cfg_c: artifact-descriptor={short-label=generate_PC::src::Wdg_43_Instance{1..9}_Cfg.c, category=SWSRC}, usages=COMPILE
    linker DIAB_Linker: name=Windriver Diab, options=-e Reset_Handler linker_script_file.dld -m30 -Xstack-usage -Xpreprocess-lecl -Llibrary_path -lc -lm, vendor=Windriver, version=DIAB_7_0_3_0-FCS_20200409_160912
    linker GCC_Linker: name=GCC Compiler, options=-Wl,-Map,filename -T linkerfile --entry=Reset_Handler -nostartfiles -mcpu=cortexm7 -mthumb -mfpu=fpv5-sp-d16 -mfloat-abi=hard -mlittle-endian -ggdb3 -lc -lm -lgcc, vendor=GCC Systems, version=NXP GCC 9.2.0 20190812 (Build 1649 Revision gaf57174)
    linker GHS_Linker: name=Green Hills, options=-e Reset_Handler -T linker_script_file.ld -map -keepmap -Mn -delete -ignore_debug_references -Llibrary_path -larch -lstartup -lind_sd -v -nostartfiles, vendor=Green Hills, version=Green Hills Multi 7.1.6d / Compiler 2020.1.4
    resource consumption ResourceConsumption
      10 x memory section:
        WDG_CODE: alignment=UNSPECIFIED, sw-addrmethod=CODE, symbol=CODE
        WDG_CONFIG_DATA_16: alignment=16, sw-addrmethod=CONFIG_DATA, symbol=CONFIG_DATA_16
        WDG_CONFIG_DATA_32: alignment=32, sw-addrmethod=CONFIG_DATA, symbol=CONFIG_DATA_32
        WDG_CONFIG_DATA_UNSPECIFIED: alignment=UNSPECIFIED, sw-addrmethod=CONFIG_DATA, symbol=CONFIG_DATA_UNSPECIFIED
        WDG_CONST_UNSPECIFIED: alignment=UNSPECIFIED, sw-addrmethod=CONST, symbol=CONST_UNSPECIFIED
        WDG_RAMCODE: alignment=UNSPECIFIED, sw-addrmethod=RAMCODE, symbol=RAMCODE
        WDG_VAR_CLEARED_32: alignment=32, sw-addrmethod=VAR_CLEARED, symbol=VAR_CLEARED_32
        WDG_VAR_CLEARED_BOOLEAN: alignment=BOOLEAN, sw-addrmethod=VAR_CLEARED, symbol=VAR_CLEARED_BOOLEAN
        WDG_VAR_CLEARED_UNSPECIFIED: alignment=UNSPECIFIED, sw-addrmethod=VAR_CLEARED, symbol=VAR_CLEARED_UNSPECIFIED
        WDG_VAR_INIT_UNSPECIFIED: alignment=UNSPECIFIED, sw-addrmethod=VAR_INIT, symbol=VAR_INIT_UNSPECIFIED
