AUTOSAR XML (schema 00046)
package /AUTOSAR_Lin/BswModuleDescriptions
  bsw module description Lin: module-id=82
    provided-entrys:
      Lin_CheckWakeup
      Lin_GetStatus
      Lin_GetVersionInfo
      Lin_GoToSleep
      Lin_GoToSleepInternal
      Lin_Init
      Lin_SendFrame
      Lin_SetClockMode
      Lin_Wakeup
      Lin_WakeupInternal
      Linflexd_Lin_Ip_SetBaudrate
      LIN_LINFLEXD{0..2}_IRQHandler
    bsw internal behavior InternalBehavior_0
      7 x exclusive area:
        LIN_EXCLUSIVE_AREA_00
        LIN_EXCLUSIVE_AREA_{02..07}
      11 x bsw called entity:
        Lin_CheckWakeup: implemented-entry=Lin_CheckWakeup
        Lin_GetStatus: implemented-entry=Lin_GetStatus
        Lin_GetVersionInfo: implemented-entry=Lin_GetVersionInfo
        Lin_GoToSleep: can-enter-exclusive-area=[LIN_EXCLUSIVE_AREA_02, LIN_EXCLUSIVE_AREA_06], implemented-entry=Lin_GoToSleep
        Lin_GoToSleepInternal: can-enter-exclusive-area=[LIN_EXCLUSIVE_AREA_02, LIN_EXCLUSIVE_AREA_03], implemented-entry=Lin_GoToSleepInternal
        Lin_Init: can-enter-exclusive-area=LIN_EXCLUSIVE_AREA_03, implemented-entry=Lin_Init
        Lin_SendFrame: can-enter-exclusive-area=[LIN_EXCLUSIVE_AREA_02, LIN_EXCLUSIVE_AREA_06], implemented-entry=Lin_SendFrame
        Lin_SetClockMode: can-enter-exclusive-area=LIN_EXCLUSIVE_AREA_00, implemented-entry=Lin_SetClockMode
        Lin_Wakeup: can-enter-exclusive-area=[LIN_EXCLUSIVE_AREA_04, LIN_EXCLUSIVE_AREA_05], implemented-entry=Lin_Wakeup
        Lin_WakeupInternal: can-enter-exclusive-area=LIN_EXCLUSIVE_AREA_04, implemented-entry=Lin_WakeupInternal
        Linflexd_Lin_Ip_SetBaudrate: can-enter-exclusive-area=LIN_EXCLUSIVE_AREA_00, implemented-entry=Linflexd_Lin_Ip_SetBaudrate
      bsw interrupt entity LIN_LINFLEXD{0..2}_IRQHandler: can-enter-exclusive-area=LIN_EXCLUSIVE_AREA_07, implemented-entry=LIN_LINFLEXD{0..2}_IRQHandler, interrupt-category=CAT-2, interrupt-source=Hardware
package /AUTOSAR_Lin/BswModuleEntrys
  14 x bsw module entry, all with sw-service-impl-policy=STANDARD:
    Lin_CheckWakeup: service-id=0x0a, is-reentrant=false, is-synchronous=true, call-type=REGULAR, execution-context=UNSPECIFIED
    Lin_GetStatus: service-id=0x08, is-reentrant=false, is-synchronous=true, call-type=REGULAR, execution-context=UNSPECIFIED
    Lin_GetVersionInfo: service-id=0x01, is-reentrant=true, is-synchronous=true, call-type=REGULAR, execution-context=UNSPECIFIED
    Lin_GoToSleep: service-id=0x06, is-reentrant=false, is-synchronous=false, call-type=REGULAR, execution-context=UNSPECIFIED
    Lin_GoToSleepInternal: service-id=0x09, is-reentrant=false, is-synchronous=true, call-type=REGULAR, execution-context=UNSPECIFIED
    Lin_Init: service-id=0x00, is-reentrant=false, is-synchronous=true, call-type=REGULAR, execution-context=UNSPECIFIED
    Lin_SendFrame: service-id=0x04, is-reentrant=false, is-synchronous=false, call-type=REGULAR, execution-context=UNSPECIFIED
    Lin_SetClockMode: service-id=0x0c, is-reentrant=false, is-synchronous=true, call-type=REGULAR, execution-context=UNSPECIFIED
    Lin_Wakeup: service-id=0x07, is-reentrant=false, is-synchronous=false, call-type=REGULAR, execution-context=UNSPECIFIED
    Lin_WakeupInternal: service-id=0x0b, is-reentrant=false, is-synchronous=false, call-type=REGULAR, execution-context=UNSPECIFIED
    Linflexd_Lin_Ip_SetBaudrate: service-id=0x110, is-reentrant=false, is-synchronous=true, call-type=REGULAR, execution-context=UNSPECIFIED
    LIN_LINFLEXD{0..2}_IRQHandler: service-id=0, is-reentrant=false, is-synchronous=true, call-type=INTERRUPT, execution-context=INTERRUPT-CAT-2
package /Lin_TS_T40D11M40I2R0/Implementations
  bsw implementation BswImplementation_0: programming-language=C, sw-version=4.0.2, vendor-id=43, ar-release-version=4.4.0, behavior=InternalBehavior_0, vendor-specific-module-def=Lin
    code-descriptors:
      code Files
        artifact-descriptors:
          short-label=config::Lin.xdm, category=SWCFG
          short-label=doc::RTD_LIN_IM.pdf, category=SWDOC
          short-label=doc::RTD_LIN_UM.pdf, category=SWDOC
          short-label=examples::EBT::S32G2::Lin_Example_S32G274A_M7::generate::epc::BaseNXP.xdm, category=SWCFG
          short-label=examples::EBT::S32G2::Lin_Example_S32G274A_M7::generate::epc::Dem.xdm, category=SWCFG
          short-label=examples::EBT::S32G2::Lin_Example_S32G274A_M7::generate::epc::EcuC.xdm, category=SWCFG
          short-label=examples::EBT::S32G2::Lin_Example_S32G274A_M7::generate::epc::EcuM.xdm, category=SWCFG
          short-label=examples::EBT::S32G2::Lin_Example_S32G274A_M7::generate::epc::Lin.xdm, category=SWCFG
          short-label=examples::EBT::S32G2::Lin_Example_S32G274A_M7::generate::epc::Mcu.xdm, category=SWCFG
          short-label=examples::EBT::S32G2::Lin_Example_S32G274A_M7::generate::epc::Platform.xdm, category=SWCFG
          short-label=examples::EBT::S32G2::Lin_Example_S32G274A_M7::generate::epc::Port.xdm, category=SWCFG
          short-label=examples::EBT::S32G2::Lin_Example_S32G274A_M7::generate::epc::Resource.xdm, category=SWCFG
          short-label=examples::EBT::S32G2::Lin_Example_S32G274A_M7::include::check_example.h, category=SWHDR
          short-label=examples::EBT::S32G2::Lin_Example_S32G274A_M7::src::main.c, category=SWSRC
          short-label=examples::EBT::S32G2::Lin_Example_S32G274A_M7::TresosProject::Lin_Example_S32G274A_M7::.prefs::preferences.xdm, category=SWCFG
          short-label=examples::EBT::S32G2::Lin_Example_S32G274A_M7::TresosProject::Lin_Example_S32G274A_M7::config::BaseNXP.xdm, category=SWCFG
          short-label=examples::EBT::S32G2::Lin_Example_S32G274A_M7::TresosProject::Lin_Example_S32G274A_M7::config::Dem.xdm, category=SWCFG
          short-label=examples::EBT::S32G2::Lin_Example_S32G274A_M7::TresosProject::Lin_Example_S32G274A_M7::config::EcuC.xdm, category=SWCFG
          short-label=examples::EBT::S32G2::Lin_Example_S32G274A_M7::TresosProject::Lin_Example_S32G274A_M7::config::EcuM.xdm, category=SWCFG
          short-label=examples::EBT::S32G2::Lin_Example_S32G274A_M7::TresosProject::Lin_Example_S32G274A_M7::config::Lin.xdm, category=SWCFG
          short-label=examples::EBT::S32G2::Lin_Example_S32G274A_M7::TresosProject::Lin_Example_S32G274A_M7::config::Mcu.xdm, category=SWCFG
          short-label=examples::EBT::S32G2::Lin_Example_S32G274A_M7::TresosProject::Lin_Example_S32G274A_M7::config::Platform.xdm, category=SWCFG
          short-label=examples::EBT::S32G2::Lin_Example_S32G274A_M7::TresosProject::Lin_Example_S32G274A_M7::config::Port.xdm, category=SWCFG
          short-label=examples::EBT::S32G2::Lin_Example_S32G274A_M7::TresosProject::Lin_Example_S32G274A_M7::config::Resource.xdm, category=SWCFG
          short-label=examples::EBT::S32G3::Lin_Example_S32G399A_M7::generate::epc::BaseNXP.xdm, category=SWCFG
          short-label=examples::EBT::S32G3::Lin_Example_S32G399A_M7::generate::epc::Dem.xdm, category=SWCFG
          short-label=examples::EBT::S32G3::Lin_Example_S32G399A_M7::generate::epc::EcuC.xdm, category=SWCFG
          short-label=examples::EBT::S32G3::Lin_Example_S32G399A_M7::generate::epc::EcuM.xdm, category=SWCFG
          short-label=examples::EBT::S32G3::Lin_Example_S32G399A_M7::generate::epc::Lin.xdm, category=SWCFG
          short-label=examples::EBT::S32G3::Lin_Example_S32G399A_M7::generate::epc::Mcu.xdm, category=SWCFG
          short-label=examples::EBT::S32G3::Lin_Example_S32G399A_M7::generate::epc::Platform.xdm, category=SWCFG
          short-label=examples::EBT::S32G3::Lin_Example_S32G399A_M7::generate::epc::Port.xdm, category=SWCFG
          short-label=examples::EBT::S32G3::Lin_Example_S32G399A_M7::generate::epc::Resource.xdm, category=SWCFG
          short-label=examples::EBT::S32G3::Lin_Example_S32G399A_M7::include::check_example.h, category=SWHDR
          short-label=examples::EBT::S32G3::Lin_Example_S32G399A_M7::src::main.c, category=SWSRC
          short-label=examples::EBT::S32G3::Lin_Example_S32G399A_M7::TresosProject::Lin_Example_S32G399A_M7::.prefs::preferences.xdm, category=SWCFG
          short-label=examples::EBT::S32G3::Lin_Example_S32G399A_M7::TresosProject::Lin_Example_S32G399A_M7::config::BaseNXP.xdm, category=SWCFG
          short-label=examples::EBT::S32G3::Lin_Example_S32G399A_M7::TresosProject::Lin_Example_S32G399A_M7::config::Dem.xdm, category=SWCFG
          short-label=examples::EBT::S32G3::Lin_Example_S32G399A_M7::TresosProject::Lin_Example_S32G399A_M7::config::EcuC.xdm, category=SWCFG
          short-label=examples::EBT::S32G3::Lin_Example_S32G399A_M7::TresosProject::Lin_Example_S32G399A_M7::config::EcuM.xdm, category=SWCFG
          short-label=examples::EBT::S32G3::Lin_Example_S32G399A_M7::TresosProject::Lin_Example_S32G399A_M7::config::Lin.xdm, category=SWCFG
          short-label=examples::EBT::S32G3::Lin_Example_S32G399A_M7::TresosProject::Lin_Example_S32G399A_M7::config::Mcu.xdm, category=SWCFG
          short-label=examples::EBT::S32G3::Lin_Example_S32G399A_M7::TresosProject::Lin_Example_S32G399A_M7::config::Platform.xdm, category=SWCFG
          short-label=examples::EBT::S32G3::Lin_Example_S32G399A_M7::TresosProject::Lin_Example_S32G399A_M7::config::Port.xdm, category=SWCFG
          short-label=examples::EBT::S32G3::Lin_Example_S32G399A_M7::TresosProject::Lin_Example_S32G399A_M7::config::Resource.xdm, category=SWCFG
          short-label=examples::EBT::S32R45::Lin_Example_S32R45_M7::generate::epc::BaseNXP.xdm, category=SWCFG
          short-label=examples::EBT::S32R45::Lin_Example_S32R45_M7::generate::epc::Dem.xdm, category=SWCFG
          short-label=examples::EBT::S32R45::Lin_Example_S32R45_M7::generate::epc::EcuC.xdm, category=SWCFG
          short-label=examples::EBT::S32R45::Lin_Example_S32R45_M7::generate::epc::EcuM.xdm, category=SWCFG
          short-label=examples::EBT::S32R45::Lin_Example_S32R45_M7::generate::epc::Lin.xdm, category=SWCFG
          short-label=examples::EBT::S32R45::Lin_Example_S32R45_M7::generate::epc::Mcu.xdm, category=SWCFG
          short-label=examples::EBT::S32R45::Lin_Example_S32R45_M7::generate::epc::Platform.xdm, category=SWCFG
          short-label=examples::EBT::S32R45::Lin_Example_S32R45_M7::generate::epc::Port.xdm, category=SWCFG
          short-label=examples::EBT::S32R45::Lin_Example_S32R45_M7::generate::epc::Resource.xdm, category=SWCFG
          short-label=examples::EBT::S32R45::Lin_Example_S32R45_M7::include::check_example.h, category=SWHDR
          short-label=examples::EBT::S32R45::Lin_Example_S32R45_M7::src::main.c, category=SWSRC
          short-label=examples::EBT::S32R45::Lin_Example_S32R45_M7::TresosProject::Lin_Example_S32R45_M7::.prefs::preferences.xdm, category=SWCFG
          short-label=examples::EBT::S32R45::Lin_Example_S32R45_M7::TresosProject::Lin_Example_S32R45_M7::config::BaseNXP.xdm, category=SWCFG
          short-label=examples::EBT::S32R45::Lin_Example_S32R45_M7::TresosProject::Lin_Example_S32R45_M7::config::Dem.xdm, category=SWCFG
          short-label=examples::EBT::S32R45::Lin_Example_S32R45_M7::TresosProject::Lin_Example_S32R45_M7::config::EcuC.xdm, category=SWCFG
          short-label=examples::EBT::S32R45::Lin_Example_S32R45_M7::TresosProject::Lin_Example_S32R45_M7::config::EcuM.xdm, category=SWCFG
          short-label=examples::EBT::S32R45::Lin_Example_S32R45_M7::TresosProject::Lin_Example_S32R45_M7::config::Lin.xdm, category=SWCFG
          short-label=examples::EBT::S32R45::Lin_Example_S32R45_M7::TresosProject::Lin_Example_S32R45_M7::config::Mcu.xdm, category=SWCFG
          short-label=examples::EBT::S32R45::Lin_Example_S32R45_M7::TresosProject::Lin_Example_S32R45_M7::config::Platform.xdm, category=SWCFG
          short-label=examples::EBT::S32R45::Lin_Example_S32R45_M7::TresosProject::Lin_Example_S32R45_M7::config::Port.xdm, category=SWCFG
          short-label=examples::EBT::S32R45::Lin_Example_S32R45_M7::TresosProject::Lin_Example_S32R45_M7::config::Resource.xdm, category=SWCFG
          short-label=examples::S32DS::S32G2::Linflexd_Lin_Ip_Example_S32G274A_M7::include::check_example.h, category=SWHDR
          short-label=examples::S32DS::S32G2::Linflexd_Lin_Ip_Example_S32G274A_M7::Project_Settings::Startup_Code::exceptions.c, category=SWSRC
          short-label=examples::S32DS::S32G2::Linflexd_Lin_Ip_Example_S32G274A_M7::Project_Settings::Startup_Code::nvic.c, category=SWSRC
          short-label=examples::S32DS::S32G2::Linflexd_Lin_Ip_Example_S32G274A_M7::Project_Settings::Startup_Code::startup.c, category=SWSRC
          short-label=examples::S32DS::S32G2::Linflexd_Lin_Ip_Example_S32G274A_M7::Project_Settings::Startup_Code::system.c, category=SWSRC
          short-label=examples::S32DS::S32G2::Linflexd_Lin_Ip_Example_S32G274A_M7::src::main.c, category=SWSRC
          short-label=examples::S32DS::S32G2::Lin_Example_S32G274A_M7::include::check_example.h, category=SWHDR
          short-label=examples::S32DS::S32G2::Lin_Example_S32G274A_M7::Project_Settings::Startup_Code::exceptions.c, category=SWSRC
          short-label=examples::S32DS::S32G2::Lin_Example_S32G274A_M7::Project_Settings::Startup_Code::nvic.c, category=SWSRC
          short-label=examples::S32DS::S32G2::Lin_Example_S32G274A_M7::Project_Settings::Startup_Code::startup.c, category=SWSRC
          short-label=examples::S32DS::S32G2::Lin_Example_S32G274A_M7::Project_Settings::Startup_Code::system.c, category=SWSRC
          short-label=examples::S32DS::S32G2::Lin_Example_S32G274A_M7::src::main.c, category=SWSRC
          short-label=examples::S32DS::S32G3::Linflexd_Lin_Ip_Example_S32G399A_M7::include::check_example.h, category=SWHDR
          short-label=examples::S32DS::S32G3::Linflexd_Lin_Ip_Example_S32G399A_M7::Project_Settings::Startup_Code::exceptions.c, category=SWSRC
          short-label=examples::S32DS::S32G3::Linflexd_Lin_Ip_Example_S32G399A_M7::Project_Settings::Startup_Code::nvic.c, category=SWSRC
          short-label=examples::S32DS::S32G3::Linflexd_Lin_Ip_Example_S32G399A_M7::Project_Settings::Startup_Code::startup.c, category=SWSRC
          short-label=examples::S32DS::S32G3::Linflexd_Lin_Ip_Example_S32G399A_M7::Project_Settings::Startup_Code::system.c, category=SWSRC
          short-label=examples::S32DS::S32G3::Linflexd_Lin_Ip_Example_S32G399A_M7::src::main.c, category=SWSRC
          short-label=examples::S32DS::S32G3::Lin_Example_S32G399A_M7::include::check_example.h, category=SWHDR
          short-label=examples::S32DS::S32G3::Lin_Example_S32G399A_M7::Project_Settings::Startup_Code::exceptions.c, category=SWSRC
          short-label=examples::S32DS::S32G3::Lin_Example_S32G399A_M7::Project_Settings::Startup_Code::nvic.c, category=SWSRC
          short-label=examples::S32DS::S32G3::Lin_Example_S32G399A_M7::Project_Settings::Startup_Code::startup.c, category=SWSRC
          short-label=examples::S32DS::S32G3::Lin_Example_S32G399A_M7::Project_Settings::Startup_Code::system.c, category=SWSRC
          short-label=examples::S32DS::S32G3::Lin_Example_S32G399A_M7::src::main.c, category=SWSRC
          short-label=examples::S32DS::S32R45::Linflexd_Lin_Ip_Example_S32R45_M7::include::check_example.h, category=SWHDR
          short-label=examples::S32DS::S32R45::Linflexd_Lin_Ip_Example_S32R45_M7::Project_Settings::Startup_Code::exceptions.c, category=SWSRC
          short-label=examples::S32DS::S32R45::Linflexd_Lin_Ip_Example_S32R45_M7::Project_Settings::Startup_Code::nvic.c, category=SWSRC
          short-label=examples::S32DS::S32R45::Linflexd_Lin_Ip_Example_S32R45_M7::Project_Settings::Startup_Code::startup.c, category=SWSRC
          short-label=examples::S32DS::S32R45::Linflexd_Lin_Ip_Example_S32R45_M7::Project_Settings::Startup_Code::system.c, category=SWSRC
          short-label=examples::S32DS::S32R45::Linflexd_Lin_Ip_Example_S32R45_M7::src::main.c, category=SWSRC
          short-label=examples::S32DS::S32R45::Lin_Example_S32R45_M7::include::check_example.h, category=SWHDR
          short-label=examples::S32DS::S32R45::Lin_Example_S32R45_M7::Project_Settings::Startup_Code::exceptions.c, category=SWSRC
          short-label=examples::S32DS::S32R45::Lin_Example_S32R45_M7::Project_Settings::Startup_Code::nvic.c, category=SWSRC
          short-label=examples::S32DS::S32R45::Lin_Example_S32R45_M7::Project_Settings::Startup_Code::startup.c, category=SWSRC
          short-label=examples::S32DS::S32R45::Lin_Example_S32R45_M7::Project_Settings::Startup_Code::system.c, category=SWSRC
          short-label=examples::S32DS::S32R45::Lin_Example_S32R45_M7::src::main.c, category=SWSRC
          short-label=include::Lin.h, category=SWHDR
          short-label=include::Linflexd_Lin_Ip.h, category=SWHDR
          short-label=include::Linflexd_Lin_Ip_Autosar.h, category=SWHDR
          short-label=include::Linflexd_Lin_Ip_TrustedFunctions.h, category=SWHDR
          short-label=include::Linflexd_Lin_Ip_Types.h, category=SWHDR
          short-label=include::Lin_ASRExt.h, category=SWHDR
          short-label=include::Lin_Ipw.h, category=SWHDR
          short-label=include::Lin_Ipw_Types.h, category=SWHDR
          short-label=include::Lin_Types.h, category=SWHDR
          short-label=src::Lin.c, category=SWSRC
          short-label=src::Linflexd_Lin_Ip.c, category=SWSRC
          short-label=src::Linflexd_Lin_Ip_Autosar.c, category=SWSRC
          short-label=src::Linflexd_Lin_Ip_Irq.c, category=SWSRC
          short-label=src::Lin_ASRExt.c, category=SWSRC
          short-label=src::Lin_Ipw.c, category=SWSRC
    compiler DIAB_Compiler:
      name=Windriver Diab
      options=-tARMCORTEXM7MG:simple -mthumb -std=c99 -Oz -g -fstandalone-debug -Wstrict-prototypes -Wsign-compare -Wdouble-promotion -Wunknown-pragmas -Wundef -Wextra -Wall -pedantic -Werror=implicit-function-declaration -fno-common -fno-signed-char -fno-trigraphs -V -c -DS32XX -DS32G2XX -DS32G3XX -DS32R45 -DDIAB -DUSE_SW_VECTOR_MODE -DD_CACHE_ENABLE -DI_CACHE_ENABLE -DENABLE_FPU -DMCAL_ENABLE_USER_MODE_SUPPORT
      vendor=Windriver
      version=DIAB_7_0_3_0-FCS_20200409_160912
    compiler GCC_Compiler:
      name=GCC Compiler
      options=-mcpu=cortex-m7 -mthumb -mlittle-endian -mfpu=fpv5-sp-d16 -mfloat-abi=hard -std=c99 -Os -ggdb3 -Wall -Wextra -pedantic -Wstrict-prototypes -Wundef -Wunused -Werror=implicit-function-declaration -Wsign-compare -Wdouble-promotion -fno-short-enums -funsigned-char -funsigned-bitfields -fomit-frame-pointer -fno-common -fstack-usage -fdump-ipa-all -c -DS32XX -DS32G2XX -DS32G3XX -DS32R45 -DGCC -DUSE_SW_VECTOR_MODE -DD_CACHE_ENABLE -DI_CACHE_ENABLE -DENABLE_FPU -DMCAL_ENABLE_USER_MODE_SUPPORT
      vendor=GCC Systems
      version=NXP GCC 9.2.0 20190812 (Build 1649 Revision gaf57174)
    compiler GHS_Compiler:
      name=Green Hills
      options=-cpu=cortexm7 -thumb -fpu=vfpv5_d16 -fsingle -C99 --ghstd=last -Osize --gnu_asm -dual_debug -G -keeptempfiles -Wimplicit-int -Wshadow -Wtrigraphs -Wundef --unsigned_chars --unsigned_fields --no_commons --no_exceptions --no_slash_comment --prototype_errors --incorrect_pragma_warnings -c -DS32XX -DS32G2XX -DS32G3XX -DS32R45 -DGHS -DUSE_SW_VECTOR_MODE -DD_CACHE_ENABLE -DI_CACHE_ENABLE -DENABLE_FPU -DMCAL_ENABLE_USER_MODE_SUPPORT
      vendor=Green Hills
      version=Green Hills Multi 7.1.6d / Compiler 2020.1.4
    generated-artifacts:
      11 x dependency on artifact:
        Linflexd_Lin_Ip_PBcfg_h: artifact-descriptor={short-label=generate_PB::include::Linflexd_Lin_Ip_PBcfg.h, category=SWHDR}, usages=EXECUTE
        Lin_Ipw_PBcfg_h: artifact-descriptor={short-label=generate_PB::include::Lin_Ipw_PBcfg.h, category=SWHDR}, usages=EXECUTE
        Lin_PBcfg_h: artifact-descriptor={short-label=generate_PB::include::Lin_PBcfg.h, category=SWHDR}, usages=EXECUTE
        Linflexd_Lin_Ip_PBcfg_c: artifact-descriptor={short-label=generate_PB::src::Linflexd_Lin_Ip_PBcfg.c, category=SWSRC}, usages=EXECUTE
        Lin_Ipw_PBcfg_c: artifact-descriptor={short-label=generate_PB::src::Lin_Ipw_PBcfg.c, category=SWSRC}, usages=EXECUTE
        Lin_PBcfg_c: artifact-descriptor={short-label=generate_PB::src::Lin_PBcfg.c, category=SWSRC}, usages=EXECUTE
        Linflexd_Lin_Ip_Cfg_h: artifact-descriptor={short-label=generate_PC::include::Linflexd_Lin_Ip_Cfg.h, category=SWHDR}, usages=COMPILE
        Lin_Cfg_h: artifact-descriptor={short-label=generate_PC::include::Lin_Cfg.h, category=SWHDR}, usages=COMPILE
        Lin_Defines_h: artifact-descriptor={short-label=generate_PC::include::Lin_Defines.h, category=SWHDR}, usages=COMPILE
        Lin_Ipw_Cfg_h: artifact-descriptor={short-label=generate_PC::include::Lin_Ipw_Cfg.h, category=SWHDR}, usages=COMPILE
        Lin_Cfg_c: artifact-descriptor={short-label=generate_PC::src::Lin_Cfg.c, category=SWSRC}, usages=COMPILE
    linker DIAB_Linker: name=Windriver Diab, options=-e Reset_Handler linker_script_file.dld -m30 -Xstack-usage -Xpreprocess-lecl -Llibrary_path -lc -lm, vendor=Windriver, version=DIAB_7_0_3_0-FCS_20200409_160912
    linker GCC_Linker: name=GCC Compiler, options=-Wl,-Map,filename -T linkerfile --entry=Reset_Handler -nostartfiles -mcpu=cortexm7 -mthumb -mfpu=fpv5-sp-d16 -mfloat-abi=hard -mlittle-endian -ggdb3 -lc -lm -lgcc, vendor=GCC Systems, version=NXP GCC 9.2.0 20190812 (Build 1649 Revision gaf57174)
    linker GHS_Linker: name=Green Hills, options=-e Reset_Handler -T linker_script_file.ld -map -keepmap -Mn -delete -ignore_debug_references -Llibrary_path -larch -lstartup -lind_sd -v -nostartfiles, vendor=Green Hills, version=Green Hills Multi 7.1.6d / Compiler 2020.1.4
    resource consumption ResourceConsumption
      6 x memory section:
        LIN_CODE: alignment=UNSPECIFIED, sw-addrmethod=CODE, symbol=CODE
        LIN_CONFIG_DATA_UNSPECIFIED: alignment=UNSPECIFIED, sw-addrmethod=CONFIG_DATA, symbol=CONFIG_DATA_UNSPECIFIED
        LIN_CONST_UNSPECIFIED: alignment=UNSPECIFIED, sw-addrmethod=CONST, symbol=CONST_UNSPECIFIED
        LIN_VAR_CLEARED_8: alignment=8, sw-addrmethod=VAR_CLEARED, symbol=VAR_CLEARED_8
        LIN_VAR_CLEARED_UNSPECIFIED: alignment=UNSPECIFIED, sw-addrmethod=VAR_CLEARED, symbol=VAR_CLEARED_UNSPECIFIED
        LIN_VAR_INIT_8: alignment=8, sw-addrmethod=VAR_INIT, symbol=VAR_INIT_8
