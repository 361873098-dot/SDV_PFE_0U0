AUTOSAR XML (schema 00046)
package /AUTOSAR_Mcu/BswModuleDescriptions
  bsw module description Mcu: module-id=101
    provided-entrys:
      Mcu_DisableCmu
      Mcu_DistributePllClock
      Mcu_GetClockFrequency
      Mcu_GetMidrStructure
      Mcu_GetPeripheralState
      Mcu_GetPllStatus
      Mcu_GetPowerDomainState
      Mcu_GetRamState
      Mcu_GetResetRawValue
      Mcu_GetResetReason
      Mcu_GetSystemState
      Mcu_GetVersionInfo
      Mcu_Init
      Mcu_InitClock
      Mcu_InitRamSection
      Mcu_PerformReset
      Mcu_SetMode
      Mcu_SleepOnExit
      MC_RGM_ResetAlt_IRQHandler
      Mcu_Cmu_ClockFail_IRQHandler
    bsw internal behavior InternalBehavior_0
      exclusive area MCU_EXCLUSIVE_AREA_00
      exclusive area MCU_EXCLUSIVE_AREA_01
      18 x bsw called entity:
        Mcu_DisableCmu: can-enter-exclusive-area=MCU_EXCLUSIVE_AREA_01, implemented-entry=Mcu_DisableCmu
        Mcu_DistributePllClock: implemented-entry=Mcu_DistributePllClock
        Mcu_GetClockFrequency: implemented-entry=Mcu_GetClockFrequency
        Mcu_GetMidrStructure: implemented-entry=Mcu_GetMidrStructure
        Mcu_GetPeripheralState: implemented-entry=Mcu_GetPeripheralState
        Mcu_GetPllStatus: implemented-entry=Mcu_GetPllStatus
        Mcu_GetPowerDomainState: implemented-entry=Mcu_GetPowerDomainState
        Mcu_GetRamState: implemented-entry=Mcu_GetRamState
        Mcu_GetResetRawValue: implemented-entry=Mcu_GetResetRawValue
        Mcu_GetResetReason: implemented-entry=Mcu_GetResetReason
        Mcu_GetSystemState: implemented-entry=Mcu_GetSystemState
        Mcu_GetVersionInfo: implemented-entry=Mcu_GetVersionInfo
        Mcu_Init: implemented-entry=Mcu_Init
        Mcu_InitClock: implemented-entry=Mcu_InitClock
        Mcu_InitRamSection: implemented-entry=Mcu_InitRamSection
        Mcu_PerformReset: implemented-entry=Mcu_PerformReset
        Mcu_SetMode: can-enter-exclusive-area=MCU_EXCLUSIVE_AREA_00, implemented-entry=Mcu_SetMode
        Mcu_SleepOnExit: implemented-entry=Mcu_SleepOnExit
      bsw interrupt entity MC_RGM_ResetAlt_IRQHandler: implemented-entry=MC_RGM_ResetAlt_IRQHandler, interrupt-category=CAT-2, interrupt-source=Hardware
      bsw interrupt entity Mcu_Cmu_ClockFail_IRQHandler: implemented-entry=Mcu_Cmu_ClockFail_IRQHandler, interrupt-category=CAT-2, interrupt-source=Hardware
package /AUTOSAR_Mcu/BswModuleEntrys
  20 x bsw module entry, all with is-synchronous=true, sw-service-impl-policy=STANDARD:
    Mcu_DisableCmu: service-id=0x17, is-reentrant=true, call-type=REGULAR, execution-context=UNSPECIFIED
    Mcu_DistributePllClock: service-id=0x03, is-reentrant=false, call-type=REGULAR, execution-context=UNSPECIFIED
    Mcu_GetClockFrequency: service-id=0x19, is-reentrant=true, call-type=REGULAR, execution-context=UNSPECIFIED
    Mcu_GetMidrStructure: service-id=0x14, is-reentrant=true, call-type=REGULAR, execution-context=UNSPECIFIED
    Mcu_GetPeripheralState: service-id=0x0c, is-reentrant=true, call-type=REGULAR, execution-context=UNSPECIFIED
    Mcu_GetPllStatus: service-id=0x04, is-reentrant=true, call-type=REGULAR, execution-context=UNSPECIFIED
    Mcu_GetPowerDomainState: service-id=0x0b, is-reentrant=true, call-type=REGULAR, execution-context=UNSPECIFIED
    Mcu_GetRamState: service-id=0x0a, is-reentrant=true, call-type=REGULAR, execution-context=UNSPECIFIED
    Mcu_GetResetRawValue: service-id=0x06, is-reentrant=true, call-type=REGULAR, execution-context=UNSPECIFIED
    Mcu_GetResetReason: service-id=0x05, is-reentrant=true, call-type=REGULAR, execution-context=UNSPECIFIED
    Mcu_GetSystemState: service-id=0x0d, is-reentrant=true, call-type=REGULAR, execution-context=UNSPECIFIED
    Mcu_GetVersionInfo: service-id=0x09, is-reentrant=true, call-type=REGULAR, execution-context=UNSPECIFIED
    Mcu_Init: service-id=0x00, is-reentrant=false, call-type=REGULAR, execution-context=UNSPECIFIED
    Mcu_InitClock: service-id=0x02, is-reentrant=false, call-type=REGULAR, execution-context=UNSPECIFIED
    Mcu_InitRamSection: service-id=0x01, is-reentrant=false, call-type=REGULAR, execution-context=UNSPECIFIED
    Mcu_PerformReset: service-id=0x07, is-reentrant=false, call-type=REGULAR, execution-context=UNSPECIFIED
    Mcu_SetMode: service-id=0x08, is-reentrant=true, call-type=REGULAR, execution-context=UNSPECIFIED
    Mcu_SleepOnExit: service-id=0x1a, is-reentrant=true, call-type=REGULAR, execution-context=UNSPECIFIED
    MC_RGM_ResetAlt_IRQHandler: service-id=0, is-reentrant=false, call-type=INTERRUPT, execution-context=INTERRUPT-CAT-2
    Mcu_Cmu_ClockFail_IRQHandler: service-id=0, is-reentrant=false, call-type=INTERRUPT, execution-context=INTERRUPT-CAT-2
package /Mcu_TS_T40D11M40I2R0/Implementations
  bsw implementation BswImplementation_0: programming-language=C, sw-version=4.0.2, vendor-id=43, ar-release-version=4.4.0, behavior=InternalBehavior_0, preconfigured-configuration=McuPreConfiguration, vendor-specific-module-def=Mcu
    code-descriptors:
      code Files
        artifact-descriptors:
          short-label=config::Mcu.xdm, category=SWCFG
          short-label=config_ext::McuPreConfiguration.xdm, category=SWCFG
          short-label=doc::RTD_MCU_IM.pdf, category=SWDOC
          short-label=doc::RTD_MCU_UM.pdf, category=SWDOC
          short-label=examples::EBT::S32G2::Mcu_Example_S32G274A_M7::generate::epc::BaseNXP.xdm, category=SWCFG
          short-label=examples::EBT::S32G2::Mcu_Example_S32G274A_M7::generate::epc::Dem.xdm, category=SWCFG
          short-label=examples::EBT::S32G2::Mcu_Example_S32G274A_M7::generate::epc::Mcu.xdm, category=SWCFG
          short-label=examples::EBT::S32G2::Mcu_Example_S32G274A_M7::generate::epc::Platform.xdm, category=SWCFG
          short-label=examples::EBT::S32G2::Mcu_Example_S32G274A_M7::generate::epc::Resource.xdm, category=SWCFG
          short-label=examples::EBT::S32G2::Mcu_Example_S32G274A_M7::include::check_example.h, category=SWHDR
          short-label=examples::EBT::S32G2::Mcu_Example_S32G274A_M7::src::main.c, category=SWSRC
          short-label=examples::EBT::S32G2::Mcu_Example_S32G274A_M7::TresosProject::Mcu_Example_S32G274A_M7::.prefs::preferences.xdm, category=SWCFG
          short-label=examples::EBT::S32G2::Mcu_Example_S32G274A_M7::TresosProject::Mcu_Example_S32G274A_M7::config::BaseNXP.xdm, category=SWCFG
          short-label=examples::EBT::S32G2::Mcu_Example_S32G274A_M7::TresosProject::Mcu_Example_S32G274A_M7::config::Dem.xdm, category=SWCFG
          short-label=examples::EBT::S32G2::Mcu_Example_S32G274A_M7::TresosProject::Mcu_Example_S32G274A_M7::config::EcuC.xdm, category=SWCFG
          short-label=examples::EBT::S32G2::Mcu_Example_S32G274A_M7::TresosProject::Mcu_Example_S32G274A_M7::config::Mcu.xdm, category=SWCFG
          short-label=examples::EBT::S32G2::Mcu_Example_S32G274A_M7::TresosProject::Mcu_Example_S32G274A_M7::config::Platform.xdm, category=SWCFG
          short-label=examples::EBT::S32G2::Mcu_Example_S32G274A_M7::TresosProject::Mcu_Example_S32G274A_M7::config::Resource.xdm, category=SWCFG
          short-label=examples::EBT::S32G3::Mcu_Example_S32G399A_M7::generate::epc::BaseNXP.xdm, category=SWCFG
          short-label=examples::EBT::S32G3::Mcu_Example_S32G399A_M7::generate::epc::Dem.xdm, category=SWCFG
          short-label=examples::EBT::S32G3::Mcu_Example_S32G399A_M7::generate::epc::Mcu.xdm, category=SWCFG
          short-label=examples::EBT::S32G3::Mcu_Example_S32G399A_M7::generate::epc::Platform.xdm, category=SWCFG
          short-label=examples::EBT::S32G3::Mcu_Example_S32G399A_M7::generate::epc::Resource.xdm, category=SWCFG
          short-label=examples::EBT::S32G3::Mcu_Example_S32G399A_M7::include::check_example.h, category=SWHDR
          short-label=examples::EBT::S32G3::Mcu_Example_S32G399A_M7::src::main.c, category=SWSRC
          short-label=examples::EBT::S32G3::Mcu_Example_S32G399A_M7::TresosProject::Mcu_Example_S32G399A_M7::.prefs::preferences.xdm, category=SWCFG
          short-label=examples::EBT::S32G3::Mcu_Example_S32G399A_M7::TresosProject::Mcu_Example_S32G399A_M7::config::BaseNXP.xdm, category=SWCFG
          short-label=examples::EBT::S32G3::Mcu_Example_S32G399A_M7::TresosProject::Mcu_Example_S32G399A_M7::config::Dem.xdm, category=SWCFG
          short-label=examples::EBT::S32G3::Mcu_Example_S32G399A_M7::TresosProject::Mcu_Example_S32G399A_M7::config::EcuC.xdm, category=SWCFG
          short-label=examples::EBT::S32G3::Mcu_Example_S32G399A_M7::TresosProject::Mcu_Example_S32G399A_M7::config::Mcu.xdm, category=SWCFG
          short-label=examples::EBT::S32G3::Mcu_Example_S32G399A_M7::TresosProject::Mcu_Example_S32G399A_M7::config::Platform.xdm, category=SWCFG
          short-label=examples::EBT::S32G3::Mcu_Example_S32G399A_M7::TresosProject::Mcu_Example_S32G399A_M7::config::Resource.xdm, category=SWCFG
          short-label=examples::EBT::S32R45::Mcu_Example_S32R45_M7::generate::epc::BaseNXP.xdm, category=SWCFG
          short-label=examples::EBT::S32R45::Mcu_Example_S32R45_M7::generate::epc::Dem.xdm, category=SWCFG
          short-label=examples::EBT::S32R45::Mcu_Example_S32R45_M7::generate::epc::Mcu.xdm, category=SWCFG
          short-label=examples::EBT::S32R45::Mcu_Example_S32R45_M7::generate::epc::Platform.xdm, category=SWCFG
          short-label=examples::EBT::S32R45::Mcu_Example_S32R45_M7::generate::epc::Resource.xdm, category=SWCFG
          short-label=examples::EBT::S32R45::Mcu_Example_S32R45_M7::include::check_example.h, category=SWHDR
          short-label=examples::EBT::S32R45::Mcu_Example_S32R45_M7::src::main.c, category=SWSRC
          short-label=examples::EBT::S32R45::Mcu_Example_S32R45_M7::TresosProject::Mcu_Example_S32R45_M7::.prefs::preferences.xdm, category=SWCFG
          short-label=examples::EBT::S32R45::Mcu_Example_S32R45_M7::TresosProject::Mcu_Example_S32R45_M7::config::BaseNXP.xdm, category=SWCFG
          short-label=examples::EBT::S32R45::Mcu_Example_S32R45_M7::TresosProject::Mcu_Example_S32R45_M7::config::Dem.xdm, category=SWCFG
          short-label=examples::EBT::S32R45::Mcu_Example_S32R45_M7::TresosProject::Mcu_Example_S32R45_M7::config::EcuC.xdm, category=SWCFG
          short-label=examples::EBT::S32R45::Mcu_Example_S32R45_M7::TresosProject::Mcu_Example_S32R45_M7::config::Mcu.xdm, category=SWCFG
          short-label=examples::EBT::S32R45::Mcu_Example_S32R45_M7::TresosProject::Mcu_Example_S32R45_M7::config::Platform.xdm, category=SWCFG
          short-label=examples::EBT::S32R45::Mcu_Example_S32R45_M7::TresosProject::Mcu_Example_S32R45_M7::config::Resource.xdm, category=SWCFG
          short-label=examples::S32DS::S32G2::Clock_Ip_Example_S32G274A_M7::include::check_example.h, category=SWHDR
          short-label=examples::S32DS::S32G2::Clock_Ip_Example_S32G274A_M7::Project_Settings::Startup_Code::exceptions.c, category=SWSRC
          short-label=examples::S32DS::S32G2::Clock_Ip_Example_S32G274A_M7::Project_Settings::Startup_Code::nvic.c, category=SWSRC
          short-label=examples::S32DS::S32G2::Clock_Ip_Example_S32G274A_M7::Project_Settings::Startup_Code::startup.c, category=SWSRC
          short-label=examples::S32DS::S32G2::Clock_Ip_Example_S32G274A_M7::Project_Settings::Startup_Code::system.c, category=SWSRC
          short-label=examples::S32DS::S32G2::Clock_Ip_Example_S32G274A_M7::src::main.c, category=SWSRC
          short-label=examples::S32DS::S32G2::Mcu_Example_S32G274A_M7::include::check_example.h, category=SWHDR
          short-label=examples::S32DS::S32G2::Mcu_Example_S32G274A_M7::Project_Settings::Startup_Code::exceptions.c, category=SWSRC
          short-label=examples::S32DS::S32G2::Mcu_Example_S32G274A_M7::Project_Settings::Startup_Code::nvic.c, category=SWSRC
          short-label=examples::S32DS::S32G2::Mcu_Example_S32G274A_M7::Project_Settings::Startup_Code::startup.c, category=SWSRC
          short-label=examples::S32DS::S32G2::Mcu_Example_S32G274A_M7::Project_Settings::Startup_Code::system.c, category=SWSRC
          short-label=examples::S32DS::S32G2::Mcu_Example_S32G274A_M7::src::main.c, category=SWSRC
          short-label=examples::S32DS::S32G2::Power_Ip_Example_S32G274A_M7::include::check_example.h, category=SWHDR
          short-label=examples::S32DS::S32G2::Power_Ip_Example_S32G274A_M7::Project_Settings::Startup_Code::exceptions.c, category=SWSRC
          short-label=examples::S32DS::S32G2::Power_Ip_Example_S32G274A_M7::Project_Settings::Startup_Code::nvic.c, category=SWSRC
          short-label=examples::S32DS::S32G2::Power_Ip_Example_S32G274A_M7::Project_Settings::Startup_Code::startup.c, category=SWSRC
          short-label=examples::S32DS::S32G2::Power_Ip_Example_S32G274A_M7::Project_Settings::Startup_Code::system.c, category=SWSRC
          short-label=examples::S32DS::S32G2::Power_Ip_Example_S32G274A_M7::src::main.c, category=SWSRC
          short-label=examples::S32DS::S32G3::Clock_Ip_Example_S32G399A_M7::include::check_example.h, category=SWHDR
          short-label=examples::S32DS::S32G3::Clock_Ip_Example_S32G399A_M7::Project_Settings::Startup_Code::exceptions.c, category=SWSRC
          short-label=examples::S32DS::S32G3::Clock_Ip_Example_S32G399A_M7::Project_Settings::Startup_Code::nvic.c, category=SWSRC
          short-label=examples::S32DS::S32G3::Clock_Ip_Example_S32G399A_M7::Project_Settings::Startup_Code::startup.c, category=SWSRC
          short-label=examples::S32DS::S32G3::Clock_Ip_Example_S32G399A_M7::Project_Settings::Startup_Code::system.c, category=SWSRC
          short-label=examples::S32DS::S32G3::Clock_Ip_Example_S32G399A_M7::src::main.c, category=SWSRC
          short-label=examples::S32DS::S32G3::Mcu_Example_S32G399A_M7::include::check_example.h, category=SWHDR
          short-label=examples::S32DS::S32G3::Mcu_Example_S32G399A_M7::Project_Settings::Startup_Code::exceptions.c, category=SWSRC
          short-label=examples::S32DS::S32G3::Mcu_Example_S32G399A_M7::Project_Settings::Startup_Code::nvic.c, category=SWSRC
          short-label=examples::S32DS::S32G3::Mcu_Example_S32G399A_M7::Project_Settings::Startup_Code::startup.c, category=SWSRC
          short-label=examples::S32DS::S32G3::Mcu_Example_S32G399A_M7::Project_Settings::Startup_Code::system.c, category=SWSRC
          short-label=examples::S32DS::S32G3::Mcu_Example_S32G399A_M7::src::main.c, category=SWSRC
          short-label=examples::S32DS::S32G3::Power_Ip_Example_S32G399A_M7::include::check_example.h, category=SWHDR
          short-label=examples::S32DS::S32G3::Power_Ip_Example_S32G399A_M7::Project_Settings::Startup_Code::exceptions.c, category=SWSRC
          short-label=examples::S32DS::S32G3::Power_Ip_Example_S32G399A_M7::Project_Settings::Startup_Code::nvic.c, category=SWSRC
          short-label=examples::S32DS::S32G3::Power_Ip_Example_S32G399A_M7::Project_Settings::Startup_Code::startup.c, category=SWSRC
          short-label=examples::S32DS::S32G3::Power_Ip_Example_S32G399A_M7::Project_Settings::Startup_Code::system.c, category=SWSRC
          short-label=examples::S32DS::S32G3::Power_Ip_Example_S32G399A_M7::src::main.c, category=SWSRC
          short-label=examples::S32DS::S32R45::Clock_Ip_Example_S32R45_M7::include::check_example.h, category=SWHDR
          short-label=examples::S32DS::S32R45::Clock_Ip_Example_S32R45_M7::Project_Settings::Startup_Code::exceptions.c, category=SWSRC
          short-label=examples::S32DS::S32R45::Clock_Ip_Example_S32R45_M7::Project_Settings::Startup_Code::nvic.c, category=SWSRC
          short-label=examples::S32DS::S32R45::Clock_Ip_Example_S32R45_M7::Project_Settings::Startup_Code::startup.c, category=SWSRC
          short-label=examples::S32DS::S32R45::Clock_Ip_Example_S32R45_M7::Project_Settings::Startup_Code::system.c, category=SWSRC
          short-label=examples::S32DS::S32R45::Clock_Ip_Example_S32R45_M7::src::main.c, category=SWSRC
          short-label=examples::S32DS::S32R45::Mcu_Example_S32R45_M7::include::check_example.h, category=SWHDR
          short-label=examples::S32DS::S32R45::Mcu_Example_S32R45_M7::Project_Settings::Startup_Code::exceptions.c, category=SWSRC
          short-label=examples::S32DS::S32R45::Mcu_Example_S32R45_M7::Project_Settings::Startup_Code::nvic.c, category=SWSRC
          short-label=examples::S32DS::S32R45::Mcu_Example_S32R45_M7::Project_Settings::Startup_Code::startup.c, category=SWSRC
          short-label=examples::S32DS::S32R45::Mcu_Example_S32R45_M7::Project_Settings::Startup_Code::system.c, category=SWSRC
          short-label=examples::S32DS::S32R45::Mcu_Example_S32R45_M7::src::main.c, category=SWSRC
          short-label=examples::S32DS::S32R45::Power_Ip_Example_S32R45_M7::include::check_example.h, category=SWHDR
          short-label=examples::S32DS::S32R45::Power_Ip_Example_S32R45_M7::Project_Settings::Startup_Code::exceptions.c, category=SWSRC
          short-label=examples::S32DS::S32R45::Power_Ip_Example_S32R45_M7::Project_Settings::Startup_Code::nvic.c, category=SWSRC
          short-label=examples::S32DS::S32R45::Power_Ip_Example_S32R45_M7::Project_Settings::Startup_Code::startup.c, category=SWSRC
          short-label=examples::S32DS::S32R45::Power_Ip_Example_S32R45_M7::Project_Settings::Startup_Code::system.c, category=SWSRC
          short-label=examples::S32DS::S32R45::Power_Ip_Example_S32R45_M7::src::main.c, category=SWSRC
          short-label=include::Clock_Ip.h, category=SWHDR
          short-label=include::Clock_Ip_Private.h, category=SWHDR
          short-label=include::Clock_Ip_Specific.h, category=SWHDR
          short-label=include::Clock_Ip_Specific1.h, category=SWHDR
          short-label=include::Clock_Ip_Specific2.h, category=SWHDR
          short-label=include::Clock_Ip_TrustedFunctions.h, category=SWHDR
          short-label=include::Clock_Ip_Types.h, category=SWHDR
          short-label=include::Mcu.h, category=SWHDR
          short-label=include::Mcu_Dem_Wrapper.h, category=SWHDR
          short-label=include::Mcu_EnvCfg.h, category=SWHDR
          short-label=include::Mcu_Ipw.h, category=SWHDR
          short-label=include::Mcu_Ipw_Types.h, category=SWHDR
          short-label=include::Power_Ip.h, category=SWHDR
          short-label=include::Power_Ip_CortexA.h, category=SWHDR
          short-label=include::Power_Ip_CortexM7.h, category=SWHDR
          short-label=include::Power_Ip_MC_ME.h, category=SWHDR
          short-label=include::Power_Ip_MC_ME_Types.h, category=SWHDR
          short-label=include::Power_Ip_MC_RGM.h, category=SWHDR
          short-label=include::Power_Ip_MC_RGM_Types.h, category=SWHDR
          short-label=include::Power_Ip_MSCM.h, category=SWHDR
          short-label=include::Power_Ip_PMC.h, category=SWHDR
          short-label=include::Power_Ip_PMC_Types.h, category=SWHDR
          short-label=include::Power_Ip_Private.h, category=SWHDR
          short-label=include::Power_Ip_Specific.h, category=SWHDR
          short-label=include::Power_Ip_TrustedFunctions.h, category=SWHDR
          short-label=include::Power_Ip_Types.h, category=SWHDR
          short-label=include::Ram_Ip.h, category=SWHDR
          short-label=include::Ram_Ip_Types.h, category=SWHDR
          short-label=src::Clock_Ip.c, category=SWSRC
          short-label=src::Clock_Ip_Data.c, category=SWSRC
          short-label=src::Clock_Ip_Data1.c, category=SWSRC
          short-label=src::Clock_Ip_Data2.c, category=SWSRC
          short-label=src::Clock_Ip_Divider.c, category=SWSRC
          short-label=src::Clock_Ip_DividerTrigger.c, category=SWSRC
          short-label=src::Clock_Ip_ExtOsc.c, category=SWSRC
          short-label=src::Clock_Ip_FracDiv.c, category=SWSRC
          short-label=src::Clock_Ip_Frequency.c, category=SWSRC
          short-label=src::Clock_Ip_Frequency1.c, category=SWSRC
          short-label=src::Clock_Ip_Frequency2.c, category=SWSRC
          short-label=src::Clock_Ip_Gate.c, category=SWSRC
          short-label=src::Clock_Ip_IntOsc.c, category=SWSRC
          short-label=src::Clock_Ip_Irq.c, category=SWSRC
          short-label=src::Clock_Ip_Monitor.c, category=SWSRC
          short-label=src::Clock_Ip_Pll.c, category=SWSRC
          short-label=src::Clock_Ip_ProgFreqSwitch.c, category=SWSRC
          short-label=src::Clock_Ip_Selector.c, category=SWSRC
          short-label=src::Clock_Ip_Specific.c, category=SWSRC
          short-label=src::Clock_Ip_Specific1.c, category=SWSRC
          short-label=src::Clock_Ip_Specific2.c, category=SWSRC
          short-label=src::Mcu.c, category=SWSRC
          short-label=src::Mcu_Dem_Wrapper.c, category=SWSRC
          short-label=src::Mcu_Ipw.c, category=SWSRC
          short-label=src::Power_Ip.c, category=SWSRC
          short-label=src::Power_Ip_CortexA.c, category=SWSRC
          short-label=src::Power_Ip_CortexM7.c, category=SWSRC
          short-label=src::Power_Ip_MC_ME.c, category=SWSRC
          short-label=src::Power_Ip_MC_RGM.c, category=SWSRC
          short-label=src::Power_Ip_MC_RGM_Irq.c, category=SWSRC
          short-label=src::Power_Ip_MSCM.c, category=SWSRC
          short-label=src::Power_Ip_PMC.c, category=SWSRC
          short-label=src::Power_Ip_Private.c, category=SWSRC
          short-label=src::Ram_Ip.c, category=SWSRC
    compiler DIAB_Compiler:
      name=Windriver Diab
      options=-tARMCORTEXM7MG:simple -mthumb -std=c99 -Oz -g -fstandalone-debug -Wstrict-prototypes -Wsign-compare -Wdouble-promotion -Wunknown-pragmas -Wundef -Wextra -Wall -pedantic -Werror=implicit-function-declaration -fno-common -fno-signed-char -fno-trigraphs -V -c -DS32XX -DS32G2XX -DS32G3XX -DS32R45 -DDIAB -DUSE_SW_VECTOR_MODE -DD_CACHE_ENABLE -DI_CACHE_ENABLE -DENABLE_FPU -DMCAL_ENABLE_USER_MODE_SUPPORT
      vendor=Windriver
      version=DIAB_7_0_3_0-FCS_20200409_160912
    compiler GCC_Compiler:
      name=GCC Compiler
      options=-mcpu=cortex-m7 -mthumb -mlittle-endian -mfpu=fpv5-sp-d16 -mfloat-abi=hard -std=c99 -Os -ggdb3 -Wall -Wextra -pedantic -Wstrict-prototypes -Wundef -Wunused -Werror=implicit-function-declaration -Wsign-compare -Wdouble-promotion -fno-short-enums -funsigned-char -funsigned-bitfields -fomit-frame-pointer -fno-common -fstack-usage -fdump-ipa-all -c -DS32XX -DS32G2XX -DS32G3XX -DS32R45 -DGCC -DUSE_SW_VECTOR_MODE -DD_CACHE_ENABLE -DI_CACHE_ENABLE -DENABLE_FPU -DMCAL_ENABLE_USER_MODE_SUPPORT
      vendor=GCC Systems
      version=NXP GCC 9.2.0 20190812 (Build 1649 Revision gaf57174)
    compiler GHS_Compiler:
      name=Green Hills
      options=-cpu=cortexm7 -thumb -fpu=vfpv5_d16 -fsingle -C99 --ghstd=last -Osize --gnu_asm -dual_debug -G -keeptempfiles -Wimplicit-int -Wshadow -Wtrigraphs -Wundef --unsigned_chars --unsigned_fields --no_commons --no_exceptions --no_slash_comment --prototype_errors --incorrect_pragma_warnings -c -DS32XX -DS32G2XX -DS32G3XX -DS32R45 -DGHS -DUSE_SW_VECTOR_MODE -DD_CACHE_ENABLE -DI_CACHE_ENABLE -DENABLE_FPU -DMCAL_ENABLE_USER_MODE_SUPPORT
      vendor=Green Hills
      version=Green Hills Multi 7.1.6d / Compiler 2020.1.4
    generated-artifacts:
      20 x dependency on artifact:
        Clock_Ip_PBcfg_h: artifact-descriptor={short-label=generate_PB::include::Clock_Ip_PBcfg.h, category=SWHDR}, usages=EXECUTE
        Mcu_PBcfg_h: artifact-descriptor={short-label=generate_PB::include::Mcu_PBcfg.h, category=SWHDR}, usages=EXECUTE
        Power_Ip_PBcfg_h: artifact-descriptor={short-label=generate_PB::include::Power_Ip_PBcfg.h, category=SWHDR}, usages=EXECUTE
        Ram_Ip_PBcfg_h: artifact-descriptor={short-label=generate_PB::include::Ram_Ip_PBcfg.h, category=SWHDR}, usages=EXECUTE
        Clock_Ip_PBcfg_c: artifact-descriptor={short-label=generate_PB::src::Clock_Ip_PBcfg.c, category=SWSRC}, usages=EXECUTE
        Mcu_PBcfg_c: artifact-descriptor={short-label=generate_PB::src::Mcu_PBcfg.c, category=SWSRC}, usages=EXECUTE
        Power_Ip_PBcfg_c: artifact-descriptor={short-label=generate_PB::src::Power_Ip_PBcfg.c, category=SWSRC}, usages=EXECUTE
        Ram_Ip_PBcfg_c: artifact-descriptor={short-label=generate_PB::src::Ram_Ip_PBcfg.c, category=SWSRC}, usages=EXECUTE
        Clock_Ip_Cfg_h: artifact-descriptor={short-label=generate_PC::include::Clock_Ip_Cfg.h, category=SWHDR}, usages=COMPILE
        Clock_Ip_Cfg_Defines_h: artifact-descriptor={short-label=generate_PC::include::Clock_Ip_Cfg_Defines.h, category=SWHDR}, usages=COMPILE
        Mcu_Cfg_h: artifact-descriptor={short-label=generate_PC::include::Mcu_Cfg.h, category=SWHDR}, usages=COMPILE
        Mcu_Ipw_Cfg_Defines_h: artifact-descriptor={short-label=generate_PC::include::Mcu_Ipw_Cfg_Defines.h, category=SWHDR}, usages=COMPILE
        Power_Ip_Cfg_h: artifact-descriptor={short-label=generate_PC::include::Power_Ip_Cfg.h, category=SWHDR}, usages=COMPILE
        Power_Ip_Cfg_Defines_h: artifact-descriptor={short-label=generate_PC::include::Power_Ip_Cfg_Defines.h, category=SWHDR}, usages=COMPILE
        Ram_Ip_Cfg_h: artifact-descriptor={short-label=generate_PC::include::Ram_Ip_Cfg.h, category=SWHDR}, usages=COMPILE
        Ram_Ip_Cfg_Defines_h: artifact-descriptor={short-label=generate_PC::include::Ram_Ip_Cfg_Defines.h, category=SWHDR}, usages=COMPILE
        Clock_Ip_Cfg_c: artifact-descriptor={short-label=generate_PC::src::Clock_Ip_Cfg.c, category=SWSRC}, usages=COMPILE
        Mcu_Cfg_c: artifact-descriptor={short-label=generate_PC::src::Mcu_Cfg.c, category=SWSRC}, usages=COMPILE
        Power_Ip_Cfg_c: artifact-descriptor={short-label=generate_PC::src::Power_Ip_Cfg.c, category=SWSRC}, usages=COMPILE
        Ram_Ip_Cfg_c: artifact-descriptor={short-label=generate_PC::src::Ram_Ip_Cfg.c, category=SWSRC}, usages=COMPILE
    linker DIAB_Linker: name=Windriver Diab, options=-e Reset_Handler linker_script_file.dld -m30 -Xstack-usage -Xpreprocess-lecl -Llibrary_path -lc -lm, vendor=Windriver, version=DIAB_7_0_3_0-FCS_20200409_160912
    linker GCC_Linker: name=GCC Compiler, options=-Wl,-Map,filename -T linkerfile --entry=Reset_Handler -nostartfiles -mcpu=cortexm7 -mthumb -mfpu=fpv5-sp-d16 -mfloat-abi=hard -mlittle-endian -ggdb3 -lc -lm -lgcc, vendor=GCC Systems, version=NXP GCC 9.2.0 20190812 (Build 1649 Revision gaf57174)
    linker GHS_Linker: name=Green Hills, options=-e Reset_Handler -T linker_script_file.ld -map -keepmap -Mn -delete -ignore_debug_references -Llibrary_path -larch -lstartup -lind_sd -v -nostartfiles, vendor=Green Hills, version=Green Hills Multi 7.1.6d / Compiler 2020.1.4
    resource consumption ResourceConsumption
      14 x memory section:
        MCU_CODE: alignment=UNSPECIFIED, sw-addrmethod=CODE, symbol=CODE
        MCU_CODE_AC: alignment=UNSPECIFIED, sw-addrmethod=CODE, symbol=CODE_AC
        MCU_CONFIG_DATA_UNSPECIFIED: alignment=UNSPECIFIED, sw-addrmethod=CONFIG_DATA, symbol=CONFIG_DATA_UNSPECIFIED
        MCU_CONST_16: alignment=16, sw-addrmethod=CONST, symbol=CONST_16
        MCU_CONST_32: alignment=32, sw-addrmethod=CONST, symbol=CONST_32
        MCU_CONST_8: alignment=8, sw-addrmethod=CONST, symbol=CONST_8
        MCU_CONST_UNSPECIFIED: alignment=UNSPECIFIED, sw-addrmethod=CONST, symbol=CONST_UNSPECIFIED
        MCU_RAMCODE: alignment=UNSPECIFIED, sw-addrmethod=RAMCODE, symbol=RAMCODE
        MCU_VAR_CLEARED_32: alignment=32, sw-addrmethod=VAR_CLEARED, symbol=VAR_CLEARED_32
        MCU_VAR_CLEARED_8: alignment=8, sw-addrmethod=VAR_CLEARED, symbol=VAR_CLEARED_8
        MCU_VAR_CLEARED_BOOLEAN: alignment=BOOLEAN, sw-addrmethod=VAR_CLEARED, symbol=VAR_CLEARED_BOOLEAN
        MCU_VAR_CLEARED_UNSPECIFIED: alignment=UNSPECIFIED, sw-addrmethod=VAR_CLEARED, symbol=VAR_CLEARED_UNSPECIFIED
        MCU_VAR_INIT_BOOLEAN: alignment=BOOLEAN, sw-addrmethod=VAR_INIT, symbol=VAR_INIT_BOOLEAN
        MCU_VAR_INIT_UNSPECIFIED: alignment=UNSPECIFIED, sw-addrmethod=VAR_INIT, symbol=VAR_INIT_UNSPECIFIED
