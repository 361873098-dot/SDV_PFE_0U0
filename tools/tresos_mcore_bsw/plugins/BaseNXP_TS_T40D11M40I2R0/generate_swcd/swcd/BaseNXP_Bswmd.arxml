AUTOSAR XML (schema 00046)
package /AUTOSAR_BaseNXP/BswModuleDescriptions
  bsw module description BaseNXP: module-id=0, provided-entrys=[OsIf_GetCounter, OsIf_GetElapsed, OsIf_Init, OsIf_MicrosToTicks, OsIf_SetTimerFrequency]
    bsw internal behavior InternalBehavior_0
      5 x bsw called entity:
        OsIf_GetCounter: implemented-entry=OsIf_GetCounter
        OsIf_GetElapsed: implemented-entry=OsIf_GetElapsed
        OsIf_Init: implemented-entry=OsIf_Init
        OsIf_MicrosToTicks: implemented-entry=OsIf_MicrosToTicks
        OsIf_SetTimerFrequency: implemented-entry=OsIf_SetTimerFrequency
package /AUTOSAR_BaseNXP/BswModuleEntrys
  5 x bsw module entry, all with is-synchronous=true, call-type=REGULAR, execution-context=UNSPECIFIED, sw-service-impl-policy=STANDARD:
    OsIf_GetCounter: service-id=0x02, is-reentrant=true
    OsIf_GetElapsed: service-id=0x03, is-reentrant=true
    OsIf_Init: service-id=0x01, is-reentrant=false
    OsIf_MicrosToTicks: service-id=0x05, is-reentrant=true
    OsIf_SetTimerFrequency: service-id=0x04, is-reentrant=true
package /BaseNXP_TS_T40D11M40I2R0/Implementations
  bsw implementation BswImplementation_0: programming-language=C, sw-version=4.0.2, vendor-id=43, ar-release-version=4.4.0, behavior=InternalBehavior_0, vendor-specific-module-def=BaseNXP
    code-descriptors:
      code Files
        artifact-descriptors:
          short-label=config::BaseNXP.xdm, category=SWCFG
          short-label=doc::howto::HOWTO_Port_An_S32DS_Example_To_Use_Another_Compiler.pdf, category=SWDOC
          short-label=doc::RTD_BASE_IM.pdf, category=SWDOC
          short-label=doc::RTD_BASE_UM.pdf, category=SWDOC
          short-label=header::S32G274A.h, category=SWHDR
          short-label=header::S32G274A_A53_COMMON.h, category=SWHDR
          short-label=header::S32G274A_A53_GPR.h, category=SWHDR
          short-label=header::S32G274A_ADC.h, category=SWHDR
          short-label=header::S32G274A_ATP.h, category=SWHDR
          short-label=header::S32G274A_BOOT.h, category=SWHDR
          short-label=header::S32G274A_CAIU.h, category=SWHDR
          short-label=header::S32G274A_CCTI_FAULT_CTRL.h, category=SWHDR
          short-label=header::S32G274A_CM7_GPR.h, category=SWHDR
          short-label=header::S32G274A_CMIU.h, category=SWHDR
          short-label=header::S32G274A_CMU_FC.h, category=SWHDR
          short-label=header::S32G274A_CMU_FM.h, category=SWHDR
          short-label=header::S32G274A_COMMON.h, category=SWHDR
          short-label=header::S32G274A_CRC.h, category=SWHDR
          short-label=header::S32G274A_CSR.h, category=SWHDR
          short-label=header::S32G274A_CTU.h, category=SWHDR
          short-label=header::S32G274A_DDR_GPR.h, category=SWHDR
          short-label=header::S32G274A_DDR_SUBSYSTEM.h, category=SWHDR
          short-label=header::S32G274A_DFS.h, category=SWHDR
          short-label=header::S32G274A_DIRU.h, category=SWHDR
          short-label=header::S32G274A_DMA.h, category=SWHDR
          short-label=header::S32G274A_DMAMUX.h, category=SWHDR
          short-label=header::S32G274A_DMA_CRC.h, category=SWHDR
          short-label=header::S32G274A_DMA_TCD.h, category=SWHDR
          short-label=header::S32G274A_EIM.h, category=SWHDR
          short-label=header::S32G274A_ERM.h, category=SWHDR
          short-label=header::S32G274A_FCCU.h, category=SWHDR
          short-label=header::S32G274A_FLEXCAN.h, category=SWHDR
          short-label=header::S32G274A_FLEXRAY.h, category=SWHDR
          short-label=header::S32G274A_FSC.h, category=SWHDR
          short-label=header::S32G274A_FTM.h, category=SWHDR
          short-label=header::S32G274A_FXOSC.h, category=SWHDR
          short-label=header::S32G274A_GMAC.h, category=SWHDR
          short-label=header::S32G274A_I2C.h, category=SWHDR
          short-label=header::S32G274A_JDC.h, category=SWHDR
          short-label=header::S32G274A_LINFLEXD.h, category=SWHDR
          short-label=header::S32G274A_LLCE_CORE_TO_CORE.h, category=SWHDR
          short-label=header::S32G274A_LLCE_LPSPI.h, category=SWHDR
          short-label=header::S32G274A_LLCE_SYSCTRL.h, category=SWHDR
          short-label=header::S32G274A_M7_COMMON.h, category=SWHDR
          short-label=header::S32G274A_MCM.h, category=SWHDR
          short-label=header::S32G274A_MC_CGM.h, category=SWHDR
          short-label=header::S32G274A_MC_CGM_1.h, category=SWHDR
          short-label=header::S32G274A_MC_CGM_2.h, category=SWHDR
          short-label=header::S32G274A_MC_ME.h, category=SWHDR
          short-label=header::S32G274A_MC_RGM.h, category=SWHDR
          short-label=header::S32G274A_MDM_AP.h, category=SWHDR
          short-label=header::S32G274A_MPU.h, category=SWHDR
          short-label=header::S32G274A_MSCM.h, category=SWHDR
          short-label=header::S32G274A_MU.h, category=SWHDR
          short-label=header::S32G274A_NCBUID_RESET_VALUE.h, category=SWHDR
          short-label=header::S32G274A_NVIC.h, category=SWHDR
          short-label=header::S32G274A_OCOTP.h, category=SWHDR
          short-label=header::S32G274A_OCOTP_GPR.h, category=SWHDR
          short-label=header::S32G274A_PCIE_DMA.h, category=SWHDR
          short-label=header::S32G274A_PCIE_EP.h, category=SWHDR
          short-label=header::S32G274A_PCIE_RC.h, category=SWHDR
          short-label=header::S32G274A_PERF_REGISTERS.h, category=SWHDR
          short-label=header::S32G274A_PIT.h, category=SWHDR
          short-label=header::S32G274A_PLLDIG.h, category=SWHDR
          short-label=header::S32G274A_PMC.h, category=SWHDR
          short-label=header::S32G274A_PMUEVENTOBSERVER.h, category=SWHDR
          short-label=header::S32G274A_QUADSPI.h, category=SWHDR
          short-label=header::S32G274A_QUADSPI_ARDB.h, category=SWHDR
          short-label=header::S32G274A_REG_PROT.h, category=SWHDR
          short-label=header::S32G274A_RESET.h, category=SWHDR
          short-label=header::S32G274A_RTC.h, category=SWHDR
          short-label=header::S32G274A_S32G_GPR.h, category=SWHDR
          short-label=header::S32G274A_S32G_STDBY_GPR.h, category=SWHDR
          short-label=header::S32G274A_SBSW.h, category=SWHDR
          short-label=header::S32G274A_SCB.h, category=SWHDR
          short-label=header::S32G274A_SECURITY.h, category=SWHDR
          short-label=header::S32G274A_SELFTEST_GPR.h, category=SWHDR
          short-label=header::S32G274A_SELFTEST_GPR_TOP.h, category=SWHDR
          short-label=header::S32G274A_SEMA42.h, category=SWHDR
          short-label=header::S32G274A_SERDES_DMA_PCIE_1.h, category=SWHDR
          short-label=header::S32G274A_SERDES_EP_PCIE_1.h, category=SWHDR
          short-label=header::S32G274A_SERDES_GPR.h, category=SWHDR
          short-label=header::S32G274A_SERDES_RC_PCIE_1.h, category=SWHDR
          short-label=header::S32G274A_SERDES_SS.h, category=SWHDR
          short-label=header::S32G274A_SERDES_SS_PCIE_1.h, category=SWHDR
          short-label=header::S32G274A_SIUL2.h, category=SWHDR
          short-label=header::S32G274A_SPI.h, category=SWHDR
          short-label=header::S32G274A_SRAMC.h, category=SWHDR
          short-label=header::S32G274A_SRC.h, category=SWHDR
          short-label=header::S32G274A_SRC_GPR.h, category=SWHDR
          short-label=header::S32G274A_STCU2.h, category=SWHDR
          short-label=header::S32G274A_STM.h, category=SWHDR
          short-label=header::S32G274A_SWT.h, category=SWHDR
          short-label=header::S32G274A_SYSTICK.h, category=SWHDR
          short-label=header::S32G274A_TMU.h, category=SWHDR
          short-label=header::S32G274A_UMCTL2_MP.h, category=SWHDR
          short-label=header::S32G274A_UMCTL2_REGS.h, category=SWHDR
          short-label=header::S32G274A_UOTG.h, category=SWHDR
          short-label=header::S32G274A_UOTGNC.h, category=SWHDR
          short-label=header::S32G274A_USDHC.h, category=SWHDR
          short-label=header::S32G274A_WKPU.h, category=SWHDR
          short-label=header::S32G274A_XRDC.h, category=SWHDR
          short-label=header::S32G274A_XRDC_0.h, category=SWHDR
          short-label=header::S32G399A.h, category=SWHDR
          short-label=header::S32G399A_A53_COMMON.h, category=SWHDR
          short-label=header::S32G399A_A53_GPR.h, category=SWHDR
          short-label=header::S32G399A_ADC.h, category=SWHDR
          short-label=header::S32G399A_ATP.h, category=SWHDR
          short-label=header::S32G399A_BOOT.h, category=SWHDR
          short-label=header::S32G399A_CAIU.h, category=SWHDR
          short-label=header::S32G399A_CAIU0_QOSGENERATOR.h, category=SWHDR
          short-label=header::S32G399A_CAIU1_QOSGENERATOR.h, category=SWHDR
          short-label=header::S32G399A_CCTI_FAULT_CTRL.h, category=SWHDR
          short-label=header::S32G399A_CM7_GPR.h, category=SWHDR
          short-label=header::S32G399A_CMIU.h, category=SWHDR
          short-label=header::S32G399A_CMU_FC.h, category=SWHDR
          short-label=header::S32G399A_CMU_FC_39.h, category=SWHDR
          short-label=header::S32G399A_CMU_FC_{46..51}.h, category=SWHDR
          short-label=header::S32G399A_CMU_FM.h, category=SWHDR
          short-label=header::S32G399A_COMMON.h, category=SWHDR
          short-label=header::S32G399A_CRC.h, category=SWHDR
          short-label=header::S32G399A_CSR.h, category=SWHDR
          short-label=header::S32G399A_CTU.h, category=SWHDR
          short-label=header::S32G399A_DDR_GPR.h, category=SWHDR
          short-label=header::S32G399A_DDR_SUBSYSTEM.h, category=SWHDR
          short-label=header::S32G399A_DFS.h, category=SWHDR
          short-label=header::S32G399A_DIRU_0.h, category=SWHDR
          short-label=header::S32G399A_DIRU_1.h, category=SWHDR
          short-label=header::S32G399A_DMA.h, category=SWHDR
          short-label=header::S32G399A_DMAMUX.h, category=SWHDR
          short-label=header::S32G399A_DMA_CRC.h, category=SWHDR
          short-label=header::S32G399A_DMA_TCD.h, category=SWHDR
          short-label=header::S32G399A_EIM.h, category=SWHDR
          short-label=header::S32G399A_ERM.h, category=SWHDR
          short-label=header::S32G399A_FCCU.h, category=SWHDR
          short-label=header::S32G399A_FLEXCAN.h, category=SWHDR
          short-label=header::S32G399A_FLEXRAY.h, category=SWHDR
          short-label=header::S32G399A_FSC.h, category=SWHDR
          short-label=header::S32G399A_FTM.h, category=SWHDR
          short-label=header::S32G399A_FXOSC.h, category=SWHDR
          short-label=header::S32G399A_GMAC.h, category=SWHDR
          short-label=header::S32G399A_I2C.h, category=SWHDR
          short-label=header::S32G399A_JDC.h, category=SWHDR
          short-label=header::S32G399A_LINFLEXD.h, category=SWHDR
          short-label=header::S32G399A_LLCE_CORE_TO_CORE.h, category=SWHDR
          short-label=header::S32G399A_LLCE_LPSPI.h, category=SWHDR
          short-label=header::S32G399A_LLCE_SYSCTRL.h, category=SWHDR
          short-label=header::S32G399A_M7_COMMON.h, category=SWHDR
          short-label=header::S32G399A_MCM.h, category=SWHDR
          short-label=header::S32G399A_MC_CGM.h, category=SWHDR
          short-label=header::S32G399A_MC_CGM_1.h, category=SWHDR
          short-label=header::S32G399A_MC_CGM_2.h, category=SWHDR
          short-label=header::S32G399A_MC_CGM_5.h, category=SWHDR
          short-label=header::S32G399A_MC_CGM_6.h, category=SWHDR
          short-label=header::S32G399A_MC_ME.h, category=SWHDR
          short-label=header::S32G399A_MC_RGM.h, category=SWHDR
          short-label=header::S32G399A_MDM_AP.h, category=SWHDR
          short-label=header::S32G399A_MPU.h, category=SWHDR
          short-label=header::S32G399A_MSCM.h, category=SWHDR
          short-label=header::S32G399A_MU.h, category=SWHDR
          short-label=header::S32G399A_NCBUID_RESET_VALUE.h, category=SWHDR
          short-label=header::S32G399A_NVIC.h, category=SWHDR
          short-label=header::S32G399A_OCOTP.h, category=SWHDR
          short-label=header::S32G399A_OCOTP_GPR.h, category=SWHDR
          short-label=header::S32G399A_PCIE_DMA.h, category=SWHDR
          short-label=header::S32G399A_PCIE_EP.h, category=SWHDR
          short-label=header::S32G399A_PCIE_RC.h, category=SWHDR
          short-label=header::S32G399A_PERF_REGISTERS.h, category=SWHDR
          short-label=header::S32G399A_PIT.h, category=SWHDR
          short-label=header::S32G399A_PLLDIG.h, category=SWHDR
          short-label=header::S32G399A_PMC.h, category=SWHDR
          short-label=header::S32G399A_PMUEVENTOBSERVER.h, category=SWHDR
          short-label=header::S32G399A_QUADSPI.h, category=SWHDR
          short-label=header::S32G399A_QUADSPI_ARDB.h, category=SWHDR
          short-label=header::S32G399A_RESET.h, category=SWHDR
          short-label=header::S32G399A_RTC.h, category=SWHDR
          short-label=header::S32G399A_S32G_GPR.h, category=SWHDR
          short-label=header::S32G399A_S32G_STDBY_GPR.h, category=SWHDR
          short-label=header::S32G399A_SBSW.h, category=SWHDR
          short-label=header::S32G399A_SCB.h, category=SWHDR
          short-label=header::S32G399A_SECURITY.h, category=SWHDR
          short-label=header::S32G399A_SELFTEST_GPR.h, category=SWHDR
          short-label=header::S32G399A_SELFTEST_GPR_TOP.h, category=SWHDR
          short-label=header::S32G399A_SEMA42.h, category=SWHDR
          short-label=header::S32G399A_SERDES_DMA_PCIE_1.h, category=SWHDR
          short-label=header::S32G399A_SERDES_EP_PCIE_1.h, category=SWHDR
          short-label=header::S32G399A_SERDES_GPR.h, category=SWHDR
          short-label=header::S32G399A_SERDES_RC_PCIE_1.h, category=SWHDR
          short-label=header::S32G399A_SERDES_SS.h, category=SWHDR
          short-label=header::S32G399A_SERDES_SS_PCIE_1.h, category=SWHDR
          short-label=header::S32G399A_SIUL2.h, category=SWHDR
          short-label=header::S32G399A_SPI.h, category=SWHDR
          short-label=header::S32G399A_SRAMC.h, category=SWHDR
          short-label=header::S32G399A_SRC.h, category=SWHDR
          short-label=header::S32G399A_SRC_GPR.h, category=SWHDR
          short-label=header::S32G399A_STCU2.h, category=SWHDR
          short-label=header::S32G399A_STM.h, category=SWHDR
          short-label=header::S32G399A_SWT.h, category=SWHDR
          short-label=header::S32G399A_SYSTICK.h, category=SWHDR
          short-label=header::S32G399A_TMU.h, category=SWHDR
          short-label=header::S32G399A_UMCTL2_MP.h, category=SWHDR
          short-label=header::S32G399A_UMCTL2_REGS.h, category=SWHDR
          short-label=header::S32G399A_UOTG.h, category=SWHDR
          short-label=header::S32G399A_UOTGNC.h, category=SWHDR
          short-label=header::S32G399A_USDHC.h, category=SWHDR
          short-label=header::S32G399A_WKPU.h, category=SWHDR
          short-label=header::S32G399A_XRDC.h, category=SWHDR
          short-label=header::S32G399A_XRDC_0.h, category=SWHDR
          short-label=header::S32R45.h, category=SWHDR
          short-label=header::S32R45_A53_COMMON.h, category=SWHDR
          short-label=header::S32R45_A53_GPR.h, category=SWHDR
          short-label=header::S32R45_ADC.h, category=SWHDR
          short-label=header::S32R45_ATP.h, category=SWHDR
          short-label=header::S32R45_BOOT.h, category=SWHDR
          short-label=header::S32R45_CAIU.h, category=SWHDR
          short-label=header::S32R45_CCTI_FAULT_CTRL.h, category=SWHDR
          short-label=header::S32R45_CM7_GPR.h, category=SWHDR
          short-label=header::S32R45_CMIU.h, category=SWHDR
          short-label=header::S32R45_CMU_FC.h, category=SWHDR
          short-label=header::S32R45_CMU_FM.h, category=SWHDR
          short-label=header::S32R45_COMMON.h, category=SWHDR
          short-label=header::S32R45_CRC.h, category=SWHDR
          short-label=header::S32R45_CSR.h, category=SWHDR
          short-label=header::S32R45_CTE.h, category=SWHDR
          short-label=header::S32R45_CTU.h, category=SWHDR
          short-label=header::S32R45_DDR_GPR.h, category=SWHDR
          short-label=header::S32R45_DDR_SUBSYSTEM.h, category=SWHDR
          short-label=header::S32R45_DFS.h, category=SWHDR
          short-label=header::S32R45_DIRU.h, category=SWHDR
          short-label=header::S32R45_DMA.h, category=SWHDR
          short-label=header::S32R45_DMAMUX.h, category=SWHDR
          short-label=header::S32R45_DMA_CRC.h, category=SWHDR
          short-label=header::S32R45_DMA_TCD.h, category=SWHDR
          short-label=header::S32R45_EIM.h, category=SWHDR
          short-label=header::S32R45_ERM.h, category=SWHDR
          short-label=header::S32R45_FASTDMA.h, category=SWHDR
          short-label=header::S32R45_FCCU.h, category=SWHDR
          short-label=header::S32R45_FLEXCAN.h, category=SWHDR
          short-label=header::S32R45_FLEXRAY.h, category=SWHDR
          short-label=header::S32R45_FSC.h, category=SWHDR
          short-label=header::S32R45_FTM.h, category=SWHDR
          short-label=header::S32R45_FXOSC.h, category=SWHDR
          short-label=header::S32R45_GMAC.h, category=SWHDR
          short-label=header::S32R45_I2C.h, category=SWHDR
          short-label=header::S32R45_JDC.h, category=SWHDR
          short-label=header::S32R45_LINFLEXD.h, category=SWHDR
          short-label=header::S32R45_M7_COMMON.h, category=SWHDR
          short-label=header::S32R45_MCM.h, category=SWHDR
          short-label=header::S32R45_MC_CGM.h, category=SWHDR
          short-label=header::S32R45_MC_CGM_1.h, category=SWHDR
          short-label=header::S32R45_MC_CGM_2.h, category=SWHDR
          short-label=header::S32R45_MC_ME.h, category=SWHDR
          short-label=header::S32R45_MC_RGM.h, category=SWHDR
          short-label=header::S32R45_MDM_AP.h, category=SWHDR
          short-label=header::S32R45_MIPICSI2.h, category=SWHDR
          short-label=header::S32R45_MPU.h, category=SWHDR
          short-label=header::S32R45_MSCM.h, category=SWHDR
          short-label=header::S32R45_MU.h, category=SWHDR
          short-label=header::S32R45_NCBUID_RESET_VALUE.h, category=SWHDR
          short-label=header::S32R45_NVIC.h, category=SWHDR
          short-label=header::S32R45_OCOTP.h, category=SWHDR
          short-label=header::S32R45_PCIE_DMA.h, category=SWHDR
          short-label=header::S32R45_PCIE_EP.h, category=SWHDR
          short-label=header::S32R45_PCIE_RC.h, category=SWHDR
          short-label=header::S32R45_PERF_REGISTERS.h, category=SWHDR
          short-label=header::S32R45_PIT.h, category=SWHDR
          short-label=header::S32R45_PLLDIG.h, category=SWHDR
          short-label=header::S32R45_PMC.h, category=SWHDR
          short-label=header::S32R45_PMUEVENTOBSERVER.h, category=SWHDR
          short-label=header::S32R45_QUADSPI.h, category=SWHDR
          short-label=header::S32R45_QUADSPI_ARDB.h, category=SWHDR
          short-label=header::S32R45_RESET.h, category=SWHDR
          short-label=header::S32R45_SBSW.h, category=SWHDR
          short-label=header::S32R45_SCB.h, category=SWHDR
          short-label=header::S32R45_SECURITY.h, category=SWHDR
          short-label=header::S32R45_SELFTEST_GPR.h, category=SWHDR
          short-label=header::S32R45_SELFTEST_GPR_TOP.h, category=SWHDR
          short-label=header::S32R45_SEMA42.h, category=SWHDR
          short-label=header::S32R45_SERDES_DMA_PCIE_1.h, category=SWHDR
          short-label=header::S32R45_SERDES_EP_PCIE_1.h, category=SWHDR
          short-label=header::S32R45_SERDES_GPR.h, category=SWHDR
          short-label=header::S32R45_SERDES_RC_PCIE_1.h, category=SWHDR
          short-label=header::S32R45_SERDES_SS.h, category=SWHDR
          short-label=header::S32R45_SERDES_SS_PCIE_1.h, category=SWHDR
          short-label=header::S32R45_SIUL2.h, category=SWHDR
          short-label=header::S32R45_SPI.h, category=SWHDR
          short-label=header::S32R45_SPT.h, category=SWHDR
          short-label=header::S32R45_SRAMC.h, category=SWHDR
          short-label=header::S32R45_SRC.h, category=SWHDR
          short-label=header::S32R45_SRC_1.h, category=SWHDR
          short-label=header::S32R45_SRC_GPR.h, category=SWHDR
          short-label=header::S32R45_STCU2.h, category=SWHDR
          short-label=header::S32R45_STM.h, category=SWHDR
          short-label=header::S32R45_SWT.h, category=SWHDR
          short-label=header::S32R45_SYSTICK.h, category=SWHDR
          short-label=header::S32R45_TMU.h, category=SWHDR
          short-label=header::S32R45_UMCTL2_MP.h, category=SWHDR
          short-label=header::S32R45_UMCTL2_REGS.h, category=SWHDR
          short-label=header::S32R45_USDHC.h, category=SWHDR
          short-label=header::S32R45_VSPA.h, category=SWHDR
          short-label=header::S32R45_WKPU.h, category=SWHDR
          short-label=header::S32R45_XRDC.h, category=SWHDR
          short-label=header::S32R45_XRDC_0.h, category=SWHDR
          short-label=include::Adc_MemMap.h, category=SWHDR
          short-label=include::BaseNXP_MemMap.h, category=SWHDR
          short-label=include::BasicTypes.h, category=SWHDR
          short-label=include::Can_43_FLEXCAN_MemMap.h, category=SWHDR
          short-label=include::Can_43_LLCE_MemMap.h, category=SWHDR
          short-label=include::Can_GeneralTypes.h, category=SWHDR
          short-label=include::Can_MemMap.h, category=SWHDR
          short-label=include::Compiler.h, category=SWHDR
          short-label=include::CompilerDefinition.h, category=SWHDR
          short-label=include::Compiler_Cfg.h, category=SWHDR
          short-label=include::ComStackTypes.h, category=SWHDR
          short-label=include::ComStack_Cfg.h, category=SWHDR
          short-label=include::ComStack_Types.h, category=SWHDR
          short-label=include::Crc_MemMap.h, category=SWHDR
          short-label=include::Crypto_MemMap.h, category=SWHDR
          short-label=include::Csec_MemMap.h, category=SWHDR
          short-label=include::Dem_MemMap.h, category=SWHDR
          short-label=include::Det_MemMap.h, category=SWHDR
          short-label=include::Devassert.h, category=SWHDR
          short-label=include::Dio_MemMap.h, category=SWHDR
          short-label=include::Ecum_MemMap.h, category=SWHDR
          short-label=include::Eep_MemMap.h, category=SWHDR
          short-label=include::EthSwitch_43_SJA1105P_MemMap.h, category=SWHDR
          short-label=include::EthSwt_43_SJA11XX_MemMap.h, category=SWHDR
          short-label=include::EthTrcv_43_PHY_MemMap.h, category=SWHDR
          short-label=include::EthTrcv_43_TJA110X_MemMap.h, category=SWHDR
          short-label=include::Eth_43_PFE_MemMap.h, category=SWHDR
          short-label=include::Eth_GeneralTypes.h, category=SWHDR
          short-label=include::Eth_MemMap.h, category=SWHDR
          short-label=include::Fee_MemMap.h, category=SWHDR
          short-label=include::Fls_MemMap.h, category=SWHDR
          short-label=include::Fr_43_LLCE_MemMap.h, category=SWHDR
          short-label=include::Fr_GeneralTypes.h, category=SWHDR
          short-label=include::Fr_MemMap.h, category=SWHDR
          short-label=include::Gpt_MemMap.h, category=SWHDR
          short-label=include::I2c_MemMap.h, category=SWHDR
          short-label=include::Icu_MemMap.h, category=SWHDR
          short-label=include::Ipcf_MemMap.h, category=SWHDR
          short-label=include::IpVersionMacros.h, category=SWHDR
          short-label=include::Lin_43_LINFLEXD_MemMap.h, category=SWHDR
          short-label=include::Lin_43_LLCE_MemMap.h, category=SWHDR
          short-label=include::Lin_GeneralTypes.h, category=SWHDR
          short-label=include::Lin_MemMap.h, category=SWHDR
          short-label=include::Mcal.h, category=SWHDR
          short-label=include::Mcem_MemMap.h, category=SWHDR
          short-label=include::Mcl_MemMap.h, category=SWHDR
          short-label=include::Mcu_MemMap.h, category=SWHDR
          short-label=include::Ocotp_MemMap.h, category=SWHDR
          short-label=include::Ocu_MemMap.h, category=SWHDR
          short-label=include::OsIf.h, category=SWHDR
          short-label=include::OsIf_Cfg_TypesDef.h, category=SWHDR
          short-label=include::OsIf_DeviceRegisters.h, category=SWHDR
          short-label=include::OsIf_Internal.h, category=SWHDR
          short-label=include::OsIf_Interrupts.h, category=SWHDR
          short-label=include::OsIf_Timer_Custom.h, category=SWHDR
          short-label=include::OsIf_Timer_System.h, category=SWHDR
          short-label=include::OsIf_Timer_System_Internal_GenericTimer.h, category=SWHDR
          short-label=include::OsIf_Timer_System_Internal_Systick.h, category=SWHDR
          short-label=include::Pcie_MemMap.h, category=SWHDR
          short-label=include::Platform_MemMap.h, category=SWHDR
          short-label=include::Platform_Types.h, category=SWHDR
          short-label=include::Pmic_MemMap.h, category=SWHDR
          short-label=include::Port_MemMap.h, category=SWHDR
          short-label=include::Pwm_MemMap.h, category=SWHDR
          short-label=include::Qdec_MemMap.h, category=SWHDR
          short-label=include::RegLockMacros.h, category=SWHDR
          short-label=include::Reg_eSys.h, category=SWHDR
          short-label=include::Rm_MemMap.h, category=SWHDR
          short-label=include::Rte_MemMap.h, category=SWHDR
          short-label=include::Sent_MemMap.h, category=SWHDR
          short-label=include::Serdes_MemMap.h, category=SWHDR
          short-label=include::Spi_MemMap.h, category=SWHDR
          short-label=include::StandardTypes.h, category=SWHDR
          short-label=include::Std_Types.h, category=SWHDR
          short-label=include::Thermal_MemMap.h, category=SWHDR
          short-label=include::Tm_MemMap.h, category=SWHDR
          short-label=include::Uart_MemMap.h, category=SWHDR
          short-label=include::Wdg_43_VR5510_MemMap.h, category=SWHDR
          short-label=include::Wdg_MemMap.h, category=SWHDR
          short-label=src::OsIf_Interrupts.c, category=SWSRC
          short-label=src::OsIf_Timer.c, category=SWSRC
          short-label=src::OsIf_Timer_System.c, category=SWSRC
          short-label=src::OsIf_Timer_System_Internal_GenericTimer.c, category=SWSRC
          short-label=src::OsIf_Timer_System_Internal_Systick.c, category=SWSRC
          short-label=wizard_data::Clock_Ip_Cfg.c, category=SWSRC
          short-label=wizard_data::Clock_Ip_Cfg.h, category=SWHDR
          short-label=wizard_data::main.c, category=SWSRC
          short-label=wizard_data::modules.h, category=SWHDR
          short-label=wizard_data::OsIf_ArchCfg.h, category=SWHDR
          short-label=wizard_data::OsIf_Cfg.c, category=SWSRC
          short-label=wizard_data::OsIf_Cfg.h, category=SWHDR
          short-label=wizard_data::PlatformTypes.h, category=SWHDR
          short-label=wizard_data::S32G2XX::Clock_Ip_Cfg_Defines.h, category=SWHDR
          short-label=wizard_data::S32G2XX::Clock_Ip_PBcfg.c, category=SWSRC
          short-label=wizard_data::S32G2XX::Clock_Ip_PBcfg.h, category=SWHDR
          short-label=wizard_data::S32G2XX::Soc_Ips.h, category=SWHDR
          short-label=wizard_data::S32G3XX::Clock_Ip_Cfg_Defines.h, category=SWHDR
          short-label=wizard_data::S32G3XX::Clock_Ip_PBcfg.c, category=SWSRC
          short-label=wizard_data::S32G3XX::Clock_Ip_PBcfg.h, category=SWHDR
          short-label=wizard_data::S32G3XX::Soc_Ips.h, category=SWHDR
          short-label=wizard_data::S32R45::Clock_Ip_Cfg_Defines.h, category=SWHDR
          short-label=wizard_data::S32R45::Clock_Ip_PBcfg.c, category=SWSRC
          short-label=wizard_data::S32R45::Clock_Ip_PBcfg.h, category=SWHDR
          short-label=wizard_data::S32R45::Soc_Ips.h, category=SWHDR
          short-label=wizard_data::Siul2_Port_Ip_Cfg.c, category=SWSRC
          short-label=wizard_data::Siul2_Port_Ip_Cfg.h, category=SWHDR
          short-label=wizard_data::Siul2_Port_Ip_Defines.h, category=SWHDR
    compiler DIAB_Compiler:
      name=Windriver Diab
      options=-tARMCORTEXM7MG:simple -mthumb -std=c99 -Oz -g -fstandalone-debug -Wstrict-prototypes -Wsign-compare -Wdouble-promotion -Wunknown-pragmas -Wundef -Wextra -Wall -pedantic -Werror=implicit-function-declaration -fno-common -fno-signed-char -fno-trigraphs -V -c -DS32XX -DS32G2XX -DS32G3XX -DS32R45 -DDIAB -DUSE_SW_VECTOR_MODE -DD_CACHE_ENABLE -DI_CACHE_ENABLE -DENABLE_FPU -DMCAL_ENABLE_USER_MODE_SUPPORT
      vendor=Windriver
      version=DIAB_7_0_3_0-FCS_20200409_160912
    compiler GCC_Compiler:
      name=GCC Compiler
      options=-mcpu=cortex-m7 -mthumb -mlittle-endian -mfpu=fpv5-sp-d16 -mfloat-abi=hard -std=c99 -Os -ggdb3 -Wall -Wextra -pedantic -Wstrict-prototypes -Wundef -Wunused -Werror=implicit-function-declaration -Wsign-compare -Wdouble-promotion -fno-short-enums -funsigned-char -funsigned-bitfields -fomit-frame-pointer -fno-common -fstack-usage -fdump-ipa-all -c -DS32XX -DS32G2XX -DS32G3XX -DS32R45 -DGCC -DUSE_SW_VECTOR_MODE -DD_CACHE_ENABLE -DI_CACHE_ENABLE -DENABLE_FPU -DMCAL_ENABLE_USER_MODE_SUPPORT
      vendor=GCC Systems
      version=NXP GCC 9.2.0 20190812 (Build 1649 Revision gaf57174)
    compiler GHS_Compiler:
      name=Green Hills
      options=-cpu=cortexm7 -thumb -fpu=vfpv5_d16 -fsingle -C99 --ghstd=last -Osize --gnu_asm -dual_debug -G -keeptempfiles -Wimplicit-int -Wshadow -Wtrigraphs -Wundef --unsigned_chars --unsigned_fields --no_commons --no_exceptions --no_slash_comment --prototype_errors --incorrect_pragma_warnings -c -DS32XX -DS32G2XX -DS32G3XX -DS32R45 -DGHS -DUSE_SW_VECTOR_MODE -DD_CACHE_ENABLE -DI_CACHE_ENABLE -DENABLE_FPU -DMCAL_ENABLE_USER_MODE_SUPPORT
      vendor=Green Hills
      version=Green Hills Multi 7.1.6d / Compiler 2020.1.4
    generated-artifacts:
      6 x dependency on artifact, all with usages=COMPILE:
        modules_h: artifact-descriptor={short-label=generate_PC::include::modules.h, category=SWHDR}
        OsIf_ArchCfg_h: artifact-descriptor={short-label=generate_PC::include::OsIf_ArchCfg.h, category=SWHDR}
        OsIf_Cfg_h: artifact-descriptor={short-label=generate_PC::include::OsIf_Cfg.h, category=SWHDR}
        PlatformTypes_h: artifact-descriptor={short-label=generate_PC::include::PlatformTypes.h, category=SWHDR}
        Soc_Ips_h: artifact-descriptor={short-label=generate_PC::include::Soc_Ips.h, category=SWHDR}
        OsIf_Cfg_c: artifact-descriptor={short-label=generate_PC::src::OsIf_Cfg.c, category=SWSRC}
    linker DIAB_Linker: name=Windriver Diab, options=-e Reset_Handler linker_script_file.dld -m30 -Xstack-usage -Xpreprocess-lecl -Llibrary_path -lc -lm, vendor=Windriver, version=DIAB_7_0_3_0-FCS_20200409_160912
    linker GCC_Linker: name=GCC Compiler, options=-Wl,-Map,filename -T linkerfile --entry=Reset_Handler -nostartfiles -mcpu=cortexm7 -mthumb -mfpu=fpv5-sp-d16 -mfloat-abi=hard -mlittle-endian -ggdb3 -lc -lm -lgcc, vendor=GCC Systems, version=NXP GCC 9.2.0 20190812 (Build 1649 Revision gaf57174)
    linker GHS_Linker: name=Green Hills, options=-e Reset_Handler -T linker_script_file.ld -map -keepmap -Mn -delete -ignore_debug_references -Llibrary_path -larch -lstartup -lind_sd -v -nostartfiles, vendor=Green Hills, version=Green Hills Multi 7.1.6d / Compiler 2020.1.4
    resource consumption ResourceConsumption
      5 x memory section:
        BASENXP_CODE: alignment=UNSPECIFIED, sw-addrmethod=CODE, symbol=CODE
        BASENXP_CONFIG_DATA_UNSPECIFIED: alignment=UNSPECIFIED, sw-addrmethod=CONFIG_DATA, symbol=CONFIG_DATA_UNSPECIFIED
        BASENXP_VAR_CLEARED_32: alignment=32, sw-addrmethod=VAR_CLEARED, symbol=VAR_CLEARED_32
        BASENXP_VAR_CLEARED_BOOLEAN: alignment=BOOLEAN, sw-addrmethod=VAR_CLEARED, symbol=VAR_CLEARED_BOOLEAN
        BASENXP_VAR_CLEARED_UNSPECIFIED: alignment=UNSPECIFIED, sw-addrmethod=VAR_CLEARED, symbol=VAR_CLEARED_UNSPECIFIED
