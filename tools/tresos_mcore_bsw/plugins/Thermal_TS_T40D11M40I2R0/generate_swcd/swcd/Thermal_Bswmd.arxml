AUTOSAR XML (schema 00046)
package /AUTOSAR_Thermal/BswModuleDescriptions
  bsw module description Thermal: module-id=255
    provided-entrys:
      Thermal_Deinit
      Thermal_DisableMonitoringSite
      Thermal_DisableNotifications
      Thermal_EnableMonitoringSite
      Thermal_EnableNotifications
      Thermal_GetTemp
      Thermal_GetTempMaxRate
      Thermal_GetTempMinMaxLevel
      Thermal_Init
      Thermal_SetMeasurementInterval
      Thermal_SetPowerMode
      Thermal_SetTempThreshold
      Tmu_Critical_Isr
      Tmu_Isr
    bsw internal behavior InternalBehavior_0
      12 x bsw called entity:
        Thermal_Deinit: implemented-entry=Thermal_Deinit
        Thermal_DisableMonitoringSite: implemented-entry=Thermal_DisableMonitoringSite
        Thermal_DisableNotifications: implemented-entry=Thermal_DisableNotifications
        Thermal_EnableMonitoringSite: implemented-entry=Thermal_EnableMonitoringSite
        Thermal_EnableNotifications: implemented-entry=Thermal_EnableNotifications
        Thermal_GetTemp: implemented-entry=Thermal_GetTemp
        Thermal_GetTempMaxRate: implemented-entry=Thermal_GetTempMaxRate
        Thermal_GetTempMinMaxLevel: implemented-entry=Thermal_GetTempMinMaxLevel
        Thermal_Init: implemented-entry=Thermal_Init
        Thermal_SetMeasurementInterval: implemented-entry=Thermal_SetMeasurementInterval
        Thermal_SetPowerMode: implemented-entry=Thermal_SetPowerMode
        Thermal_SetTempThreshold: implemented-entry=Thermal_SetTempThreshold
      bsw interrupt entity Tmu_Critical_Isr: implemented-entry=Tmu_Critical_Isr, interrupt-category=CAT-2, interrupt-source=Hardware
      bsw interrupt entity Tmu_Isr: implemented-entry=Tmu_Isr, interrupt-category=CAT-2, interrupt-source=Hardware
package /AUTOSAR_Thermal/BswModuleEntrys
  14 x bsw module entry, all with is-reentrant=false, is-synchronous=true, sw-service-impl-policy=STANDARD:
    Thermal_Deinit: service-id=0x01, call-type=REGULAR, execution-context=UNSPECIFIED
    Thermal_DisableMonitoringSite: service-id=0x03, call-type=REGULAR, execution-context=UNSPECIFIED
    Thermal_DisableNotifications: service-id=0x0b, call-type=REGULAR, execution-context=UNSPECIFIED
    Thermal_EnableMonitoringSite: service-id=0x02, call-type=REGULAR, execution-context=UNSPECIFIED
    Thermal_EnableNotifications: service-id=0x0a, call-type=REGULAR, execution-context=UNSPECIFIED
    Thermal_GetTemp: service-id=0x07, call-type=REGULAR, execution-context=UNSPECIFIED
    Thermal_GetTempMaxRate: service-id=0x06, call-type=REGULAR, execution-context=UNSPECIFIED
    Thermal_GetTempMinMaxLevel: service-id=0x05, call-type=REGULAR, execution-context=UNSPECIFIED
    Thermal_Init: service-id=0x00, call-type=REGULAR, execution-context=UNSPECIFIED
    Thermal_SetMeasurementInterval: service-id=0x09, call-type=REGULAR, execution-context=UNSPECIFIED
    Thermal_SetPowerMode: service-id=0x04, call-type=REGULAR, execution-context=UNSPECIFIED
    Thermal_SetTempThreshold: service-id=0x08, call-type=REGULAR, execution-context=UNSPECIFIED
    Tmu_Critical_Isr: service-id=0, call-type=INTERRUPT, execution-context=INTERRUPT-CAT-2
    Tmu_Isr: service-id=0, call-type=INTERRUPT, execution-context=INTERRUPT-CAT-2
package /Thermal_TS_T40D11M40I2R0/Implementations
  bsw implementation BswImplementation_0: programming-language=C, sw-version=4.0.2, vendor-id=43, ar-release-version=4.4.0, behavior=InternalBehavior_0, vendor-specific-module-def=Thermal
    code-descriptors:
      code Files
        artifact-descriptors:
          short-label=config::Thermal.xdm, category=SWCFG
          short-label=doc::RTD_THERMAL_IM.pdf, category=SWDOC
          short-label=doc::RTD_THERMAL_UM.pdf, category=SWDOC
          short-label=examples::EBT::S32G2::Thermal_example_S32G274A_M7::generate::epc::BaseNXP.xdm, category=SWCFG
          short-label=examples::EBT::S32G2::Thermal_example_S32G274A_M7::generate::epc::EcuC.xdm, category=SWCFG
          short-label=examples::EBT::S32G2::Thermal_example_S32G274A_M7::generate::epc::Mcu.xdm, category=SWCFG
          short-label=examples::EBT::S32G2::Thermal_example_S32G274A_M7::generate::epc::Platform.xdm, category=SWCFG
          short-label=examples::EBT::S32G2::Thermal_example_S32G274A_M7::generate::epc::Resource.xdm, category=SWCFG
          short-label=examples::EBT::S32G2::Thermal_example_S32G274A_M7::generate::epc::Thermal.xdm, category=SWCFG
          short-label=examples::EBT::S32G2::Thermal_example_S32G274A_M7::include::check_example.h, category=SWHDR
          short-label=examples::EBT::S32G2::Thermal_example_S32G274A_M7::src::main.c, category=SWSRC
          short-label=examples::EBT::S32G2::Thermal_example_S32G274A_M7::TresosProject::Thermal_example_S32G274A_M7::.prefs::preferences.xdm, category=SWCFG
          short-label=examples::EBT::S32G2::Thermal_example_S32G274A_M7::TresosProject::Thermal_example_S32G274A_M7::config::BaseNXP.xdm, category=SWCFG
          short-label=examples::EBT::S32G2::Thermal_example_S32G274A_M7::TresosProject::Thermal_example_S32G274A_M7::config::EcuC.xdm, category=SWCFG
          short-label=examples::EBT::S32G2::Thermal_example_S32G274A_M7::TresosProject::Thermal_example_S32G274A_M7::config::Mcu.xdm, category=SWCFG
          short-label=examples::EBT::S32G2::Thermal_example_S32G274A_M7::TresosProject::Thermal_example_S32G274A_M7::config::Platform.xdm, category=SWCFG
          short-label=examples::EBT::S32G2::Thermal_example_S32G274A_M7::TresosProject::Thermal_example_S32G274A_M7::config::Resource.xdm, category=SWCFG
          short-label=examples::EBT::S32G2::Thermal_example_S32G274A_M7::TresosProject::Thermal_example_S32G274A_M7::config::Thermal.xdm, category=SWCFG
          short-label=examples::EBT::S32G3::Thermal_example_S32G399A_M7::generate::epc::BaseNXP.xdm, category=SWCFG
          short-label=examples::EBT::S32G3::Thermal_example_S32G399A_M7::generate::epc::EcuC.xdm, category=SWCFG
          short-label=examples::EBT::S32G3::Thermal_example_S32G399A_M7::generate::epc::Mcu.xdm, category=SWCFG
          short-label=examples::EBT::S32G3::Thermal_example_S32G399A_M7::generate::epc::Platform.xdm, category=SWCFG
          short-label=examples::EBT::S32G3::Thermal_example_S32G399A_M7::generate::epc::Resource.xdm, category=SWCFG
          short-label=examples::EBT::S32G3::Thermal_example_S32G399A_M7::generate::epc::Thermal.xdm, category=SWCFG
          short-label=examples::EBT::S32G3::Thermal_example_S32G399A_M7::include::check_example.h, category=SWHDR
          short-label=examples::EBT::S32G3::Thermal_example_S32G399A_M7::src::main.c, category=SWSRC
          short-label=examples::EBT::S32G3::Thermal_example_S32G399A_M7::TresosProject::Thermal_example_S32G399A_M7::.prefs::preferences.xdm, category=SWCFG
          short-label=examples::EBT::S32G3::Thermal_example_S32G399A_M7::TresosProject::Thermal_example_S32G399A_M7::config::BaseNXP.xdm, category=SWCFG
          short-label=examples::EBT::S32G3::Thermal_example_S32G399A_M7::TresosProject::Thermal_example_S32G399A_M7::config::EcuC.xdm, category=SWCFG
          short-label=examples::EBT::S32G3::Thermal_example_S32G399A_M7::TresosProject::Thermal_example_S32G399A_M7::config::Mcu.xdm, category=SWCFG
          short-label=examples::EBT::S32G3::Thermal_example_S32G399A_M7::TresosProject::Thermal_example_S32G399A_M7::config::Platform.xdm, category=SWCFG
          short-label=examples::EBT::S32G3::Thermal_example_S32G399A_M7::TresosProject::Thermal_example_S32G399A_M7::config::Resource.xdm, category=SWCFG
          short-label=examples::EBT::S32G3::Thermal_example_S32G399A_M7::TresosProject::Thermal_example_S32G399A_M7::config::Thermal.xdm, category=SWCFG
          short-label=examples::EBT::S32R45::Thermal_example_S32R45_M7::generate::epc::BaseNXP.xdm, category=SWCFG
          short-label=examples::EBT::S32R45::Thermal_example_S32R45_M7::generate::epc::EcuC.xdm, category=SWCFG
          short-label=examples::EBT::S32R45::Thermal_example_S32R45_M7::generate::epc::Mcu.xdm, category=SWCFG
          short-label=examples::EBT::S32R45::Thermal_example_S32R45_M7::generate::epc::Platform.xdm, category=SWCFG
          short-label=examples::EBT::S32R45::Thermal_example_S32R45_M7::generate::epc::Resource.xdm, category=SWCFG
          short-label=examples::EBT::S32R45::Thermal_example_S32R45_M7::generate::epc::Thermal.xdm, category=SWCFG
          short-label=examples::EBT::S32R45::Thermal_example_S32R45_M7::include::check_example.h, category=SWHDR
          short-label=examples::EBT::S32R45::Thermal_example_S32R45_M7::src::main.c, category=SWSRC
          short-label=examples::EBT::S32R45::Thermal_example_S32R45_M7::TresosProject::Thermal_example_S32R45_M7::.prefs::preferences.xdm, category=SWCFG
          short-label=examples::EBT::S32R45::Thermal_example_S32R45_M7::TresosProject::Thermal_example_S32R45_M7::config::BaseNXP.xdm, category=SWCFG
          short-label=examples::EBT::S32R45::Thermal_example_S32R45_M7::TresosProject::Thermal_example_S32R45_M7::config::EcuC.xdm, category=SWCFG
          short-label=examples::EBT::S32R45::Thermal_example_S32R45_M7::TresosProject::Thermal_example_S32R45_M7::config::Mcu.xdm, category=SWCFG
          short-label=examples::EBT::S32R45::Thermal_example_S32R45_M7::TresosProject::Thermal_example_S32R45_M7::config::Platform.xdm, category=SWCFG
          short-label=examples::EBT::S32R45::Thermal_example_S32R45_M7::TresosProject::Thermal_example_S32R45_M7::config::Resource.xdm, category=SWCFG
          short-label=examples::EBT::S32R45::Thermal_example_S32R45_M7::TresosProject::Thermal_example_S32R45_M7::config::Thermal.xdm, category=SWCFG
          short-label=examples::S32DS::S32G2::Thermal_example_S32G274A_M7::include::check_example.h, category=SWHDR
          short-label=examples::S32DS::S32G2::Thermal_example_S32G274A_M7::Project_Settings::Startup_Code::exceptions.c, category=SWSRC
          short-label=examples::S32DS::S32G2::Thermal_example_S32G274A_M7::Project_Settings::Startup_Code::nvic.c, category=SWSRC
          short-label=examples::S32DS::S32G2::Thermal_example_S32G274A_M7::Project_Settings::Startup_Code::startup.c, category=SWSRC
          short-label=examples::S32DS::S32G2::Thermal_example_S32G274A_M7::Project_Settings::Startup_Code::system.c, category=SWSRC
          short-label=examples::S32DS::S32G2::Thermal_example_S32G274A_M7::src::main.c, category=SWSRC
          short-label=examples::S32DS::S32G2::TMU_example_S32G274A_M7::include::check_example.h, category=SWHDR
          short-label=examples::S32DS::S32G2::TMU_example_S32G274A_M7::Project_Settings::Startup_Code::exceptions.c, category=SWSRC
          short-label=examples::S32DS::S32G2::TMU_example_S32G274A_M7::Project_Settings::Startup_Code::nvic.c, category=SWSRC
          short-label=examples::S32DS::S32G2::TMU_example_S32G274A_M7::Project_Settings::Startup_Code::startup.c, category=SWSRC
          short-label=examples::S32DS::S32G2::TMU_example_S32G274A_M7::Project_Settings::Startup_Code::system.c, category=SWSRC
          short-label=examples::S32DS::S32G2::TMU_example_S32G274A_M7::src::main.c, category=SWSRC
          short-label=examples::S32DS::S32G3::Thermal_example_S32G399A_M7::include::check_example.h, category=SWHDR
          short-label=examples::S32DS::S32G3::Thermal_example_S32G399A_M7::Project_Settings::Startup_Code::exceptions.c, category=SWSRC
          short-label=examples::S32DS::S32G3::Thermal_example_S32G399A_M7::Project_Settings::Startup_Code::nvic.c, category=SWSRC
          short-label=examples::S32DS::S32G3::Thermal_example_S32G399A_M7::Project_Settings::Startup_Code::startup.c, category=SWSRC
          short-label=examples::S32DS::S32G3::Thermal_example_S32G399A_M7::Project_Settings::Startup_Code::system.c, category=SWSRC
          short-label=examples::S32DS::S32G3::Thermal_example_S32G399A_M7::src::main.c, category=SWSRC
          short-label=examples::S32DS::S32G3::TMU_example_S32G399A_M7::include::check_example.h, category=SWHDR
          short-label=examples::S32DS::S32G3::TMU_example_S32G399A_M7::Project_Settings::Startup_Code::exceptions.c, category=SWSRC
          short-label=examples::S32DS::S32G3::TMU_example_S32G399A_M7::Project_Settings::Startup_Code::nvic.c, category=SWSRC
          short-label=examples::S32DS::S32G3::TMU_example_S32G399A_M7::Project_Settings::Startup_Code::startup.c, category=SWSRC
          short-label=examples::S32DS::S32G3::TMU_example_S32G399A_M7::Project_Settings::Startup_Code::system.c, category=SWSRC
          short-label=examples::S32DS::S32G3::TMU_example_S32G399A_M7::src::main.c, category=SWSRC
          short-label=examples::S32DS::S32R45::Thermal_example_S32R45_M7::include::check_example.h, category=SWHDR
          short-label=examples::S32DS::S32R45::Thermal_example_S32R45_M7::Project_Settings::Startup_Code::exceptions.c, category=SWSRC
          short-label=examples::S32DS::S32R45::Thermal_example_S32R45_M7::Project_Settings::Startup_Code::nvic.c, category=SWSRC
          short-label=examples::S32DS::S32R45::Thermal_example_S32R45_M7::Project_Settings::Startup_Code::startup.c, category=SWSRC
          short-label=examples::S32DS::S32R45::Thermal_example_S32R45_M7::Project_Settings::Startup_Code::system.c, category=SWSRC
          short-label=examples::S32DS::S32R45::Thermal_example_S32R45_M7::src::main.c, category=SWSRC
          short-label=examples::S32DS::S32R45::TMU_example_S32R45_M7::include::check_example.h, category=SWHDR
          short-label=examples::S32DS::S32R45::TMU_example_S32R45_M7::Project_Settings::Startup_Code::exceptions.c, category=SWSRC
          short-label=examples::S32DS::S32R45::TMU_example_S32R45_M7::Project_Settings::Startup_Code::nvic.c, category=SWSRC
          short-label=examples::S32DS::S32R45::TMU_example_S32R45_M7::Project_Settings::Startup_Code::startup.c, category=SWSRC
          short-label=examples::S32DS::S32R45::TMU_example_S32R45_M7::Project_Settings::Startup_Code::system.c, category=SWSRC
          short-label=examples::S32DS::S32R45::TMU_example_S32R45_M7::src::main.c, category=SWSRC
          short-label=include::CDD_Thermal.h, category=SWHDR
          short-label=include::CDD_Thermal_Types.h, category=SWHDR
          short-label=include::Tmu_Ip.h, category=SWHDR
          short-label=include::Tmu_Ip_Irq.h, category=SWHDR
          short-label=include::Tmu_Ip_TrustedFunctions.h, category=SWHDR
          short-label=include::Tmu_Ip_Types.h, category=SWHDR
          short-label=src::CDD_Thermal.c, category=SWSRC
          short-label=src::Tmu_Ip.c, category=SWSRC
          short-label=src::Tmu_Ip_Irq.c, category=SWSRC
    compiler DIAB_Compiler:
      name=Windriver Diab
      options=-tARMCORTEXM7MG:simple -mthumb -std=c99 -Oz -g -fstandalone-debug -Wstrict-prototypes -Wsign-compare -Wdouble-promotion -Wunknown-pragmas -Wundef -Wextra -Wall -pedantic -Werror=implicit-function-declaration -fno-common -fno-signed-char -fno-trigraphs -V -c -DS32XX -DS32G2XX -DS32G3XX -DS32R45 -DDIAB -DUSE_SW_VECTOR_MODE -DD_CACHE_ENABLE -DI_CACHE_ENABLE -DENABLE_FPU -DMCAL_ENABLE_USER_MODE_SUPPORT
      vendor=Windriver
      version=DIAB_7_0_3_0-FCS_20200409_160912
    compiler GCC_Compiler:
      name=GCC Compiler
      options=-mcpu=cortex-m7 -mthumb -mlittle-endian -mfpu=fpv5-sp-d16 -mfloat-abi=hard -std=c99 -Os -ggdb3 -Wall -Wextra -pedantic -Wstrict-prototypes -Wundef -Wunused -Werror=implicit-function-declaration -Wsign-compare -Wdouble-promotion -fno-short-enums -funsigned-char -funsigned-bitfields -fomit-frame-pointer -fno-common -fstack-usage -fdump-ipa-all -c -DS32XX -DS32G2XX -DS32G3XX -DS32R45 -DGCC -DUSE_SW_VECTOR_MODE -DD_CACHE_ENABLE -DI_CACHE_ENABLE -DENABLE_FPU -DMCAL_ENABLE_USER_MODE_SUPPORT
      vendor=GCC Systems
      version=NXP GCC 9.2.0 20190812 (Build 1649 Revision gaf57174)
    compiler GHS_Compiler:
      name=Green Hills
      options=-cpu=cortexm7 -thumb -fpu=vfpv5_d16 -fsingle -C99 --ghstd=last -Osize --gnu_asm -dual_debug -G -keeptempfiles -Wimplicit-int -Wshadow -Wtrigraphs -Wundef --unsigned_chars --unsigned_fields --no_commons --no_exceptions --no_slash_comment --prototype_errors --incorrect_pragma_warnings -c -DS32XX -DS32G2XX -DS32G3XX -DS32R45 -DGHS -DUSE_SW_VECTOR_MODE -DD_CACHE_ENABLE -DI_CACHE_ENABLE -DENABLE_FPU -DMCAL_ENABLE_USER_MODE_SUPPORT
      vendor=Green Hills
      version=Green Hills Multi 7.1.6d / Compiler 2020.1.4
    generated-artifacts:
      9 x dependency on artifact:
        CDD_Thermal_PBcfg_h: artifact-descriptor={short-label=generate_PB::include::CDD_Thermal_PBcfg.h, category=SWHDR}, usages=EXECUTE
        Tmu_Ip_PBcfg_h: artifact-descriptor={short-label=generate_PB::include::Tmu_Ip_PBcfg.h, category=SWHDR}, usages=EXECUTE
        CDD_Thermal_PBcfg_c: artifact-descriptor={short-label=generate_PB::src::CDD_Thermal_PBcfg.c, category=SWSRC}, usages=EXECUTE
        Tmu_Ip_PBcfg_c: artifact-descriptor={short-label=generate_PB::src::Tmu_Ip_PBcfg.c, category=SWSRC}, usages=EXECUTE
        CDD_Thermal_Cfg_h: artifact-descriptor={short-label=generate_PC::include::CDD_Thermal_Cfg.h, category=SWHDR}, usages=COMPILE
        CDD_Thermal_CfgDefines_h: artifact-descriptor={short-label=generate_PC::include::CDD_Thermal_CfgDefines.h, category=SWHDR}, usages=COMPILE
        Tmu_Ip_Cfg_h: artifact-descriptor={short-label=generate_PC::include::Tmu_Ip_Cfg.h, category=SWHDR}, usages=COMPILE
        Tmu_Ip_CfgDefines_h: artifact-descriptor={short-label=generate_PC::include::Tmu_Ip_CfgDefines.h, category=SWHDR}, usages=COMPILE
        CDD_Thermal_Cfg_c: artifact-descriptor={short-label=generate_PC::src::CDD_Thermal_Cfg.c, category=SWSRC}, usages=COMPILE
    linker DIAB_Linker: name=Windriver Diab, options=-e Reset_Handler linker_script_file.dld -m30 -Xstack-usage -Xpreprocess-lecl -Llibrary_path -lc -lm, vendor=Windriver, version=DIAB_7_0_3_0-FCS_20200409_160912
    linker GCC_Linker: name=GCC Compiler, options=-Wl,-Map,filename -T linkerfile --entry=Reset_Handler -nostartfiles -mcpu=cortexm7 -mthumb -mfpu=fpv5-sp-d16 -mfloat-abi=hard -mlittle-endian -ggdb3 -lc -lm -lgcc, vendor=GCC Systems, version=NXP GCC 9.2.0 20190812 (Build 1649 Revision gaf57174)
    linker GHS_Linker: name=Green Hills, options=-e Reset_Handler -T linker_script_file.ld -map -keepmap -Mn -delete -ignore_debug_references -Llibrary_path -larch -lstartup -lind_sd -v -nostartfiles, vendor=Green Hills, version=Green Hills Multi 7.1.6d / Compiler 2020.1.4
    resource consumption ResourceConsumption
      5 x memory section:
        THERMAL_CODE: alignment=UNSPECIFIED, sw-addrmethod=CODE, symbol=CODE
        THERMAL_CONFIG_DATA_UNSPECIFIED: alignment=UNSPECIFIED, sw-addrmethod=CONFIG_DATA, symbol=CONFIG_DATA_UNSPECIFIED
        THERMAL_CONST_UNSPECIFIED: alignment=UNSPECIFIED, sw-addrmethod=CONST, symbol=CONST_UNSPECIFIED
        THERMAL_VAR_CLEARED_BOOLEAN: alignment=BOOLEAN, sw-addrmethod=VAR_CLEARED, symbol=VAR_CLEARED_BOOLEAN
        THERMAL_VAR_CLEARED_UNSPECIFIED: alignment=UNSPECIFIED, sw-addrmethod=VAR_CLEARED, symbol=VAR_CLEARED_UNSPECIFIED
