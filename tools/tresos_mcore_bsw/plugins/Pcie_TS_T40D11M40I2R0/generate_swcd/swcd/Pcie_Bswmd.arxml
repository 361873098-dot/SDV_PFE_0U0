AUTOSAR XML (schema 00046)
package /AUTOSAR_Pcie/BswModuleDescriptions
  bsw module description Pcie: module-id=255, provided-entrys=[Pcie_Ip_PCIE_0_DmaIRQHandler, Pcie_Ip_PCIE_1_DmaIRQHandler]
    bsw internal behavior InternalBehavior_0
      bsw interrupt entity Pcie_Ip_PCIE_0_DmaIRQHandler: implemented-entry=Pcie_Ip_PCIE_0_DmaIRQHandler, interrupt-category=CAT-2, interrupt-source=Hardware
      bsw interrupt entity Pcie_Ip_PCIE_1_DmaIRQHandler: implemented-entry=Pcie_Ip_PCIE_1_DmaIRQHandler, interrupt-category=CAT-2, interrupt-source=Hardware
package /AUTOSAR_Pcie/BswModuleEntrys
  bsw module entry Pcie_Ip_PCIE_0_DmaIRQHandler: service-id=0, is-reentrant=false, is-synchronous=true, call-type=INTERRUPT, execution-context=INTERRUPT-CAT-2, sw-service-impl-policy=STANDARD
  bsw module entry Pcie_Ip_PCIE_1_DmaIRQHandler: service-id=0, is-reentrant=false, is-synchronous=true, call-type=INTERRUPT, execution-context=INTERRUPT-CAT-2, sw-service-impl-policy=STANDARD
package /Pcie_TS_T40D11M40I2R0/Implementations
  bsw implementation BswImplementation_0: programming-language=C, sw-version=4.0.2, vendor-id=43, ar-release-version=4.4.0, behavior=InternalBehavior_0, vendor-specific-module-def=Pcie
    code-descriptors:
      code Files
        artifact-descriptors:
          short-label=config::Pcie.xdm, category=SWCFG
          short-label=doc::RTD_PCIE_IM.pdf, category=SWDOC
          short-label=doc::RTD_PCIE_UM.pdf, category=SWDOC
          short-label=examples::EBT::S32G2::Pcie_Example_EBT_S32G274A_M7_001::generate::epc::BaseNXP.xdm, category=SWCFG
          short-label=examples::EBT::S32G2::Pcie_Example_EBT_S32G274A_M7_001::generate::epc::EcuC.xdm, category=SWCFG
          short-label=examples::EBT::S32G2::Pcie_Example_EBT_S32G274A_M7_001::generate::epc::Mcu.xdm, category=SWCFG
          short-label=examples::EBT::S32G2::Pcie_Example_EBT_S32G274A_M7_001::generate::epc::Os.xdm, category=SWCFG
          short-label=examples::EBT::S32G2::Pcie_Example_EBT_S32G274A_M7_001::generate::epc::Pcie.xdm, category=SWCFG
          short-label=examples::EBT::S32G2::Pcie_Example_EBT_S32G274A_M7_001::generate::epc::Platform.xdm, category=SWCFG
          short-label=examples::EBT::S32G2::Pcie_Example_EBT_S32G274A_M7_001::generate::epc::Resource.xdm, category=SWCFG
          short-label=examples::EBT::S32G2::Pcie_Example_EBT_S32G274A_M7_001::generate::epc::Serdes.xdm, category=SWCFG
          short-label=examples::EBT::S32G2::Pcie_Example_EBT_S32G274A_M7_001::include::check_example.h, category=SWHDR
          short-label=examples::EBT::S32G2::Pcie_Example_EBT_S32G274A_M7_001::include::Pcie_TC_DVT_0001.h, category=SWHDR
          short-label=examples::EBT::S32G2::Pcie_Example_EBT_S32G274A_M7_001::src::main.c, category=SWSRC
          short-label=examples::EBT::S32G2::Pcie_Example_EBT_S32G274A_M7_001::TresosProject::Pcie_Example_EBT_S32G274A_M7_001::.prefs::preferences.xdm, category=SWCFG
          short-label=examples::EBT::S32G2::Pcie_Example_EBT_S32G274A_M7_001::TresosProject::Pcie_Example_EBT_S32G274A_M7_001::config::BaseNXP.xdm, category=SWCFG
          short-label=examples::EBT::S32G2::Pcie_Example_EBT_S32G274A_M7_001::TresosProject::Pcie_Example_EBT_S32G274A_M7_001::config::EcuC.xdm, category=SWCFG
          short-label=examples::EBT::S32G2::Pcie_Example_EBT_S32G274A_M7_001::TresosProject::Pcie_Example_EBT_S32G274A_M7_001::config::Mcu.xdm, category=SWCFG
          short-label=examples::EBT::S32G2::Pcie_Example_EBT_S32G274A_M7_001::TresosProject::Pcie_Example_EBT_S32G274A_M7_001::config::Os.xdm, category=SWCFG
          short-label=examples::EBT::S32G2::Pcie_Example_EBT_S32G274A_M7_001::TresosProject::Pcie_Example_EBT_S32G274A_M7_001::config::Pcie.xdm, category=SWCFG
          short-label=examples::EBT::S32G2::Pcie_Example_EBT_S32G274A_M7_001::TresosProject::Pcie_Example_EBT_S32G274A_M7_001::config::Platform.xdm, category=SWCFG
          short-label=examples::EBT::S32G2::Pcie_Example_EBT_S32G274A_M7_001::TresosProject::Pcie_Example_EBT_S32G274A_M7_001::config::Resource.xdm, category=SWCFG
          short-label=examples::EBT::S32G2::Pcie_Example_EBT_S32G274A_M7_001::TresosProject::Pcie_Example_EBT_S32G274A_M7_001::config::Serdes.xdm, category=SWCFG
          short-label=examples::EBT::S32G3::Pcie_Example_EBT_S32G399A_M7_001::generate::epc::BaseNXP.xdm, category=SWCFG
          short-label=examples::EBT::S32G3::Pcie_Example_EBT_S32G399A_M7_001::generate::epc::EcuC.xdm, category=SWCFG
          short-label=examples::EBT::S32G3::Pcie_Example_EBT_S32G399A_M7_001::generate::epc::Mcu.xdm, category=SWCFG
          short-label=examples::EBT::S32G3::Pcie_Example_EBT_S32G399A_M7_001::generate::epc::Os.xdm, category=SWCFG
          short-label=examples::EBT::S32G3::Pcie_Example_EBT_S32G399A_M7_001::generate::epc::Pcie.xdm, category=SWCFG
          short-label=examples::EBT::S32G3::Pcie_Example_EBT_S32G399A_M7_001::generate::epc::Platform.xdm, category=SWCFG
          short-label=examples::EBT::S32G3::Pcie_Example_EBT_S32G399A_M7_001::generate::epc::Resource.xdm, category=SWCFG
          short-label=examples::EBT::S32G3::Pcie_Example_EBT_S32G399A_M7_001::generate::epc::Serdes.xdm, category=SWCFG
          short-label=examples::EBT::S32G3::Pcie_Example_EBT_S32G399A_M7_001::include::check_example.h, category=SWHDR
          short-label=examples::EBT::S32G3::Pcie_Example_EBT_S32G399A_M7_001::include::Pcie_TC_DVT_0001.h, category=SWHDR
          short-label=examples::EBT::S32G3::Pcie_Example_EBT_S32G399A_M7_001::src::main.c, category=SWSRC
          short-label=examples::EBT::S32G3::Pcie_Example_EBT_S32G399A_M7_001::TresosProject::Pcie_Example_EBT_S32G399A_M7_001::.prefs::preferences.xdm, category=SWCFG
          short-label=examples::EBT::S32G3::Pcie_Example_EBT_S32G399A_M7_001::TresosProject::Pcie_Example_EBT_S32G399A_M7_001::config::BaseNXP.xdm, category=SWCFG
          short-label=examples::EBT::S32G3::Pcie_Example_EBT_S32G399A_M7_001::TresosProject::Pcie_Example_EBT_S32G399A_M7_001::config::EcuC.xdm, category=SWCFG
          short-label=examples::EBT::S32G3::Pcie_Example_EBT_S32G399A_M7_001::TresosProject::Pcie_Example_EBT_S32G399A_M7_001::config::Mcu.xdm, category=SWCFG
          short-label=examples::EBT::S32G3::Pcie_Example_EBT_S32G399A_M7_001::TresosProject::Pcie_Example_EBT_S32G399A_M7_001::config::Os.xdm, category=SWCFG
          short-label=examples::EBT::S32G3::Pcie_Example_EBT_S32G399A_M7_001::TresosProject::Pcie_Example_EBT_S32G399A_M7_001::config::Pcie.xdm, category=SWCFG
          short-label=examples::EBT::S32G3::Pcie_Example_EBT_S32G399A_M7_001::TresosProject::Pcie_Example_EBT_S32G399A_M7_001::config::Platform.xdm, category=SWCFG
          short-label=examples::EBT::S32G3::Pcie_Example_EBT_S32G399A_M7_001::TresosProject::Pcie_Example_EBT_S32G399A_M7_001::config::Resource.xdm, category=SWCFG
          short-label=examples::EBT::S32G3::Pcie_Example_EBT_S32G399A_M7_001::TresosProject::Pcie_Example_EBT_S32G399A_M7_001::config::Serdes.xdm, category=SWCFG
          short-label=include::Pcie.h, category=SWHDR
          short-label=include::Pcie_Ip.h, category=SWHDR
          short-label=include::Pcie_Ipw.h, category=SWHDR
          short-label=include::Pcie_Ipw_Types.h, category=SWHDR
          short-label=include::Pcie_Ip_HwAccess.h, category=SWHDR
          short-label=include::Pcie_Ip_Irq.h, category=SWHDR
          short-label=include::Pcie_Ip_Types.h, category=SWHDR
          short-label=include::Pcie_Types.h, category=SWHDR
          short-label=src::Pcie.c, category=SWSRC
          short-label=src::Pcie_Ip.c, category=SWSRC
          short-label=src::Pcie_Ipw.c, category=SWSRC
          short-label=src::Pcie_Ip_HwAccess.c, category=SWSRC
          short-label=src::Pcie_Ip_Irq.c, category=SWSRC
    compiler DIAB_Compiler:
      name=Windriver Diab
      options=-tARMCORTEXM7MG:simple -mthumb -std=c99 -Oz -g -fstandalone-debug -Wstrict-prototypes -Wsign-compare -Wdouble-promotion -Wunknown-pragmas -Wundef -Wextra -Wall -pedantic -Werror=implicit-function-declaration -fno-common -fno-signed-char -fno-trigraphs -V -c -DS32XX -DS32G2XX -DS32G3XX -DS32R45 -DDIAB -DUSE_SW_VECTOR_MODE -DD_CACHE_ENABLE -DI_CACHE_ENABLE -DENABLE_FPU -DMCAL_ENABLE_USER_MODE_SUPPORT
      vendor=Windriver
      version=DIAB_7_0_3_0-FCS_20200409_160912
    compiler GCC_Compiler:
      name=GCC Compiler
      options=-mcpu=cortex-m7 -mthumb -mlittle-endian -mfpu=fpv5-sp-d16 -mfloat-abi=hard -std=c99 -Os -ggdb3 -Wall -Wextra -pedantic -Wstrict-prototypes -Wundef -Wunused -Werror=implicit-function-declaration -Wsign-compare -Wdouble-promotion -fno-short-enums -funsigned-char -funsigned-bitfields -fomit-frame-pointer -fno-common -fstack-usage -fdump-ipa-all -c -DS32XX -DS32G2XX -DS32G3XX -DS32R45 -DGCC -DUSE_SW_VECTOR_MODE -DD_CACHE_ENABLE -DI_CACHE_ENABLE -DENABLE_FPU -DMCAL_ENABLE_USER_MODE_SUPPORT
      vendor=GCC Systems
      version=NXP GCC 9.2.0 20190812 (Build 1649 Revision gaf57174)
    compiler GHS_Compiler:
      name=Green Hills
      options=-cpu=cortexm7 -thumb -fpu=vfpv5_d16 -fsingle -C99 --ghstd=last -Osize --gnu_asm -dual_debug -G -keeptempfiles -Wimplicit-int -Wshadow -Wtrigraphs -Wundef --unsigned_chars --unsigned_fields --no_commons --no_exceptions --no_slash_comment --prototype_errors --incorrect_pragma_warnings -c -DS32XX -DS32G2XX -DS32G3XX -DS32R45 -DGHS -DUSE_SW_VECTOR_MODE -DD_CACHE_ENABLE -DI_CACHE_ENABLE -DENABLE_FPU -DMCAL_ENABLE_USER_MODE_SUPPORT
      vendor=Green Hills
      version=Green Hills Multi 7.1.6d / Compiler 2020.1.4
    generated-artifacts:
      8 x dependency on artifact, all with usages=COMPILE:
        Pcie_Cfg_h: artifact-descriptor={short-label=generate_PC::include::Pcie_Cfg.h, category=SWHDR}
        Pcie_Ipw_PBCfg_h: artifact-descriptor={short-label=generate_PC::include::Pcie_Ipw_PBCfg.h, category=SWHDR}
        Pcie_Ip_Cfg_h: artifact-descriptor={short-label=generate_PC::include::Pcie_Ip_Cfg.h, category=SWHDR}
        Pcie_Ip_DeviceReg_h: artifact-descriptor={short-label=generate_PC::include::Pcie_Ip_DeviceReg.h, category=SWHDR}
        Pcie_Ip_PBCfg_h: artifact-descriptor={short-label=generate_PC::include::Pcie_Ip_PBCfg.h, category=SWHDR}
        Pcie_Cfg_c: artifact-descriptor={short-label=generate_PC::src::Pcie_Cfg.c, category=SWSRC}
        Pcie_Ipw_PBCfg_c: artifact-descriptor={short-label=generate_PC::src::Pcie_Ipw_PBCfg.c, category=SWSRC}
        Pcie_Ip_PBCfg_c: artifact-descriptor={short-label=generate_PC::src::Pcie_Ip_PBCfg.c, category=SWSRC}
    linker DIAB_Linker: name=Windriver Diab, options=-e Reset_Handler linker_script_file.dld -m30 -Xstack-usage -Xpreprocess-lecl -Llibrary_path -lc -lm, vendor=Windriver, version=DIAB_7_0_3_0-FCS_20200409_160912
    linker GCC_Linker: name=GCC Compiler, options=-Wl,-Map,filename -T linkerfile --entry=Reset_Handler -nostartfiles -mcpu=cortexm7 -mthumb -mfpu=fpv5-sp-d16 -mfloat-abi=hard -mlittle-endian -ggdb3 -lc -lm -lgcc, vendor=GCC Systems, version=NXP GCC 9.2.0 20190812 (Build 1649 Revision gaf57174)
    linker GHS_Linker: name=Green Hills, options=-e Reset_Handler -T linker_script_file.ld -map -keepmap -Mn -delete -ignore_debug_references -Llibrary_path -larch -lstartup -lind_sd -v -nostartfiles, vendor=Green Hills, version=Green Hills Multi 7.1.6d / Compiler 2020.1.4
    resource consumption ResourceConsumption
      4 x memory section, all with alignment=UNSPECIFIED:
        PCIE_CODE: sw-addrmethod=CODE, symbol=CODE
        PCIE_CONFIG_DATA_UNSPECIFIED: sw-addrmethod=CONFIG_DATA, symbol=CONFIG_DATA_UNSPECIFIED
        PCIE_VAR_CLEARED_UNSPECIFIED: sw-addrmethod=VAR_CLEARED, symbol=VAR_CLEARED_UNSPECIFIED
        PCIE_VAR_CLEARED_UNSPECIFIED_NO_CACHEABLE: sw-addrmethod=VAR_CLEARED_NO_CACHEABLE, symbol=VAR_CLEARED_UNSPECIFIED_NO_CACHEABLE
