AUTOSAR XML (schema 00046)
package /AUTOSAR_Port/BswModuleDescriptions
  bsw module description Port: module-id=124
    provided-entrys:
      Port_GetVersionInfo
      Port_Init
      Port_RefreshPortDirection
      Port_ResetPinMode
      Port_SetAsUnusedPin
      Port_SetAsUsedPin
      Port_SetPinDirection
      Port_SetPinMode
      Siul2_Port_Ip_SetInputBuffer
      Siul2_Port_Ip_SetOutputBuffer
      Siul2_Port_Ip_SetPinDirection
      Siul2_Port_Ip_SetPullSel
    bsw internal behavior InternalBehavior_0
      5 x exclusive area:
        PORT_EXCLUSIVE_AREA_{00..04}
      12 x bsw called entity:
        Port_GetVersionInfo: implemented-entry=Port_GetVersionInfo
        Port_Init: implemented-entry=Port_Init
        Port_RefreshPortDirection: implemented-entry=Port_RefreshPortDirection
        Port_ResetPinMode: implemented-entry=Port_ResetPinMode
        Port_SetAsUnusedPin: implemented-entry=Port_SetAsUnusedPin
        Port_SetAsUsedPin: implemented-entry=Port_SetAsUsedPin
        Port_SetPinDirection: implemented-entry=Port_SetPinDirection
        Port_SetPinMode: can-enter-exclusive-area=PORT_EXCLUSIVE_AREA_00, implemented-entry=Port_SetPinMode
        Siul2_Port_Ip_SetInputBuffer: can-enter-exclusive-area=PORT_EXCLUSIVE_AREA_03, implemented-entry=Siul2_Port_Ip_SetInputBuffer
        Siul2_Port_Ip_SetOutputBuffer: can-enter-exclusive-area=PORT_EXCLUSIVE_AREA_02, implemented-entry=Siul2_Port_Ip_SetOutputBuffer
        Siul2_Port_Ip_SetPinDirection: can-enter-exclusive-area=PORT_EXCLUSIVE_AREA_04, implemented-entry=Siul2_Port_Ip_SetPinDirection
        Siul2_Port_Ip_SetPullSel: can-enter-exclusive-area=PORT_EXCLUSIVE_AREA_01, implemented-entry=Siul2_Port_Ip_SetPullSel
package /AUTOSAR_Port/BswModuleEntrys
  12 x bsw module entry, all with is-synchronous=true, call-type=REGULAR, execution-context=UNSPECIFIED, sw-service-impl-policy=STANDARD:
    Port_GetVersionInfo: service-id=0x03, is-reentrant=true
    Port_Init: service-id=0x00, is-reentrant=false
    Port_RefreshPortDirection: service-id=0x02, is-reentrant=false
    Port_ResetPinMode: service-id=0x07, is-reentrant=false
    Port_SetAsUnusedPin: service-id=0x05, is-reentrant=false
    Port_SetAsUsedPin: service-id=0x06, is-reentrant=false
    Port_SetPinDirection: service-id=0x01, is-reentrant=true
    Port_SetPinMode: service-id=0x04, is-reentrant=true
    Siul2_Port_Ip_SetInputBuffer: service-id=0xf2, is-reentrant=false
    Siul2_Port_Ip_SetOutputBuffer: service-id=0xf1, is-reentrant=false
    Siul2_Port_Ip_SetPinDirection: service-id=0xf3, is-reentrant=false
    Siul2_Port_Ip_SetPullSel: service-id=0xf0, is-reentrant=false
package /Port_TS_T40D11M40I0R0/Implementations
  bsw implementation BswImplementation_0: programming-language=C, sw-version=4.0.0, vendor-id=43, ar-release-version=4.4.0, behavior=InternalBehavior_0, recommended-configuration=Port, vendor-specific-module-def=Port
    code-descriptors:
      code Files
        artifact-descriptors:
          short-label=config::Port.xdm, category=SWCFG
          short-label=config_ext::PortRecConfiguration_JtagPins.xdm, category=SWCFG
          short-label=doc::RTD_PORT_IM.pdf, category=SWDOC
          short-label=doc::RTD_PORT_UM.pdf, category=SWDOC
          short-label=examples::EBT::S32G2::Port_ToggleLed_S32G274A_M7::generate::epc::Base.xdm, category=SWCFG
          short-label=examples::EBT::S32G2::Port_ToggleLed_S32G274A_M7::generate::epc::Dem.xdm, category=SWCFG
          short-label=examples::EBT::S32G2::Port_ToggleLed_S32G274A_M7::generate::epc::Dio.xdm, category=SWCFG
          short-label=examples::EBT::S32G2::Port_ToggleLed_S32G274A_M7::generate::epc::EcuC.xdm, category=SWCFG
          short-label=examples::EBT::S32G2::Port_ToggleLed_S32G274A_M7::generate::epc::Mcu.xdm, category=SWCFG
          short-label=examples::EBT::S32G2::Port_ToggleLed_S32G274A_M7::generate::epc::Port.xdm, category=SWCFG
          short-label=examples::EBT::S32G2::Port_ToggleLed_S32G274A_M7::generate::epc::Resource.xdm, category=SWCFG
          short-label=examples::EBT::S32G2::Port_ToggleLed_S32G274A_M7::include::check_example.h, category=SWHDR
          short-label=examples::EBT::S32G2::Port_ToggleLed_S32G274A_M7::src::main.c, category=SWSRC
          short-label=examples::EBT::S32G2::Port_ToggleLed_S32G274A_M7::TresosProject::Port_ToggleLed_S32G274A_M7::.prefs::preferences.xdm, category=SWCFG
          short-label=examples::EBT::S32G2::Port_ToggleLed_S32G274A_M7::TresosProject::Port_ToggleLed_S32G274A_M7::config::Base.xdm, category=SWCFG
          short-label=examples::EBT::S32G2::Port_ToggleLed_S32G274A_M7::TresosProject::Port_ToggleLed_S32G274A_M7::config::Dem.xdm, category=SWCFG
          short-label=examples::EBT::S32G2::Port_ToggleLed_S32G274A_M7::TresosProject::Port_ToggleLed_S32G274A_M7::config::Dio.xdm, category=SWCFG
          short-label=examples::EBT::S32G2::Port_ToggleLed_S32G274A_M7::TresosProject::Port_ToggleLed_S32G274A_M7::config::EcuC.xdm, category=SWCFG
          short-label=examples::EBT::S32G2::Port_ToggleLed_S32G274A_M7::TresosProject::Port_ToggleLed_S32G274A_M7::config::Mcu.xdm, category=SWCFG
          short-label=examples::EBT::S32G2::Port_ToggleLed_S32G274A_M7::TresosProject::Port_ToggleLed_S32G274A_M7::config::Port.xdm, category=SWCFG
          short-label=examples::EBT::S32G2::Port_ToggleLed_S32G274A_M7::TresosProject::Port_ToggleLed_S32G274A_M7::config::Resource.xdm, category=SWCFG
          short-label=examples::EBT::S32G3::Port_ToggleLed_S32G399A_M7::generate::epc::Base.xdm, category=SWCFG
          short-label=examples::EBT::S32G3::Port_ToggleLed_S32G399A_M7::generate::epc::Dem.xdm, category=SWCFG
          short-label=examples::EBT::S32G3::Port_ToggleLed_S32G399A_M7::generate::epc::Dio.xdm, category=SWCFG
          short-label=examples::EBT::S32G3::Port_ToggleLed_S32G399A_M7::generate::epc::EcuC.xdm, category=SWCFG
          short-label=examples::EBT::S32G3::Port_ToggleLed_S32G399A_M7::generate::epc::Mcu.xdm, category=SWCFG
          short-label=examples::EBT::S32G3::Port_ToggleLed_S32G399A_M7::generate::epc::Port.xdm, category=SWCFG
          short-label=examples::EBT::S32G3::Port_ToggleLed_S32G399A_M7::generate::epc::Resource.xdm, category=SWCFG
          short-label=examples::EBT::S32G3::Port_ToggleLed_S32G399A_M7::include::check_example.h, category=SWHDR
          short-label=examples::EBT::S32G3::Port_ToggleLed_S32G399A_M7::src::main.c, category=SWSRC
          short-label=examples::EBT::S32G3::Port_ToggleLed_S32G399A_M7::TresosProject::Port_ToggleLed_S32G399A_M7::.prefs::preferences.xdm, category=SWCFG
          short-label=examples::EBT::S32G3::Port_ToggleLed_S32G399A_M7::TresosProject::Port_ToggleLed_S32G399A_M7::config::Base.xdm, category=SWCFG
          short-label=examples::EBT::S32G3::Port_ToggleLed_S32G399A_M7::TresosProject::Port_ToggleLed_S32G399A_M7::config::Dem.xdm, category=SWCFG
          short-label=examples::EBT::S32G3::Port_ToggleLed_S32G399A_M7::TresosProject::Port_ToggleLed_S32G399A_M7::config::Dio.xdm, category=SWCFG
          short-label=examples::EBT::S32G3::Port_ToggleLed_S32G399A_M7::TresosProject::Port_ToggleLed_S32G399A_M7::config::EcuC.xdm, category=SWCFG
          short-label=examples::EBT::S32G3::Port_ToggleLed_S32G399A_M7::TresosProject::Port_ToggleLed_S32G399A_M7::config::Mcu.xdm, category=SWCFG
          short-label=examples::EBT::S32G3::Port_ToggleLed_S32G399A_M7::TresosProject::Port_ToggleLed_S32G399A_M7::config::Port.xdm, category=SWCFG
          short-label=examples::EBT::S32G3::Port_ToggleLed_S32G399A_M7::TresosProject::Port_ToggleLed_S32G399A_M7::config::Resource.xdm, category=SWCFG
          short-label=examples::EBT::S32R45::Port_ToggleLed_S32R45_M7::generate::epc::Base.xdm, category=SWCFG
          short-label=examples::EBT::S32R45::Port_ToggleLed_S32R45_M7::generate::epc::Dem.xdm, category=SWCFG
          short-label=examples::EBT::S32R45::Port_ToggleLed_S32R45_M7::generate::epc::Dio.xdm, category=SWCFG
          short-label=examples::EBT::S32R45::Port_ToggleLed_S32R45_M7::generate::epc::EcuC.xdm, category=SWCFG
          short-label=examples::EBT::S32R45::Port_ToggleLed_S32R45_M7::generate::epc::Mcu.xdm, category=SWCFG
          short-label=examples::EBT::S32R45::Port_ToggleLed_S32R45_M7::generate::epc::Port.xdm, category=SWCFG
          short-label=examples::EBT::S32R45::Port_ToggleLed_S32R45_M7::generate::epc::Resource.xdm, category=SWCFG
          short-label=examples::EBT::S32R45::Port_ToggleLed_S32R45_M7::include::check_example.h, category=SWHDR
          short-label=examples::EBT::S32R45::Port_ToggleLed_S32R45_M7::src::main.c, category=SWSRC
          short-label=examples::EBT::S32R45::Port_ToggleLed_S32R45_M7::TresosProject::Port_ToggleLed_S32R45_M7::.prefs::preferences.xdm, category=SWCFG
          short-label=examples::EBT::S32R45::Port_ToggleLed_S32R45_M7::TresosProject::Port_ToggleLed_S32R45_M7::config::Base.xdm, category=SWCFG
          short-label=examples::EBT::S32R45::Port_ToggleLed_S32R45_M7::TresosProject::Port_ToggleLed_S32R45_M7::config::Dem.xdm, category=SWCFG
          short-label=examples::EBT::S32R45::Port_ToggleLed_S32R45_M7::TresosProject::Port_ToggleLed_S32R45_M7::config::Dio.xdm, category=SWCFG
          short-label=examples::EBT::S32R45::Port_ToggleLed_S32R45_M7::TresosProject::Port_ToggleLed_S32R45_M7::config::EcuC.xdm, category=SWCFG
          short-label=examples::EBT::S32R45::Port_ToggleLed_S32R45_M7::TresosProject::Port_ToggleLed_S32R45_M7::config::Mcu.xdm, category=SWCFG
          short-label=examples::EBT::S32R45::Port_ToggleLed_S32R45_M7::TresosProject::Port_ToggleLed_S32R45_M7::config::Port.xdm, category=SWCFG
          short-label=examples::EBT::S32R45::Port_ToggleLed_S32R45_M7::TresosProject::Port_ToggleLed_S32R45_M7::config::Resource.xdm, category=SWCFG
          short-label=examples::S32DS::S32G2::Port_ToggleLed_S32G274A_M7::include::check_example.h, category=SWHDR
          short-label=examples::S32DS::S32G2::Port_ToggleLed_S32G274A_M7::Project_Settings::Startup_Code::exceptions.c, category=SWSRC
          short-label=examples::S32DS::S32G2::Port_ToggleLed_S32G274A_M7::Project_Settings::Startup_Code::nvic.c, category=SWSRC
          short-label=examples::S32DS::S32G2::Port_ToggleLed_S32G274A_M7::Project_Settings::Startup_Code::startup.c, category=SWSRC
          short-label=examples::S32DS::S32G2::Port_ToggleLed_S32G274A_M7::Project_Settings::Startup_Code::system.c, category=SWSRC
          short-label=examples::S32DS::S32G2::Port_ToggleLed_S32G274A_M7::src::main.c, category=SWSRC
          short-label=examples::S32DS::S32G2::Siul2_Port_ToggleLed_S32G274A_M7::include::check_example.h, category=SWHDR
          short-label=examples::S32DS::S32G2::Siul2_Port_ToggleLed_S32G274A_M7::Project_Settings::Startup_Code::exceptions.c, category=SWSRC
          short-label=examples::S32DS::S32G2::Siul2_Port_ToggleLed_S32G274A_M7::Project_Settings::Startup_Code::nvic.c, category=SWSRC
          short-label=examples::S32DS::S32G2::Siul2_Port_ToggleLed_S32G274A_M7::Project_Settings::Startup_Code::startup.c, category=SWSRC
          short-label=examples::S32DS::S32G2::Siul2_Port_ToggleLed_S32G274A_M7::Project_Settings::Startup_Code::system.c, category=SWSRC
          short-label=examples::S32DS::S32G2::Siul2_Port_ToggleLed_S32G274A_M7::src::main.c, category=SWSRC
          short-label=examples::S32DS::S32G3::Port_ToggleLed_S32G399A_M7::include::check_example.h, category=SWHDR
          short-label=examples::S32DS::S32G3::Port_ToggleLed_S32G399A_M7::Project_Settings::Startup_Code::exceptions.c, category=SWSRC
          short-label=examples::S32DS::S32G3::Port_ToggleLed_S32G399A_M7::Project_Settings::Startup_Code::nvic.c, category=SWSRC
          short-label=examples::S32DS::S32G3::Port_ToggleLed_S32G399A_M7::Project_Settings::Startup_Code::startup.c, category=SWSRC
          short-label=examples::S32DS::S32G3::Port_ToggleLed_S32G399A_M7::Project_Settings::Startup_Code::system.c, category=SWSRC
          short-label=examples::S32DS::S32G3::Port_ToggleLed_S32G399A_M7::src::main.c, category=SWSRC
          short-label=examples::S32DS::S32G3::Siul2_Port_ToggleLed_S32G399A_M7::include::check_example.h, category=SWHDR
          short-label=examples::S32DS::S32G3::Siul2_Port_ToggleLed_S32G399A_M7::Project_Settings::Startup_Code::exceptions.c, category=SWSRC
          short-label=examples::S32DS::S32G3::Siul2_Port_ToggleLed_S32G399A_M7::Project_Settings::Startup_Code::nvic.c, category=SWSRC
          short-label=examples::S32DS::S32G3::Siul2_Port_ToggleLed_S32G399A_M7::Project_Settings::Startup_Code::startup.c, category=SWSRC
          short-label=examples::S32DS::S32G3::Siul2_Port_ToggleLed_S32G399A_M7::Project_Settings::Startup_Code::system.c, category=SWSRC
          short-label=examples::S32DS::S32G3::Siul2_Port_ToggleLed_S32G399A_M7::src::main.c, category=SWSRC
          short-label=examples::S32DS::S32R45::Port_ToggleLed_S32R45_M7::include::check_example.h, category=SWHDR
          short-label=examples::S32DS::S32R45::Port_ToggleLed_S32R45_M7::Project_Settings::Startup_Code::exceptions.c, category=SWSRC
          short-label=examples::S32DS::S32R45::Port_ToggleLed_S32R45_M7::Project_Settings::Startup_Code::nvic.c, category=SWSRC
          short-label=examples::S32DS::S32R45::Port_ToggleLed_S32R45_M7::Project_Settings::Startup_Code::startup.c, category=SWSRC
          short-label=examples::S32DS::S32R45::Port_ToggleLed_S32R45_M7::Project_Settings::Startup_Code::system.c, category=SWSRC
          short-label=examples::S32DS::S32R45::Port_ToggleLed_S32R45_M7::src::main.c, category=SWSRC
          short-label=examples::S32DS::S32R45::Siul2_Port_ToggleLed_S32R45_M7::include::check_example.h, category=SWHDR
          short-label=examples::S32DS::S32R45::Siul2_Port_ToggleLed_S32R45_M7::Project_Settings::Startup_Code::exceptions.c, category=SWSRC
          short-label=examples::S32DS::S32R45::Siul2_Port_ToggleLed_S32R45_M7::Project_Settings::Startup_Code::nvic.c, category=SWSRC
          short-label=examples::S32DS::S32R45::Siul2_Port_ToggleLed_S32R45_M7::Project_Settings::Startup_Code::startup.c, category=SWSRC
          short-label=examples::S32DS::S32R45::Siul2_Port_ToggleLed_S32R45_M7::Project_Settings::Startup_Code::system.c, category=SWSRC
          short-label=examples::S32DS::S32R45::Siul2_Port_ToggleLed_S32R45_M7::src::main.c, category=SWSRC
          short-label=include::Port.h, category=SWHDR
          short-label=include::Port_Ipw.h, category=SWHDR
          short-label=include::Siul2_Port_Ip.h, category=SWHDR
          short-label=include::Siul2_Port_Ip_TrustedFunctions.h, category=SWHDR
          short-label=include::Siul2_Port_Ip_Types.h, category=SWHDR
          short-label=src::Port.c, category=SWSRC
          short-label=src::Port_Ipw.c, category=SWSRC
          short-label=src::Siul2_Port_Ip.c, category=SWSRC
    compiler DIAB_Compiler:
      name=Windriver Diab
      options=-tARMCORTEXM7MG:simple -mthumb -std=c99 -Oz -g -fstandalone-debug -Wstrict-prototypes -Wsign-compare -Wdouble-promotion -Wunknown-pragmas -Wundef -Wextra -Wall -pedantic -Werror=implicit-function-declaration -fno-common -fno-signed-char -fno-trigraphs -V -c -DS32XX -DS32G2XX -DDIAB -DUSE_SW_VECTOR_MODE -DD_CACHE_ENABLE -DI_CACHE_ENABLE -DENABLE_FPU -DMCAL_ENABLE_USER_MODE_SUPPORT
      vendor=Windriver
      version=DIAB_7_0_3_0-FCS_20200409_160912
    compiler GCC_Compiler:
      name=GCC Compiler
      options=-mcpu=cortex-m7 -mthumb -mlittle-endian -mfpu=fpv5-sp-d16 -mfloat-abi=hard -std=c99 -Os -ggdb3 -Wall -Wextra -pedantic -Wstrict-prototypes -Wundef -Wunused -Werror=implicit-function-declaration -Wsign-compare -Wdouble-promotion -fno-short-enums -funsigned-char -funsigned-bitfields -fomit-frame-pointer -fno-common -fstack-usage -fdump-ipa-all -c -DS32XX -DS32G2XX -DGCC -DUSE_SW_VECTOR_MODE -DD_CACHE_ENABLE -DI_CACHE_ENABLE -DENABLE_FPU -DMCAL_ENABLE_USER_MODE_SUPPORT
      vendor=GCC Systems
      version=NXP GCC 9.2.0 20190812 (Build 1649 Revision gaf57174)
    compiler GHS_Compiler:
      name=Green Hills
      options=-cpu=cortexm7 -thumb -fpu=vfpv5_d16 -fsingle -C99 --ghstd=last -Osize --gnu_asm -dual_debug -G -keeptempfiles -Wimplicit-int -Wshadow -Wtrigraphs -Wundef --unsigned_chars --unsigned_fields --no_commons --no_exceptions --no_slash_comment --prototype_errors --incorrect_pragma_warnings -c -DS32XX -DS32G2XX -DGHS -DUSE_SW_VECTOR_MODE -DD_CACHE_ENABLE -DI_CACHE_ENABLE -DENABLE_FPU -DMCAL_ENABLE_USER_MODE_SUPPORT
      vendor=Green Hills
      version=Green Hills Multi 7.1.6d / Compiler 2020.1.4
    generated-artifacts:
      8 x dependency on artifact:
        Port_PBcfg_h: artifact-descriptor={short-label=generate_PB::include::Port_PBcfg.h, category=SWHDR}, usages=EXECUTE
        Siul2_Port_Ip_PBcfg_h: artifact-descriptor={short-label=generate_PB::include::Siul2_Port_Ip_PBcfg.h, category=SWHDR}, usages=EXECUTE
        Port_PBcfg_c: artifact-descriptor={short-label=generate_PB::src::Port_PBcfg.c, category=SWSRC}, usages=EXECUTE
        Siul2_Port_Ip_PBcfg_c: artifact-descriptor={short-label=generate_PB::src::Siul2_Port_Ip_PBcfg.c, category=SWSRC}, usages=EXECUTE
        Port_Cfg_h: artifact-descriptor={short-label=generate_PC::include::Port_Cfg.h, category=SWHDR}, usages=COMPILE
        Siul2_Port_Ip_Cfg_h: artifact-descriptor={short-label=generate_PC::include::Siul2_Port_Ip_Cfg.h, category=SWHDR}, usages=COMPILE
        Siul2_Port_Ip_Defines_h: artifact-descriptor={short-label=generate_PC::include::Siul2_Port_Ip_Defines.h, category=SWHDR}, usages=COMPILE
        Port_Cfg_c: artifact-descriptor={short-label=generate_PC::src::Port_Cfg.c, category=SWSRC}, usages=COMPILE
    linker DIAB_Linker: name=Windriver Diab, options=-e Reset_Handler linker_script_file.dld -m30 -Xstack-usage -Xpreprocess-lecl -Llibrary_path -lc -lm, vendor=Windriver, version=DIAB_7_0_3_0-FCS_20200409_160912
    linker GCC_Linker: name=GCC Compiler, options=-Wl,-Map,filename -T linkerfile --entry=Reset_Handler -nostartfiles -mcpu=cortexm7 -mthumb -mfpu=fpv5-sp-d16 -mfloat-abi=hard -mlittle-endian -ggdb3 -lc -lm -lgcc, vendor=GCC Systems, version=NXP GCC 9.2.0 20190812 (Build 1649 Revision gaf57174)
    linker GHS_Linker: name=Green Hills, options=-e Reset_Handler -T linker_script_file.ld -map -keepmap -Mn -delete -ignore_debug_references -Llibrary_path -larch -lstartup -lind_sd -v -nostartfiles, vendor=Green Hills, version=Green Hills Multi 7.1.6d / Compiler 2020.1.4
    resource consumption ResourceConsumption
      12 x memory section:
        PORT_CODE: alignment=UNSPECIFIED, sw-addrmethod=CODE, symbol=CODE
        PORT_CONFIG_DATA_16: alignment=16, sw-addrmethod=CONFIG_DATA, symbol=CONFIG_DATA_16
        PORT_CONFIG_DATA_32: alignment=32, sw-addrmethod=CONFIG_DATA, symbol=CONFIG_DATA_32
        PORT_CONFIG_DATA_8: alignment=8, sw-addrmethod=CONFIG_DATA, symbol=CONFIG_DATA_8
        PORT_CONFIG_DATA_UNSPECIFIED: alignment=UNSPECIFIED, sw-addrmethod=CONFIG_DATA, symbol=CONFIG_DATA_UNSPECIFIED
        PORT_CONST_16: alignment=16, sw-addrmethod=CONST, symbol=CONST_16
        PORT_CONST_32: alignment=32, sw-addrmethod=CONST, symbol=CONST_32
        PORT_CONST_UNSPECIFIED: alignment=UNSPECIFIED, sw-addrmethod=CONST, symbol=CONST_UNSPECIFIED
        PORT_VAR_CLEARED_16_NO_CACHEABLE: alignment=16, sw-addrmethod=VAR_CLEARED_NO_CACHEABLE, symbol=VAR_CLEARED_16_NO_CACHEABLE
        PORT_VAR_CLEARED_32: alignment=32, sw-addrmethod=VAR_CLEARED, symbol=VAR_CLEARED_32
        PORT_VAR_CLEARED_UNSPECIFIED: alignment=UNSPECIFIED, sw-addrmethod=VAR_CLEARED, symbol=VAR_CLEARED_UNSPECIFIED
        PORT_VAR_CLEARED_UNSPECIFIED_NO_CACHEABLE: alignment=UNSPECIFIED, sw-addrmethod=VAR_CLEARED_NO_CACHEABLE, symbol=VAR_CLEARED_UNSPECIFIED_NO_CACHEABLE
