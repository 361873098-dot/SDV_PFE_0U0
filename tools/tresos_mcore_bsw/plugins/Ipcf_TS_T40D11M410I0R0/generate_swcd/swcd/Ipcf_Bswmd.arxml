AUTOSAR XML (schema 00050)
package /AUTOSAR_Ipcf/BswModuleDescriptions
  bsw module description Ipcf: module-id=255
    provided-entrys:
      ipc_shm_acquire_buf
      ipc_shm_free
      ipc_shm_free_instance
      ipc_shm_init
      ipc_shm_init_instance
      ipc_shm_is_remote_ready
      ipc_shm_poll_channels
      ipc_shm_release_buf
      ipc_shm_tx
      ipc_shm_unmanaged_acquire
      ipc_shm_unmanaged_tx
    bsw internal behavior InternalBehavior_0
      11 x bsw called entity:
        ipc_shm_acquire_buf: implemented-entry=ipc_shm_acquire_buf
        ipc_shm_free: implemented-entry=ipc_shm_free
        ipc_shm_free_instance: implemented-entry=ipc_shm_free_instance
        ipc_shm_init: implemented-entry=ipc_shm_init
        ipc_shm_init_instance: implemented-entry=ipc_shm_init_instance
        ipc_shm_is_remote_ready: implemented-entry=ipc_shm_is_remote_ready
        ipc_shm_poll_channels: implemented-entry=ipc_shm_poll_channels
        ipc_shm_release_buf: implemented-entry=ipc_shm_release_buf
        ipc_shm_tx: implemented-entry=ipc_shm_tx
        ipc_shm_unmanaged_acquire: implemented-entry=ipc_shm_unmanaged_acquire
        ipc_shm_unmanaged_tx: implemented-entry=ipc_shm_unmanaged_tx
package /AUTOSAR_Ipcf/BswModuleEntrys
  11 x bsw module entry, all with is-reentrant=false, is-synchronous=true, call-type=REGULAR, execution-context=UNSPECIFIED, sw-service-impl-policy=STANDARD:
    ipc_shm_acquire_buf: service-id=0x05
    ipc_shm_free: service-id=0x01
    ipc_shm_free_instance: service-id=0x02
    ipc_shm_init: service-id=0x03
    ipc_shm_init_instance: service-id=0x04
    ipc_shm_is_remote_ready: service-id=0x0a
    ipc_shm_poll_channels: service-id=0x0b
    ipc_shm_release_buf: service-id=0x06
    ipc_shm_tx: service-id=0x07
    ipc_shm_unmanaged_acquire: service-id=0x08
    ipc_shm_unmanaged_tx: service-id=0x09
package /Ipcf_TS_T40D11M410I0R0/Implementations
  bsw implementation BswImplementation_0: programming-language=C, sw-version=4.10.0, vendor-id=43, ar-release-version=4.7.0, behavior=InternalBehavior_0, vendor-specific-module-def=Ipcf
    code-descriptors:
      code Files
        artifact-descriptors:
          short-label=src::common::ipc-queue.c, category=SWSRC
          short-label=src::common::ipc-queue.h, category=SWHDR
          short-label=src::common::ipc-shm.c, category=SWSRC
          short-label=src::common::ipc-shm.h, category=SWHDR
          short-label=src::common::ipc-types.h, category=SWHDR
          short-label=src::common::ipc-util.c, category=SWSRC
          short-label=src::common::ipc-util.h, category=SWHDR
          short-label=src::hw::ipc-hw.h, category=SWHDR
          short-label=src::hw::s32gen1::ipc-hw-platform.h, category=SWHDR
          short-label=src::hw::s32gen1::ipc-hw-s32gen1.c, category=SWSRC
          short-label=src::hw::s32g3xx::ipc-hw-platform.h, category=SWHDR
          short-label=src::hw::s32g3xx::ipc-hw-s32g3xx.c, category=SWSRC
          short-label=src::os::autosar::ipc-os-autosar.c, category=SWSRC
          short-label=src::os::baremetal::ipc-os-baremetal.c, category=SWSRC
          short-label=src::os::freertos::ipc-os-freertos.c, category=SWSRC
          short-label=src::os::ipc-os.h, category=SWHDR
    compiler DIAB_Compiler:
      name=Windriver Diab
      options=-DSINTRAM -DDISABLE_MCAL_INTERMODULE_ASR_CHECK -DD_CACHE_ENABLE_NOT -DI_CACHE_ENABLE -DENABLE_FPU -DCPU_CORTEX_M7 -DMPU_ENABLE -tARMCORTEXM7MG:simple -DS32G3XX -DS32G3XX -S32G399A -DDIAB -DEU_DISABLE_ANSILIB_CALLS -DUSE_SW_VECTOR_MODE -c -mthumb -std=c99 -Oz -g -fstandalone-debug -Wstrict-prototypes -Wsign-compare -Wdouble-promotion -Wunknown-pragmas -Wundef -Wextra -Wall -pedantic -Werror=implicit-function-declaration -fno-common -fno-signed-char -fno-trigraphs
      vendor=Windriver
      version=Windriver DIAB v7.0.3
    compiler GCC_Compiler:
      name=GCC Compiler
      options=-DSINTRAM -DDISABLE_MCAL_INTERMODULE_ASR_CHECK -DD_CACHE_ENABLE_NOT -DI_CACHE_ENABLE -DENABLE_FPU -DCPU_CORTEX_M7 -DMPU_ENABLE -DS32G3XX -DS32G3XX -S32G399A -DGCC -DEU_DISABLE_ANSILIB_CALLS -DUSE_SW_VECTOR_MODE -c -mcpu=cortex-m7 -mthumb -std=c99 -Os -mfpu=fpv5-sp-d16 -mfloat-abi=hard -ggdb3 -mlittle-endian -Wall -Wextra -Wstrict-prototypes -Wundef -Wunused -Werror=implicit-function-declaration -Wsign-compare -Wdouble-promotion -fno-short-enums -funsigned-char -funsigned-bitfields -fno-common -pedantic --sysroot=$(GCC_DIR)/arm-none-eabi/newlib -specs=nano.specs -specs=nosys.specs
      vendor=GCC Systems
      version=NXP GCC 9.2.0
    compiler GHS_Compiler:
      name=Green Hills
      options=-DSINTRAM -DDISABLE_MCAL_INTERMODULE_ASR_CHECK -DD_CACHE_ENABLE_NOT -DI_CACHE_ENABLE -DENABLE_FPU -DCPU_CORTEX_M7 -DMPU_ENABLE -DS32G3XX -DS32G3XX -S32G399A -DGHS -DEU_DISABLE_ANSILIB_CALLS -DUSE_SW_VECTOR_MODE -c -cpu=cortexm7 -thumb -fpu=vfpv5_d16 -fsingle -C99 --ghstd=last -Osize --gnu_asm -dual_debug -G -keeptempfiles -Wimplicit-int -Wshadow -Wtrigraphs -Wundef --unsigned_chars --unsigned_fields --no_commons --no_exceptions --no_slash_comment --prototype_errors --incorrect_pragma_warnings
      vendor=Green Hills
      version=Green Hills Multi 7.1.6d
    generated-artifacts:
      dependency on artifact ipcf_Ip_Cfg_Defines_h: artifact-descriptor={short-label=generate_PC::include::ipcf_Ip_Cfg_Defines.h, category=SWHDR}, usages=COMPILE
      dependency on artifact ipcf_Ip_Cfg_c: artifact-descriptor={short-label=generate_PC::src::ipcf_Ip_Cfg.c, category=SWSRC}, usages=COMPILE
      dependency on artifact ipcf_Ip_Cfg_h: artifact-descriptor={short-label=generate_PC::include::ipcf_Ip_Cfg.h, category=SWHDR}, usages=COMPILE
    linker DIAB_Linker: name=Windriver Diab, options=-tARMCORTEXM7MG:simple -e Reset_Handle -m30 -Xstack-usage -Xpreprocess-lecl -Xremove-unused-sections -L$(DIAB_DIR)/ARMV7EMMG -lc -lm lcf/diab/linker_ram.dld, vendor=Windriver, version=Windriver DIAB v7.0.3
    linker GCC_Linker: name=GCC Compiler, options=--entry=Reset_Handler --sysroot=$(GCC_DIR)/arm-none-eabi/newlib -specs=nano.specs -specs=nosys.specs -nostartfiles -mcpu=cortex-m7 -mthumb -mfpu=fpv5-sp-d16 -mfloat-abi=hard -ggdb3 -mlittle-endian -lc -lm -lgcc -T lcf/gcc/linker_ram.ld, vendor=GCC Systems, version=NXP GCC 9.2.0
    linker GHS_Linker: name=Green Hills, options=-e Reset_Handler -map -keepmap -Mn -delete -ignore_debug_references -lnk=-keep=C40_Ip_AccessCode -L$(GHS_DIR)/lib/thumb2 -larch -lstartup -lind_sd -lnk=-v -nostartfiles -T lcf/ghs/linker_ram.ld, vendor=Green Hills, version=Green Hills Multi 7.1.6d
    resource consumption ResourceConsumption
      memory section IPCF_CODE: alignment=UNSPECIFIED, sw-addrmethod=CODE, symbol=CODE
      memory section IPCF_CONFIG_DATA_UNSPECIFIED: alignment=UNSPECIFIED, sw-addrmethod=CONFIG_DATA, symbol=CONFIG_DATA_UNSPECIFIED
