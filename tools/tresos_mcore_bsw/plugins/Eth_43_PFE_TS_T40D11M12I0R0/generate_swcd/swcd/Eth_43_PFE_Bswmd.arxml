[part 1 of 2]
<?xml version="1.0" encoding="ISO-8859-1"?>
<!--
 *  Project              : AUTOSAR 4.4 MCAL
 *  Platform             : CORTEXM
 *  Peripheral           : PFE
 *  Dependencies         : none
 *
 *  Autosar Version      : 4.4.0
 *  Autosar Revision     : ASR_REL_4_4_REV_0000
 *  Autosar Conf.Variant :
 *  SW Version           : 1.2.0
 *  Build Version        : PFE-DRV_S32G_M7_MCAL_1.2.0_D2307_ASR_REL_4_4_REV_0000_20230728
 *
 *  Copyright 2019-2023 NXP
 *
 *  NXP Confidential and Proprietary. This software is owned or controlled by NXP and may only
 *  be used strictly in accordance with the applicable license terms. By
 *  expressly accepting such terms or by downloading, installing, activating
 *  and/or otherwise using the software, you are agreeing that you have read,
 *  and that you agree to comply with and are bound by, such license terms. If
 *  you do not agree to be bound by the applicable license terms, then you may
 *  not retain, install, activate or otherwise use the software.
 *  <<< PFE Restricted Software >>>
 *
-->
<AUTOSAR xmlns="http://autosar.org/schema/r4.0"
        xmlns:xsi="http://www.w3.org/2001/XMLSchema-instance"
        xsi:schemaLocation="http://autosar.org/schema/r4.0 AUTOSAR_4-0-3_STRICT_COMPACT.xsd">

  <AR-PACKAGES>
    <AR-PACKAGE>
      <SHORT-NAME>AUTOSAR_Eth_43_PFE</SHORT-NAME>
      <AR-PACKAGES>
        <AR-PACKAGE>
          <SHORT-NAME>BswModuleDescriptions</SHORT-NAME>
          <ELEMENTS>
            <BSW-MODULE-DESCRIPTION>
              <SHORT-NAME>Eth</SHORT-NAME>
              <MODULE-ID>88</MODULE-ID>
              <PROVIDED-ENTRYS>
                <BSW-MODULE-ENTRY-REF-CONDITIONAL>
                  <BSW-MODULE-ENTRY-REF DEST="BSW-MODULE-ENTRY">/AUTOSAR_Eth_43_PFE/BswModuleEntrys/Eth_Init</BSW-MODULE-ENTRY-REF>
                </BSW-MODULE-ENTRY-REF-CONDITIONAL>
                <BSW-MODULE-ENTRY-REF-CONDITIONAL>
                  <BSW-MODULE-ENTRY-REF DEST="BSW-MODULE-ENTRY">/AUTOSAR_Eth_43_PFE/BswModuleEntrys/Eth_DeInit</BSW-MODULE-ENTRY-REF>
                </BSW-MODULE-ENTRY-REF-CONDITIONAL>
                <BSW-MODULE-ENTRY-REF-CONDITIONAL>
                  <BSW-MODULE-ENTRY-REF DEST="BSW-MODULE-ENTRY">/AUTOSAR_Eth_43_PFE/BswModuleEntrys/Eth_PreInit</BSW-MODULE-ENTRY-REF>
                </BSW-MODULE-ENTRY-REF-CONDITIONAL>
                <BSW-MODULE-ENTRY-REF-CONDITIONAL>
                  <BSW-MODULE-ENTRY-REF DEST="BSW-MODULE-ENTRY">/AUTOSAR_Eth_43_PFE/BswModuleEntrys/Eth_SetControllerMode</BSW-MODULE-ENTRY-REF>
                </BSW-MODULE-ENTRY-REF-CONDITIONAL>
                <BSW-MODULE-ENTRY-REF-CONDITIONAL>
                  <BSW-MODULE-ENTRY-REF DEST="BSW-MODULE-ENTRY">/AUTOSAR_Eth_43_PFE/BswModuleEntrys/Eth_GetControllerMode</BSW-MODULE-ENTRY-REF>
                </BSW-MODULE-ENTRY-REF-CONDITIONAL>
                <BSW-MODULE-ENTRY-REF-CONDITIONAL>
                  <BSW-MODULE-ENTRY-REF DEST="BSW-MODULE-ENTRY">/AUTOSAR_Eth_43_PFE/BswModuleEntrys/Eth_GetPhysAddr</BSW-MODULE-ENTRY-REF>
                </BSW-MODULE-ENTRY-REF-CONDITIONAL>
                <BSW-MODULE-ENTRY-REF-CONDITIONAL>
                  <BSW-MODULE-ENTRY-REF DEST="BSW-MODULE-ENTRY">/AUTOSAR_Eth_43_PFE/BswModuleEntrys/Eth_SetPhysAddr</BSW-MODULE-ENTRY-REF>
                </BSW-MODULE-ENTRY-REF-CONDITIONAL>
                <BSW-MODULE-ENTRY-REF-CONDITIONAL>
                  <BSW-MODULE-ENTRY-REF DEST="BSW-MODULE-ENTRY">/AUTOSAR_Eth_43_PFE/BswModuleEntrys/Eth_UpdatePhysAddrFilter</BSW-MODULE-ENTRY-REF>
                </BSW-MODULE-ENTRY-REF-CONDITIONAL>
                <BSW-MODULE-ENTRY-REF-CONDITIONAL>
                  <BSW-MODULE-ENTRY-REF DEST="BSW-MODULE-ENTRY">/AUTOSAR_Eth_43_PFE/BswModuleEntrys/Eth_ProvideTxBuffer</BSW-MODULE-ENTRY-REF>
                </BSW-MODULE-ENTRY-REF-CONDITIONAL>
                [!IF "EthGeneral/EthVendorSpecific/EthReleaseTxBufferApi = 'true'"!][!//
                <BSW-MODULE-ENTRY-REF-CONDITIONAL>
                  <BSW-MODULE-ENTRY-REF DEST="BSW-MODULE-ENTRY">/AUTOSAR_Eth_43_PFE/BswModuleEntrys/Eth_ReleaseTxBuffer</BSW-MODULE-ENTRY-REF>
                </BSW-MODULE-ENTRY-REF-CONDITIONAL>
                [!ENDIF!][!//
                <BSW-MODULE-ENTRY-REF-CONDITIONAL>
                  <BSW-MODULE-ENTRY-REF DEST="BSW-MODULE-ENTRY">/AUTOSAR_Eth_43_PFE/BswModuleEntrys/Eth_Transmit</BSW-MODULE-ENTRY-REF>
                </BSW-MODULE-ENTRY-REF-CONDITIONAL>
                <BSW-MODULE-ENTRY-REF-CONDITIONAL>
                  <BSW-MODULE-ENTRY-REF DEST="BSW-MODULE-ENTRY">/AUTOSAR_Eth_43_PFE/BswModuleEntrys/Eth_Receive</BSW-MODULE-ENTRY-REF>
                </BSW-MODULE-ENTRY-REF-CONDITIONAL>
                <BSW-MODULE-ENTRY-REF-CONDITIONAL>
                  <BSW-MODULE-ENTRY-REF DEST="BSW-MODULE-ENTRY">/AUTOSAR_Eth_43_PFE/BswModuleEntrys/Eth_TxConfirmation</BSW-MODULE-ENTRY-REF>
                </BSW-MODULE-ENTRY-REF-CONDITIONAL>
                [!IF "EthGeneral/EthVersionInfoApi = 'true'"!][!//
                <BSW-MODULE-ENTRY-REF-CONDITIONAL>
                  <BSW-MODULE-ENTRY-REF DEST="BSW-MODULE-ENTRY">/AUTOSAR_Eth_43_PFE/BswModuleEntrys/Eth_GetVersionInfo</BSW-MODULE-ENTRY-REF>
                </BSW-MODULE-ENTRY-REF-CONDITIONAL>
                [!ENDIF!][!//
                [!IF "EthGeneral/EthGetPFEStatisticApi = 'true'"!][!//
                <BSW-MODULE-ENTRY-REF-CONDITIONAL>
                  <BSW-MODULE-ENTRY-REF DEST="BSW-MODULE-ENTRY">/AUTOSAR_Eth_43_PFE/BswModuleEntrys/Eth_GetBmuStats</BSW-MODULE-ENTRY-REF>
                </BSW-MODULE-ENTRY-REF-CONDITIONAL>
                <BSW-MODULE-ENTRY-REF-CONDITIONAL>
                  <BSW-MODULE-ENTRY-REF DEST="BSW-MODULE-ENTRY">/AUTOSAR_Eth_43_PFE/BswModuleEntrys/Eth_GetGpiStats</BSW-MODULE-ENTRY-REF>
                </BSW-MODULE-ENTRY-REF-CONDITIONAL>
                <BSW-MODULE-ENTRY-REF-CONDITIONAL>
                  <BSW-MODULE-ENTRY-REF DEST="BSW-MODULE-ENTRY">/AUTOSAR_Eth_43_PFE/BswModuleEntrys/Eth_GetL2BridgeStats</BSW-MODULE-ENTRY-REF>
                </BSW-MODULE-ENTRY-REF-CONDITIONAL>
                <BSW-MODULE-ENTRY-REF-CONDITIONAL>
                  <BSW-MODULE-ENTRY-REF DEST="BSW-MODULE-ENTRY">/AUTOSAR_Eth_43_PFE/BswModuleEntrys/Eth_GetL2BridgeDomainStats</BSW-MODULE-ENTRY-REF>
                </BSW-MODULE-ENTRY-REF-CONDITIONAL>
                <BSW-MODULE-ENTRY-REF-CONDITIONAL>
                  <BSW-MODULE-ENTRY-REF DEST="BSW-MODULE-ENTRY">/AUTOSAR_Eth_43_PFE/BswModuleEntrys/Eth_GetWdtStats</BSW-MODULE-ENTRY-REF>
                </BSW-MODULE-ENTRY-REF-CONDITIONAL>
                <BSW-MODULE-ENTRY-REF-CONDITIONAL>
                  <BSW-MODULE-ENTRY-REF DEST="BSW-MODULE-ENTRY">/AUTOSAR_Eth_43_PFE/BswModuleEntrys/Eth_GetRtableStats</BSW-MODULE-ENTRY-REF>
                </BSW-MODULE-ENTRY-REF-CONDITIONAL>
                <BSW-MODULE-ENTRY-REF-CONDITIONAL>
                  <BSW-MODULE-ENTRY-REF DEST="BSW-MODULE-ENTRY">/AUTOSAR_Eth_43_PFE/BswModuleEntrys/Eth_GetTmuStats</BSW-MODULE-ENTRY-REF>
                </BSW-MODULE-ENTRY-REF-CONDITIONAL>
                [!ENDIF!][!//
                <BSW-MODULE-ENTRY-REF-CONDITIONAL>
                  <BSW-MODULE-ENTRY-REF DEST="BSW-MODULE-ENTRY">/AUTOSAR_Eth_43_PFE/BswModuleEntrys/Eth_MainFunction</BSW-MODULE-ENTRY-REF>
                </BSW-MODULE-ENTRY-REF-CONDITIONAL>
                [!NOCODE!][!//  
                  [!VAR "AllMiiDisabled" = "true()"!]
                  [!SELECT "EthConfigSet"!][!//
                    [!LOOP "EthCtrlConfig/*"!][!//
                      [!IF "EthCtrlEnableMii = 'true'"!]
                        [!VAR "AllMiiDisabled" = "false()"!]
                      [!ENDIF!]
                    [!ENDLOOP!]
                  [!ENDSELECT!][!//
                [!ENDNOCODE!][!//
                [!IF "$AllMiiDisabled = 'false'"!][!//
                <BSW-MODULE-ENTRY-REF-CONDITIONAL>
                  <BSW-MODULE-ENTRY-REF DEST="BSW-MODULE-ENTRY">/AUTOSAR_Eth_43_PFE/BswModuleEntrys/Eth_WriteMii</BSW-MODULE-ENTRY-REF>
                </BSW-MODULE-ENTRY-REF-CONDITIONAL>
                <BSW-MODULE-ENTRY-REF-CONDITIONAL>
                  <BSW-MODULE-ENTRY-REF DEST="BSW-MODULE-ENTRY">/AUTOSAR_Eth_43_PFE/BswModuleEntrys/Eth_ReadMii</BSW-MODULE-ENTRY-REF>
                </BSW-MODULE-ENTRY-REF-CONDITIONAL>
                  [!IF "EthGeneral/EthVendorSpecific/EthEnableClause45API = 'true'"!][!//
                <BSW-MODULE-ENTRY-REF-CONDITIONAL>
                  <BSW-MODULE-ENTRY-REF DEST="BSW-MODULE-ENTRY">/AUTOSAR_Eth_43_PFE/BswModuleEntrys/Eth_WriteMii45</BSW-MODULE-ENTRY-REF>
                </BSW-MODULE-ENTRY-REF-CONDITIONAL>
                <BSW-MODULE-ENTRY-REF-CONDITIONAL>
                  <BSW-MODULE-ENTRY-REF DEST="BSW-MODULE-ENTRY">/AUTOSAR_Eth_43_PFE/BswModuleEntrys/Eth_ReadMii45</BSW-MODULE-ENTRY-REF>
                </BSW-MODULE-ENTRY-REF-CONDITIONAL>
                  [!ENDIF!][!//
                [!ENDIF!][!//
                [!IF "EthGeneral/EthGetCounterValuesApi = 'true'"!][!//
                <BSW-MODULE-ENTRY-REF-CONDITIONAL>
                  <BSW-MODULE-ENTRY-REF DEST="BSW-MODULE-ENTRY">/AUTOSAR_Eth_43_PFE/BswModuleEntrys/Eth_GetCounterValues</BSW-MODULE-ENTRY-REF>
                </BSW-MODULE-ENTRY-REF-CONDITIONAL>
                [!ENDIF!][!//
                [!IF "EthGeneral/EthGetClassStatisticApi = 'true'"!][!//
                <BSW-MODULE-ENTRY-REF-CONDITIONAL>
                  <BSW-MODULE-ENTRY-REF DEST="BSW-MODULE-ENTRY">/AUTOSAR_Eth_43_PFE/BswModuleEntrys/Eth_GetClassStats</BSW-MODULE-ENTRY-REF>
                </BSW-MODULE-ENTRY-REF-CONDITIONAL>
                [!ENDIF!][!//
                [!IF "EthGeneral/EthGetRxStatsApi = 'true'"!][!//
                <BSW-MODULE-ENTRY-REF-CONDITIONAL>
                  <BSW-MODULE-ENTRY-REF DEST="BSW-MODULE-ENTRY">/AUTOSAR_Eth_43_PFE/BswModuleEntrys/Eth_GetRxStats</BSW-MODULE-ENTRY-REF>
                </BSW-MODULE-ENTRY-REF-CONDITIONAL>
                [!ENDIF!][!//
                [!IF "EthGeneral/EthGetTxStatsApi = 'true'"!][!//
                <BSW-MODULE-ENTRY-REF-CONDITIONAL>
                  <BSW-MODULE-ENTRY-REF DEST="BSW-MODULE-ENTRY">/AUTOSAR_Eth_43_PFE/BswModuleEntrys/Eth_GetTxStats</BSW-MODULE-ENTRY-REF>
                </BSW-MODULE-ENTRY-REF-CONDITIONAL>
                [!ENDIF!][!//
                [!IF "EthGeneral/EthGetTxErrorCounterValuesApi = 'true'"!][!//
                <BSW-MODULE-ENTRY-REF-CONDITIONAL>
                  <BSW-MODULE-ENTRY-REF DEST="BSW-MODULE-ENTRY">/AUTOSAR_Eth_43_PFE/BswModuleEntrys/Eth_GetTxErrorCounterValues</BSW-MODULE-ENTRY-REF>
                </BSW-MODULE-ENTRY-REF-CONDITIONAL>
                [!ENDIF!][!//
                [!IF "EthGeneral/EthGlobalTimeSupport = 'true'"!][!//
                <BSW-MODULE-ENTRY-REF-CONDITIONAL>
                  <BSW-MODULE-ENTRY-REF DEST="BSW-MODULE-ENTRY">/AUTOSAR_Eth_43_PFE/BswModuleEntrys/Eth_GetEgressTimeStamp</BSW-MODULE-ENTRY-REF>
                </BSW-MODULE-ENTRY-REF-CONDITIONAL>
                <BSW-MODULE-ENTRY-REF-CONDITIONAL>
                  <BSW-MODULE-ENTRY-REF DEST="BSW-MODULE-ENTRY">/AUTOSAR_Eth_43_PFE/BswModuleEntrys/Eth_GetIngressTimeStamp</BSW-MODULE-ENTRY-REF>
                </BSW-MODULE-ENTRY-REF-CONDITIONAL>
                <BSW-MODULE-ENTRY-REF-CONDITIONAL>
                  <BSW-MODULE-ENTRY-REF DEST="BSW-MODULE-ENTRY">/AUTOSAR_Eth_43_PFE/BswModuleEntrys/Eth_GetCurrentTime</BSW-MODULE-ENTRY-REF>
                </BSW-MODULE-ENTRY-REF-CONDITIONAL>
                  [!IF "EthGeneral/EthVendorSpecific/EthPfeMultiInstance = 'false' or EthGeneral/EthVendorSpecific/EthPfeSlaveMode = 'false'"!][!//
                <BSW-MODULE-ENTRY-REF-CONDITIONAL>
                  <BSW-MODULE-ENTRY-REF DEST="BSW-MODULE-ENTRY">/AUTOSAR_Eth_43_PFE/BswModuleEntrys/Eth_SetGlobalTime</BSW-MODULE-ENTRY-REF>
                </BSW-MODULE-ENTRY-REF-CONDITIONAL>
                <BSW-MODULE-ENTRY-REF-CONDITIONAL>
                  <BSW-MODULE-ENTRY-REF DEST="BSW-MODULE-ENTRY">/AUTOSAR_Eth_43_PFE/BswModuleEntrys/Eth_SetCorrectionTime</BSW-MODULE-ENTRY-REF>
                </BSW-MODULE-ENTRY-REF-CONDITIONAL>
                  [!ENDIF!][!//
                <BSW-MODULE-ENTRY-REF-CONDITIONAL>
                  <BSW-MODULE-ENTRY-REF DEST="BSW-MODULE-ENTRY">/AUTOSAR_Eth_43_PFE/BswModuleEntrys/Eth_EnableEgressTimeStamp</BSW-MODULE-ENTRY-REF>
                </BSW-MODULE-ENTRY-REF-CONDITIONAL>
                [!ENDIF!][!//
                <BSW-MODULE-ENTRY-REF-CONDITIONAL>
                  <BSW-MODULE-ENTRY-REF DEST="BSW-MODULE-ENTRY">/AUTOSAR_Eth_43_PFE/BswModuleEntrys/Eth_GetPlatform</BSW-MODULE-ENTRY-REF>
                </BSW-MODULE-ENTRY-REF-CONDITIONAL>
                <BSW-MODULE-ENTRY-REF-CONDITIONAL>
                  <BSW-MODULE-ENTRY-REF DEST="BSW-MODULE-ENTRY">/AUTOSAR_Eth_43_PFE/BswModuleEntrys/Eth_HifIrqHdlr_0</BSW-MODULE-ENTRY-REF>
                </BSW-MODULE-ENTRY-REF-CONDITIONAL>
                <BSW-MODULE-ENTRY-REF-CONDITIONAL>
                  <BSW-MODULE-ENTRY-REF DEST="BSW-MODULE-ENTRY">/AUTOSAR_Eth_43_PFE/BswModuleEntrys/Eth_HifIrqHdlr_1</BSW-MODULE-ENTRY-REF>
                </BSW-MODULE-ENTRY-REF-CONDITIONAL>
                <BSW-MODULE-ENTRY-REF-CONDITIONAL>
                  <BSW-MODULE-ENTRY-REF DEST="BSW-MODULE-ENTRY">/AUTOSAR_Eth_43_PFE/BswModuleEntrys/Eth_HifIrqHdlr_2</BSW-MODULE-ENTRY-REF>
                </BSW-MODULE-ENTRY-REF-CONDITIONAL>
                <BSW-MODULE-ENTRY-REF-CONDITIONAL>
                  <BSW-MODULE-ENTRY-REF DEST="BSW-MODULE-ENTRY">/AUTOSAR_Eth_43_PFE/BswModuleEntrys/Eth_HifIrqHdlr_3</BSW-MODULE-ENTRY-REF>
                </BSW-MODULE-ENTRY-REF-CONDITIONAL>
                <BSW-MODULE-ENTRY-REF-CONDITIONAL>
                  <BSW-MODULE-ENTRY-REF DEST="BSW-MODULE-ENTRY">/AUTOSAR_Eth_43_PFE/BswModuleEntrys/Eth_HifNoCpyIrqHdlr</BSW-MODULE-ENTRY-REF>
                </BSW-MODULE-ENTRY-REF-CONDITIONAL>
                <BSW-MODULE-ENTRY-REF-CONDITIONAL>
                  <BSW-MODULE-ENTRY-REF DEST="BSW-MODULE-ENTRY">/AUTOSAR_Eth_43_PFE/BswModuleEntrys/Eth_BmuIrqHdlr</BSW-MODULE-ENTRY-REF>
                </BSW-MODULE-ENTRY-REF-CONDITIONAL>
                [!IF "EthGeneral/EthVendorSpecific/PfeEnableFCI = 'true'"!][!//
                <BSW-MODULE-ENTRY-REF-CONDITIONAL>
                  <BSW-MODULE-ENTRY-REF DEST="BSW-MODULE-ENTRY">/AUTOSAR_Eth_43_PFE/BswModuleEntrys/fci_open</BSW-MODULE-ENTRY-REF>
                </BSW-MODULE-ENTRY-REF-CONDITIONAL>
                <BSW-MODULE-ENTRY-REF-CONDITIONAL>
                  <BSW-MODULE-ENTRY-REF DEST="BSW-MODULE-ENTRY">/AUTOSAR_Eth_43_PFE/BswModuleEntrys/fci_close</BSW-MODULE-ENTRY-REF>
                </BSW-MODULE-ENTRY-REF-CONDITIONAL>
                <BSW-MODULE-ENTRY-REF-CONDITIONAL>
                  <BSW-MODULE-ENTRY-REF DEST="BSW-MODULE-ENTRY">/AUTOSAR_Eth_43_PFE/BswModuleEntrys/fci_catch</BSW-MODULE-ENTRY-REF>
                </BSW-MODULE-ENTRY-REF-CONDITIONAL>
                <BSW-MODULE-ENTRY-REF-CONDITIONAL>
                  <BSW-MODULE-ENTRY-REF DEST="BSW-MODULE-ENTRY">/AUTOSAR_Eth_43_PFE/BswModuleEntrys/fci_cmd</BSW-MODULE-ENTRY-REF>
                </BSW-MODULE-ENTRY-REF-CONDITIONAL>
                <BSW-MODULE-ENTRY-REF-CONDITIONAL>
                  <BSW-MODULE-ENTRY-REF DEST="BSW-MODULE-ENTRY">/AUTOSAR_Eth_43_PFE/BswModuleEntrys/fci_query</BSW-MODULE-ENTRY-REF>
                </BSW-MODULE-ENTRY-REF-CONDITIONAL>
                <BSW-MODULE-ENTRY-REF-CONDITIONAL>
                  <BSW-MODULE-ENTRY-REF DEST="BSW-MODULE-ENTRY">/AUTOSAR_Eth_43_PFE/BswModuleEntrys/fci_write</BSW-MODULE-ENTRY-REF>
                </BSW-MODULE-ENTRY-REF-CONDITIONAL>
                <BSW-MODULE-ENTRY-REF-CONDITIONAL>
                  <BSW-MODULE-ENTRY-REF DEST="BSW-MODULE-ENTRY">/AUTOSAR_Eth_43_PFE/BswModuleEntrys/fci_register_cb</BSW-MODULE-ENTRY-REF>
                </BSW-MODULE-ENTRY-REF-CONDITIONAL>
                <BSW-MODULE-ENTRY-REF-CONDITIONAL>
                  <BSW-MODULE-ENTRY-REF DEST="BSW-MODULE-ENTRY">/AUTOSAR_Eth_43_PFE/BswModuleEntrys/fci_fd</BSW-MODULE-ENTRY-REF>
                </BSW-MODULE-ENTRY-REF-CONDITIONAL>
                [!ENDIF!][!//
              </PROVIDED-ENTRYS>
              <INTERNAL-BEHAVIORS>
                <BSW-INTERNAL-BEHAVIOR>
                  <SHORT-NAME>InternalBehavior_0</SHORT-NAME>
                  <EXCLUSIVE-AREAS>
                    <EXCLUSIVE-AREA>
                      <SHORT-NAME>ETH_EXCLUSIVE_AREA_00</SHORT-NAME>
                    </EXCLUSIVE-AREA>
                    <EXCLUSIVE-AREA>
                      <SHORT-NAME>ETH_EXCLUSIVE_AREA_01</SHORT-NAME>
                    </EXCLUSIVE-AREA>
                    <EXCLUSIVE-AREA>
                      <SHORT-NAME>ETH_EXCLUSIVE_AREA_02</SHORT-NAME>
                    </EXCLUSIVE-AREA>
                    <EXCLUSIVE-AREA>
                      <SHORT-NAME>ETH_EXCLUSIVE_AREA_03</SHORT-NAME>
                    </EXCLUSIVE-AREA>
                    <EXCLUSIVE-AREA>
                      <SHORT-NAME>ETH_EXCLUSIVE_AREA_04</SHORT-NAME>
                    </EXCLUSIVE-AREA>
                    <EXCLUSIVE-AREA>
                      <SHORT-NAME>ETH_EXCLUSIVE_AREA_05</SHORT-NAME>
                    </EXCLUSIVE-AREA>
                    <EXCLUSIVE-AREA>
                      <SHORT-NAME>ETH_EXCLUSIVE_AREA_06</SHORT-NAME>
                    </EXCLUSIVE-AREA>
                    <EXCLUSIVE-AREA>
                      <SHORT-NAME>ETH_EXCLUSIVE_AREA_07</SHORT-NAME>
                    </EXCLUSIVE-AREA>
                    <EXCLUSIVE-AREA>
                      <SHORT-NAME>ETH_EXCLUSIVE_AREA_08</SHORT-NAME>
                    </EXCLUSIVE-AREA>
                    <EXCLUSIVE-AREA>
                      <SHORT-NAME>ETH_EXCLUSIVE_AREA_09</SHORT-NAME>
                    </EXCLUSIVE-AREA>
                    <EXCLUSIVE-AREA>
                      <SHORT-NAME>ETH_EXCLUSIVE_AREA_10</SHORT-NAME>
                    </EXCLUSIVE-AREA>
                    <EXCLUSIVE-AREA>
                      <SHORT-NAME>ETH_EXCLUSIVE_AREA_11</SHORT-NAME>
                    </EXCLUSIVE-AREA>
                    <EXCLUSIVE-AREA>
                      <SHORT-NAME>ETH_EXCLUSIVE_AREA_12</SHORT-NAME>
                    </EXCLUSIVE-AREA>
                    <EXCLUSIVE-AREA>
                      <SHORT-NAME>ETH_EXCLUSIVE_AREA_13</SHORT-NAME>
                    </EXCLUSIVE-AREA>
                    <EXCLUSIVE-AREA>
                      <SHORT-NAME>ETH_EXCLUSIVE_AREA_14</SHORT-NAME>
                    </EXCLUSIVE-AREA>
                    <EXCLUSIVE-AREA>
                      <SHORT-NAME>ETH_EXCLUSIVE_AREA_15</SHORT-NAME>
                    </EXCLUSIVE-AREA>
                    <EXCLUSIVE-AREA>
                      <SHORT-NAME>ETH_EXCLUSIVE_AREA_16</SHORT-NAME>
                    </EXCLUSIVE-AREA>
                    <EXCLUSIVE-AREA>
                      <SHORT-NAME>ETH_EXCLUSIVE_AREA_17</SHORT-NAME>
                    </EXCLUSIVE-AREA>
                    <EXCLUSIVE-AREA>
                      <SHORT-NAME>ETH_EXCLUSIVE_AREA_18</SHORT-NAME>
                    </EXCLUSIVE-AREA>
                    <EXCLUSIVE-AREA>
                      <SHORT-NAME>ETH_EXCLUSIVE_AREA_19</SHORT-NAME>
                    </EXCLUSIVE-AREA>
                    <EXCLUSIVE-AREA>
                      <SHORT-NAME>ETH_EXCLUSIVE_AREA_20</SHORT-NAME>
                    </EXCLUSIVE-AREA>
                    <EXCLUSIVE-AREA>
                      <SHORT-NAME>ETH_EXCLUSIVE_AREA_21</SHORT-NAME>
                    </EXCLUSIVE-AREA>
                    <EXCLUSIVE-AREA>
                      <SHORT-NAME>ETH_EXCLUSIVE_AREA_22</SHORT-NAME>
                    </EXCLUSIVE-AREA>
                    <EXCLUSIVE-AREA>
                      <SHORT-NAME>ETH_EXCLUSIVE_AREA_23</SHORT-NAME>
                    </EXCLUSIVE-AREA>
                    <EXCLUSIVE-AREA>
                      <SHORT-NAME>ETH_EXCLUSIVE_AREA_24</SHORT-NAME>
                    </EXCLUSIVE-AREA>
                    <EXCLUSIVE-AREA>
                      <SHORT-NAME>ETH_EXCLUSIVE_AREA_25</SHORT-NAME>
                    </EXCLUSIVE-AREA>
                    <EXCLUSIVE-AREA>
                      <SHORT-NAME>ETH_EXCLUSIVE_AREA_26</SHORT-NAME>
                    </EXCLUSIVE-AREA>
                    <EXCLUSIVE-AREA>
                      <SHORT-NAME>ETH_EXCLUSIVE_AREA_27</SHORT-NAME>
                    </EXCLUSIVE-AREA>
                    <EXCLUSIVE-AREA>
                      <SHORT-NAME>ETH_EXCLUSIVE_AREA_28</SHORT-NAME>
                    </EXCLUSIVE-AREA>
                    <EXCLUSIVE-AREA>
                      <SHORT-NAME>ETH_EXCLUSIVE_AREA_29</SHORT-NAME>
                    </EXCLUSIVE-AREA>
                    <EXCLUSIVE-AREA>
                      <SHORT-NAME>ETH_EXCLUSIVE_AREA_30</SHORT-NAME>
                    </EXCLUSIVE-AREA>
                    <EXCLUSIVE-AREA>
                      <SHORT-NAME>ETH_EXCLUSIVE_AREA_31</SHORT-NAME>
                    </EXCLUSIVE-AREA>
                    <EXCLUSIVE-AREA>
                      <SHORT-NAME>ETH_EXCLUSIVE_AREA_32</SHORT-NAME>
                    </EXCLUSIVE-AREA>
                    <EXCLUSIVE-AREA>
                      <SHORT-NAME>ETH_EXCLUSIVE_AREA_33</SHORT-NAME>
                    </EXCLUSIVE-AREA>
                    <EXCLUSIVE-AREA>
                      <SHORT-NAME>ETH_EXCLUSIVE_AREA_34</SHORT-NAME>
                    </EXCLUSIVE-AREA>
                    <EXCLUSIVE-AREA>
                      <SHORT-NAME>ETH_EXCLUSIVE_AREA_35</SHORT-NAME>
                    </EXCLUSIVE-AREA>
                    <EXCLUSIVE-AREA>
                      <SHORT-NAME>ETH_EXCLUSIVE_AREA_36</SHORT-NAME>
                    </EXCLUSIVE-AREA>
                    <EXCLUSIVE-AREA>
                      <SHORT-NAME>ETH_EXCLUSIVE_AREA_37</SHORT-NAME>
                    </EXCLUSIVE-AREA>
                    <EXCLUSIVE-AREA>
                      <SHORT-NAME>ETH_EXCLUSIVE_AREA_38</SHORT-NAME>
                    </EXCLUSIVE-AREA>
                    <EXCLUSIVE-AREA>
                      <SHORT-NAME>ETH_EXCLUSIVE_AREA_39</SHORT-NAME>
                    </EXCLUSIVE-AREA>
                    <EXCLUSIVE-AREA>
                      <SHORT-NAME>ETH_EXCLUSIVE_AREA_40</SHORT-NAME>
                    </EXCLUSIVE-AREA>
                    <EXCLUSIVE-AREA>
                      <SHORT-NAME>ETH_EXCLUSIVE_AREA_41</SHORT-NAME>
                    </EXCLUSIVE-AREA>
                    <EXCLUSIVE-AREA>
                      <SHORT-NAME>ETH_EXCLUSIVE_AREA_42</SHORT-NAME>
                    </EXCLUSIVE-AREA>
                    <EXCLUSIVE-AREA>
                      <SHORT-NAME>ETH_EXCLUSIVE_AREA_43</SHORT-NAME>
                    </EXCLUSIVE-AREA>
                    <EXCLUSIVE-AREA>
                      <SHORT-NAME>ETH_EXCLUSIVE_AREA_44</SHORT-NAME>
                    </EXCLUSIVE-AREA>
                    <EXCLUSIVE-AREA>
                      <SHORT-NAME>ETH_EXCLUSIVE_AREA_45</SHORT-NAME>
                    </EXCLUSIVE-AREA>
                    <EXCLUSIVE-AREA>
                      <SHORT-NAME>ETH_EXCLUSIVE_AREA_46</SHORT-NAME>
                    </EXCLUSIVE-AREA>
                    <EXCLUSIVE-AREA>
                      <SHORT-NAME>ETH_EXCLUSIVE_AREA_47</SHORT-NAME>
                    </EXCLUSIVE-AREA>
                    <EXCLUSIVE-AREA>
                      <SHORT-NAME>ETH_EXCLUSIVE_AREA_48</SHORT-NAME>
                    </EXCLUSIVE-AREA>
                    <EXCLUSIVE-AREA>
                      <SHORT-NAME>ETH_EXCLUSIVE_AREA_49</SHORT-NAME>
                    </EXCLUSIVE-AREA>
                    <EXCLUSIVE-AREA>
                      <SHORT-NAME>ETH_EXCLUSIVE_AREA_50</SHORT-NAME>
                    </EXCLUSIVE-AREA>
                    <EXCLUSIVE-AREA>
                      <SHORT-NAME>ETH_EXCLUSIVE_AREA_51</SHORT-NAME>
                    </EXCLUSIVE-AREA>
                    <EXCLUSIVE-AREA>
                      <SHORT-NAME>ETH_EXCLUSIVE_AREA_52</SHORT-NAME>
                    </EXCLUSIVE-AREA>
                    <EXCLUSIVE-AREA>
                      <SHORT-NAME>ETH_EXCLUSIVE_AREA_53</SHORT-NAME>
                    </EXCLUSIVE-AREA>
                    <EXCLUSIVE-AREA>
                      <SHORT-NAME>ETH_EXCLUSIVE_AREA_54</SHORT-NAME>
                    </EXCLUSIVE-AREA>
                    <EXCLUSIVE-AREA>
                      <SHORT-NAME>ETH_EXCLUSIVE_AREA_55</SHORT-NAME>
                    </EXCLUSIVE-AREA>
                    <EXCLUSIVE-AREA>
                      <SHORT-NAME>ETH_EXCLUSIVE_AREA_56</SHORT-NAME>
                    </EXCLUSIVE-AREA>
                    <EXCLUSIVE-AREA>
                      <SHORT-NAME>ETH_EXCLUSIVE_AREA_57</SHORT-NAME>
                    </EXCLUSIVE-AREA>
                    <EXCLUSIVE-AREA>
                      <SHORT-NAME>ETH_EXCLUSIVE_AREA_58</SHORT-NAME>
                    </EXCLUSIVE-AREA>
                    <EXCLUSIVE-AREA>
                      <SHORT-NAME>ETH_EXCLUSIVE_AREA_59</SHORT-NAME>
                    </EXCLUSIVE-AREA>
                    <EXCLUSIVE-AREA>
                      <SHORT-NAME>ETH_EXCLUSIVE_AREA_60</SHORT-NAME>
                    </EXCLUSIVE-AREA>
                    <EXCLUSIVE-AREA>
                      <SHORT-NAME>ETH_EXCLUSIVE_AREA_61</SHORT-NAME>
                    </EXCLUSIVE-AREA>
                    <EXCLUSIVE-AREA>
                      <SHORT-NAME>ETH_EXCLUSIVE_AREA_62</SHORT-NAME>
                    </EXCLUSIVE-AREA>
                    <EXCLUSIVE-AREA>
                      <SHORT-NAME>ETH_EXCLUSIVE_AREA_63</SHORT-NAME>
                    </EXCLUSIVE-AREA>
                    <EXCLUSIVE-AREA>
                      <SHORT-NAME>ETH_EXCLUSIVE_AREA_64</SHORT-NAME>
                    </EXCLUSIVE-AREA>
                    <EXCLUSIVE-AREA>
                      <SHORT-NAME>ETH_EXCLUSIVE_AREA_65</SHORT-NAME>
                    </EXCLUSIVE-AREA>
                    <EXCLUSIVE-AREA>
                      <SHORT-NAME>ETH_EXCLUSIVE_AREA_66</SHORT-NAME>
                    </EXCLUSIVE-AREA>
                    <EXCLUSIVE-AREA>
                      <SHORT-NAME>ETH_EXCLUSIVE_AREA_67</SHORT-NAME>
                    </EXCLUSIVE-AREA>
                    <EXCLUSIVE-AREA>
                      <SHORT-NAME>ETH_EXCLUSIVE_AREA_68</SHORT-NAME>
                    </EXCLUSIVE-AREA>
                    <EXCLUSIVE-AREA>
                      <SHORT-NAME>ETH_EXCLUSIVE_AREA_69</SHORT-NAME>
                    </EXCLUSIVE-AREA>
                    <EXCLUSIVE-AREA>
                      <SHORT-NAME>ETH_EXCLUSIVE_AREA_70</SHORT-NAME>
                    </EXCLUSIVE-AREA>
                    <EXCLUSIVE-AREA>
                      <SHORT-NAME>ETH_EXCLUSIVE_AREA_71</SHORT-NAME>
                    </EXCLUSIVE-AREA>
                    <EXCLUSIVE-AREA>
                      <SHORT-NAME>ETH_EXCLUSIVE_AREA_72</SHORT-NAME>
                    </EXCLUSIVE-AREA>
                    <EXCLUSIVE-AREA>
                      <SHORT-NAME>ETH_EXCLUSIVE_AREA_73</SHORT-NAME>
                    </EXCLUSIVE-AREA>
                    <EXCLUSIVE-AREA>
                      <SHORT-NAME>ETH_EXCLUSIVE_AREA_74</SHORT-NAME>
                    </EXCLUSIVE-AREA>
                    <EXCLUSIVE-AREA>
                      <SHORT-NAME>ETH_EXCLUSIVE_AREA_75</SHORT-NAME>
                    </EXCLUSIVE-AREA>
                    <EXCLUSIVE-AREA>
                      <SHORT-NAME>ETH_EXCLUSIVE_AREA_76</SHORT-NAME>
                    </EXCLUSIVE-AREA>
                    <EXCLUSIVE-AREA>
                      <SHORT-NAME>ETH_EXCLUSIVE_AREA_77</SHORT-NAME>
                    </EXCLUSIVE-AREA>
                    <EXCLUSIVE-AREA>
                      <SHORT-NAME>ETH_EXCLUSIVE_AREA_78</SHORT-NAME>
                    </EXCLUSIVE-AREA>
                    <EXCLUSIVE-AREA>
                      <SHORT-NAME>ETH_EXCLUSIVE_AREA_79</SHORT-NAME>
                    </EXCLUSIVE-AREA>
                    <EXCLUSIVE-AREA>
                      <SHORT-NAME>ETH_EXCLUSIVE_AREA_80</SHORT-NAME>
                    </EXCLUSIVE-AREA>
                    <EXCLUSIVE-AREA>
                      <SHORT-NAME>ETH_EXCLUSIVE_AREA_81</SHORT-NAME>
                    </EXCLUSIVE-AREA>
                    <EXCLUSIVE-AREA>
                      <SHORT-NAME>ETH_EXCLUSIVE_AREA_82</SHORT-NAME>
                    </EXCLUSIVE-AREA>
                    <EXCLUSIVE-AREA>
                      <SHORT-NAME>ETH_EXCLUSIVE_AREA_83</SHORT-NAME>
                    </EXCLUSIVE-AREA>
                    <EXCLUSIVE-AREA>
                      <SHORT-NAME>ETH_EXCLUSIVE_AREA_84</SHORT-NAME>
                    </EXCLUSIVE-AREA>
                    <EXCLUSIVE-AREA>
                      <SHORT-NAME>ETH_EXCLUSIVE_AREA_85</SHORT-NAME>
                    </EXCLUSIVE-AREA>
                    <EXCLUSIVE-AREA>
                      <SHORT-NAME>ETH_EXCLUSIVE_AREA_86</SHORT-NAME>
                    </EXCLUSIVE-AREA>
                    <EXCLUSIVE-AREA>
                      <SHORT-NAME>ETH_EXCLUSIVE_AREA_87</SHORT-NAME>
                    </EXCLUSIVE-AREA>
                    <EXCLUSIVE-AREA>
                      <SHORT-NAME>ETH_EXCLUSIVE_AREA_88</SHORT-NAME>
                    </EXCLUSIVE-AREA>
                    <EXCLUSIVE-AREA>
                      <SHORT-NAME>ETH_EXCLUSIVE_AREA_89</SHORT-NAME>
                    </EXCLUSIVE-AREA>
                    <EXCLUSIVE-AREA>
                      <SHORT-NAME>ETH_EXCLUSIVE_AREA_90</SHORT-NAME>
                    </EXCLUSIVE-AREA>
                    <EXCLUSIVE-AREA>
                      <SHORT-NAME>ETH_EXCLUSIVE_AREA_91</SHORT-NAME>
                    </EXCLUSIVE-AREA>
                    <EXCLUSIVE-AREA>
                      <SHORT-NAME>ETH_EXCLUSIVE_AREA_92</SHORT-NAME>
                    </EXCLUSIVE-AREA>
                    <EXCLUSIVE-AREA>
                      <SHORT-NAME>ETH_EXCLUSIVE_AREA_93</SHORT-NAME>
                    </EXCLUSIVE-AREA>
                    <EXCLUSIVE-AREA>
                      <SHORT-NAME>ETH_EXCLUSIVE_AREA_94</SHORT-NAME>
                    </EXCLUSIVE-AREA>
                    <EXCLUSIVE-AREA>
                      <SHORT-NAME>ETH_EXCLUSIVE_AREA_95</SHORT-NAME>
                    </EXCLUSIVE-AREA>
                    <EXCLUSIVE-AREA>
                      <SHORT-NAME>ETH_EXCLUSIVE_AREA_96</SHORT-NAME>
                    </EXCLUSIVE-AREA>
                    <EXCLUSIVE-AREA>
                      <SHORT-NAME>ETH_EXCLUSIVE_AREA_97</SHORT-NAME>
                    </EXCLUSIVE-AREA>
                    <EXCLUSIVE-AREA>
                      <SHORT-NAME>ETH_EXCLUSIVE_AREA_98</SHORT-NAME>
                    </EXCLUSIVE-AREA>
                    <EXCLUSIVE-AREA>
                      <SHORT-NAME>ETH_EXCLUSIVE_AREA_99</SHORT-NAME>
                    </EXCLUSIVE-AREA>
                    <EXCLUSIVE-AREA>
                      <SHORT-NAME>ETH_EXCLUSIVE_AREA_100</SHORT-NAME>
                    </EXCLUSIVE-AREA>
                    <EXCLUSIVE-AREA>
                      <SHORT-NAME>ETH_EXCLUSIVE_AREA_101</SHORT-NAME>
                    </EXCLUSIVE-AREA>
                    <EXCLUSIVE-AREA>
                      <SHORT-NAME>ETH_EXCLUSIVE_AREA_102</SHORT-NAME>
                    </EXCLUSIVE-AREA>
                    <EXCLUSIVE-AREA>
                      <SHORT-NAME>ETH_EXCLUSIVE_AREA_103</SHORT-NAME>
                    </EXCLUSIVE-AREA>
                    <EXCLUSIVE-AREA>
                      <SHORT-NAME>ETH_EXCLUSIVE_AREA_104</SHORT-NAME>
                    </EXCLUSIVE-AREA>
                  </EXCLUSIVE-AREAS>
                  <ENTITYS>
                    <BSW-CALLED-ENTITY>
                      <SHORT-NAME>Eth_43_PFE_Init</SHORT-NAME>
                      <CAN-ENTER-EXCLUSIVE-AREA-REFS>
                        <CAN-ENTER-EXCLUSIVE-AREA-REF DEST="EXCLUSIVE-AREA">/AUTOSAR_Eth_43_PFE/BswModuleDescriptions/Eth/InternalBehavior_0/ETH_EXCLUSIVE_AREA_00</CAN-ENTER-EXCLUSIVE-AREA-REF>
                        <CAN-ENTER-EXCLUSIVE-AREA-REF DEST="EXCLUSIVE-AREA">/AUTOSAR_Eth_43_PFE/BswModuleDescriptions/Eth/InternalBehavior_0/ETH_EXCLUSIVE_AREA_01</CAN-ENTER-EXCLUSIVE-AREA-REF>
                        <CAN-ENTER-EXCLUSIVE-AREA-REF DEST="EXCLUSIVE-AREA">/AUTOSAR_Eth_43_PFE/BswModuleDescriptions/Eth/InternalBehavior_0/ETH_EXCLUSIVE_AREA_02</CAN-ENTER-EXCLUSIVE-AREA-REF>
                        <CAN-ENTER-EXCLUSIVE-AREA-REF DEST="EXCLUSIVE-AREA">/AUTOSAR_Eth_43_PFE/BswModuleDescriptions/Eth/InternalBehavior_0/ETH_EXCLUSIVE_AREA_03</CAN-ENTER-EXCLUSIVE-AREA-REF>
                        <CAN-ENTER-EXCLUSIVE-AREA-REF DEST="EXCLUSIVE-AREA">/AUTOSAR_Eth_43_PFE/BswModuleDescriptions/Eth/InternalBehavior_0/ETH_EXCLUSIVE_AREA_04</CAN-ENTER-EXCLUSIVE-AREA-REF>
                        <CAN-ENTER-EXCLUSIVE-AREA-REF DEST="EXCLUSIVE-AREA">/AUTOSAR_Eth_43_PFE/BswModuleDescriptions/Eth/InternalBehavior_0/ETH_EXCLUSIVE_AREA_06</CAN-ENTER-EXCLUSIVE-AREA-REF>
                        <CAN-ENTER-EXCLUSIVE-AREA-REF DEST="EXCLUSIVE-AREA">/AUTOSAR_Eth_43_PFE/BswModuleDescriptions/Eth/InternalBehavior_0/ETH_EXCLUSIVE_AREA_09</CAN-ENTER-EXCLUSIVE-AREA-REF>
                        <CAN-ENTER-EXCLUSIVE-AREA-REF DEST="EXCLUSIVE-AREA">/AUTOSAR_Eth_43_PFE/BswModuleDescriptions/Eth/InternalBehavior_0/ETH_EXCLUSIVE_AREA_10</CAN-ENTER-EXCLUSIVE-AREA-REF>
                        <CAN-ENTER-EXCLUSIVE-AREA-REF DEST="EXCLUSIVE-AREA">/AUTOSAR_Eth_43_PFE/BswModuleDescriptions/Eth/InternalBehavior_0/ETH_EXCLUSIVE_AREA_11</CAN-ENTER-EXCLUSIVE-AREA-REF>
                        <CAN-ENTER-EXCLUSIVE-AREA-REF DEST="EXCLUSIVE-AREA">/AUTOSAR_Eth_43_PFE/BswModuleDescriptions/Eth/InternalBehavior_0/ETH_EXCLUSIVE_AREA_13</CAN-ENTER-EXCLUSIVE-AREA-REF>
                        <CAN-ENTER-EXCLUSIVE-AREA-REF DEST="EXCLUSIVE-AREA">/AUTOSAR_Eth_43_PFE/BswModuleDescriptions/Eth/InternalBehavior_0/ETH_EXCLUSIVE_AREA_15</CAN-ENTER-EXCLUSIVE-AREA-REF>
                        <CAN-ENTER-EXCLUSIVE-AREA-REF DEST="EXCLUSIVE-AREA">/AUTOSAR_Eth_43_PFE/BswModuleDescriptions/Eth/InternalBehavior_0/ETH_EXCLUSIVE_AREA_22</CAN-ENTER-EXCLUSIVE-AREA-REF>
                        <CAN-ENTER-EXCLUSIVE-AREA-REF DEST="EXCLUSIVE-AREA">/AUTOSAR_Eth_43_PFE/BswModuleDescriptions/Eth/InternalBehavior_0/ETH_EXCLUSIVE_AREA_23</CAN-ENTER-EXCLUSIVE-AREA-REF>
                        <CAN-ENTER-EXCLUSIVE-AREA-REF DEST="EXCLUSIVE-AREA">/AUTOSAR_Eth_43_PFE/BswModuleDescriptions/Eth/InternalBehavior_0/ETH_EXCLUSIVE_AREA_24</CAN-ENTER-EXCLUSIVE-AREA-REF>
                        <CAN-ENTER-EXCLUSIVE-AREA-REF DEST="EXCLUSIVE-AREA">/AUTOSAR_Eth_43_PFE/BswModuleDescriptions/Eth/InternalBehavior_0/ETH_EXCLUSIVE_AREA_29</CAN-ENTER-EXCLUSIVE-AREA-REF>
                        <CAN-ENTER-EXCLUSIVE-AREA-REF DEST="EXCLUSIVE-AREA">/AUTOSAR_Eth_43_PFE/BswModuleDescriptions/Eth/InternalBehavior_0/ETH_EXCLUSIVE_AREA_30</CAN-ENTER-EXCLUSIVE-AREA-REF>
                        <CAN-ENTER-EXCLUSIVE-AREA-REF DEST="EXCLUSIVE-AREA">/AUTOSAR_Eth_43_PFE/BswModuleDescriptions/Eth/InternalBehavior_0/ETH_EXCLUSIVE_AREA_31</CAN-ENTER-EXCLUSIVE-AREA-REF>
                        <CAN-ENTER-EXCLUSIVE-AREA-REF DEST="EXCLUSIVE-AREA">/AUTOSAR_Eth_43_PFE/BswModuleDescriptions/Eth/InternalBehavior_0/ETH_EXCLUSIVE_AREA_32</CAN-ENTER-EXCLUSIVE-AREA-REF>
                        <CAN-ENTER-EXCLUSIVE-AREA-REF DEST="EXCLUSIVE-AREA">/AUTOSAR_Eth_43_PFE/BswModuleDescriptions/Eth/InternalBehavior_0/ETH_EXCLUSIVE_AREA_33</CAN-ENTER-EXCLUSIVE-AREA-REF>
                        <CAN-ENTER-EXCLUSIVE-AREA-REF DEST="EXCLUSIVE-AREA">/AUTOSAR_Eth_43_PFE/BswModuleDescriptions/Eth/InternalBehavior_0/ETH_EXCLUSIVE_AREA_37</CAN-ENTER-EXCLUSIVE-AREA-REF>
                        <CAN-ENTER-EXCLUSIVE-AREA-REF DEST="EXCLUSIVE-AREA">/AUTOSAR_Eth_43_PFE/BswModuleDescriptions/Eth/InternalBehavior_0/ETH_EXCLUSIVE_AREA_38</CAN-ENTER-EXCLUSIVE-AREA-REF>
                        <CAN-ENTER-EXCLUSIVE-AREA-REF DEST="EXCLUSIVE-AREA">/AUTOSAR_Eth_43_PFE/BswModuleDescriptions/Eth/InternalBehavior_0/ETH_EXCLUSIVE_AREA_39</CAN-ENTER-EXCLUSIVE-AREA-REF>
                        <CAN-ENTER-EXCLUSIVE-AREA-REF DEST="EXCLUSIVE-AREA">/AUTOSAR_Eth_43_PFE/BswModuleDescriptions/Eth/InternalBehavior_0/ETH_EXCLUSIVE_AREA_42</CAN-ENTER-EXCLUSIVE-AREA-REF>
                        <CAN-ENTER-EXCLUSIVE-AREA-REF DEST="EXCLUSIVE-AREA">/AUTOSAR_Eth_43_PFE/BswModuleDescriptions/Eth/InternalBehavior_0/ETH_EXCLUSIVE_AREA_43</CAN-ENTER-EXCLUSIVE-AREA-REF>
                        <CAN-ENTER-EXCLUSIVE-AREA-REF DEST="EXCLUSIVE-AREA">/AUTOSAR_Eth_43_PFE/BswModuleDescriptions/Eth/InternalBehavior_0/ETH_EXCLUSIVE_AREA_44</CAN-ENTER-EXCLUSIVE-AREA-REF>
                        <CAN-ENTER-EXCLUSIVE-AREA-REF DEST="EXCLUSIVE-AREA">/AUTOSAR_Eth_43_PFE/BswModuleDescriptions/Eth/InternalBehavior_0/ETH_EXCLUSIVE_AREA_45</CAN-ENTER-EXCLUSIVE-AREA-REF>
                        <CAN-ENTER-EXCLUSIVE-AREA-REF DEST="EXCLUSIVE-AREA">/AUTOSAR_Eth_43_PFE/BswModuleDescriptions/Eth/InternalBehavior_0/ETH_EXCLUSIVE_AREA_46</CAN-ENTER-EXCLUSIVE-AREA-REF>
                        <CAN-ENTER-EXCLUSIVE-AREA-REF DEST="EXCLUSIVE-AREA">/AUTOSAR_Eth_43_PFE/BswModuleDescriptions/Eth/InternalBehavior_0/ETH_EXCLUSIVE_AREA_47</CAN-ENTER-EXCLUSIVE-AREA-REF>
                        <CAN-ENTER-EXCLUSIVE-AREA-REF DEST="EXCLUSIVE-AREA">/AUTOSAR_Eth_43_PFE/BswModuleDescriptions/Eth/InternalBehavior_0/ETH_EXCLUSIVE_AREA_48</CAN-ENTER-EXCLUSIVE-AREA-REF>
                        <CAN-ENTER-EXCLUSIVE-AREA-REF DEST="EXCLUSIVE-AREA">/AUTOSAR_Eth_43_PFE/BswModuleDescriptions/Eth/InternalBehavior_0/ETH_EXCLUSIVE_AREA_49</CAN-ENTER-EXCLUSIVE-AREA-REF>
                        <CAN-ENTER-EXCLUSIVE-AREA-REF DEST="EXCLUSIVE-AREA">/AUTOSAR_Eth_43_PFE/BswModuleDescriptions/Eth/InternalBehavior_0/ETH_EXCLUSIVE_AREA_50</CAN-ENTER-EXCLUSIVE-AREA-REF>
                        <CAN-ENTER-EXCLUSIVE-AREA-REF DEST="EXCLUSIVE-AREA">/AUTOSAR_Eth_43_PFE/BswModuleDescriptions/Eth/InternalBehavior_0/ETH_EXCLUSIVE_AREA_51</CAN-ENTER-EXCLUSIVE-AREA-REF>
                        <CAN-ENTER-EXCLUSIVE-AREA-REF DEST="EXCLUSIVE-AREA">/AUTOSAR_Eth_43_PFE/BswModuleDescriptions/Eth/InternalBehavior_0/ETH_EXCLUSIVE_AREA_52</CAN-ENTER-EXCLUSIVE-AREA-REF>
                        <CAN-ENTER-EXCLUSIVE-AREA-REF DEST="EXCLUSIVE-AREA">/AUTOSAR_Eth_43_PFE/BswModuleDescriptions/Eth/InternalBehavior_0/ETH_EXCLUSIVE_AREA_53</CAN-ENTER-EXCLUSIVE-AREA-REF>
                        <CAN-ENTER-EXCLUSIVE-AREA-REF DEST="EXCLUSIVE-AREA">/AUTOSAR_Eth_43_PFE/BswModuleDescriptions/Eth/InternalBehavior_0/ETH_EXCLUSIVE_AREA_54</CAN-ENTER-EXCLUSIVE-AREA-REF>
                        <CAN-ENTER-EXCLUSIVE-AREA-REF DEST="EXCLUSIVE-AREA">/AUTOSAR_Eth_43_PFE/BswModuleDescriptions/Eth/InternalBehavior_0/ETH_EXCLUSIVE_AREA_55</CAN-ENTER-EXCLUSIVE-AREA-REF>
                        <CAN-ENTER-EXCLUSIVE-AREA-REF DEST="EXCLUSIVE-AREA">/AUTOSAR_Eth_43_PFE/BswModuleDescriptions/Eth/InternalBehavior_0/ETH_EXCLUSIVE_AREA_56</CAN-ENTER-EXCLUSIVE-AREA-REF>
                        <CAN-ENTER-EXCLUSIVE-AREA-REF DEST="EXCLUSIVE-AREA">/AUTOSAR_Eth_43_PFE/BswModuleDescriptions/Eth/InternalBehavior_0/ETH_EXCLUSIVE_AREA_59</CAN-ENTER-EXCLUSIVE-AREA-REF>
                        <CAN-ENTER-EXCLUSIVE-AREA-REF DEST="EXCLUSIVE-AREA">/AUTOSAR_Eth_43_PFE/BswModuleDescriptions/Eth/InternalBehavior_0/ETH_EXCLUSIVE_AREA_61</CAN-ENTER-EXCLUSIVE-AREA-REF>
                        <CAN-ENTER-EXCLUSIVE-AREA-REF DEST="EXCLUSIVE-AREA">/AUTOSAR_Eth_43_PFE/BswModuleDescriptions/Eth/InternalBehavior_0/ETH_EXCLUSIVE_AREA_79</CAN-ENTER-EXCLUSIVE-AREA-REF>
                        <CAN-ENTER-EXCLUSIVE-AREA-REF DEST="EXCLUSIVE-AREA">/AUTOSAR_Eth_43_PFE/BswModuleDescriptions/Eth/InternalBehavior_0/ETH_EXCLUSIVE_AREA_83</CAN-ENTER-EXCLUSIVE-AREA-REF>
                        <CAN-ENTER-EXCLUSIVE-AREA-REF DEST="EXCLUSIVE-AREA">/AUTOSAR_Eth_43_PFE/BswModuleDescriptions/Eth/InternalBehavior_0/ETH_EXCLUSIVE_AREA_84</CAN-ENTER-EXCLUSIVE-AREA-REF>
                        <CAN-ENTER-EXCLUSIVE-AREA-REF DEST="EXCLUSIVE-AREA">/AUTOSAR_Eth_43_PFE/BswModuleDescriptions/Eth/InternalBehavior_0/ETH_EXCLUSIVE_AREA_85</CAN-ENTER-EXCLUSIVE-AREA-REF>
                        <CAN-ENTER-EXCLUSIVE-AREA-REF DEST="EXCLUSIVE-AREA">/AUTOSAR_Eth_43_PFE/BswModuleDescriptions/Eth/InternalBehavior_0/ETH_EXCLUSIVE_AREA_86</CAN-ENTER-EXCLUSIVE-AREA-REF>
                        <CAN-ENTER-EXCLUSIVE-AREA-REF DEST="EXCLUSIVE-AREA">/AUTOSAR_Eth_43_PFE/BswModuleDescriptions/Eth/InternalBehavior_0/ETH_EXCLUSIVE_AREA_88</CAN-ENTER-EXCLUSIVE-AREA-REF>
                        <CAN-ENTER-EXCLUSIVE-AREA-REF DEST="EXCLUSIVE-AREA">/AUTOSAR_Eth_43_PFE/BswModuleDescriptions/Eth/InternalBehavior_0/ETH_EXCLUSIVE_AREA_90</CAN-ENTER-EXCLUSIVE-AREA-REF>
                        <CAN-ENTER-EXCLUSIVE-AREA-REF DEST="EXCLUSIVE-AREA">/AUTOSAR_Eth_43_PFE/BswModuleDescriptions/Eth/InternalBehavior_0/ETH_EXCLUSIVE_AREA_91</CAN-ENTER-EXCLUSIVE-AREA-REF>
                        <CAN-ENTER-EXCLUSIVE-AREA-REF DEST="EXCLUSIVE-AREA">/AUTOSAR_Eth_43_PFE/BswModuleDescriptions/Eth/InternalBehavior_0/ETH_EXCLUSIVE_AREA_94</CAN-ENTER-EXCLUSIVE-AREA-REF>
                        <CAN-ENTER-EXCLUSIVE-AREA-REF DEST="EXCLUSIVE-AREA">/AUTOSAR_Eth_43_PFE/BswModuleDescriptions/Eth/InternalBehavior_0/ETH_EXCLUSIVE_AREA_95</CAN-ENTER-EXCLUSIVE-AREA-REF>
                        <CAN-ENTER-EXCLUSIVE-AREA-REF DEST="EXCLUSIVE-AREA">/AUTOSAR_Eth_43_PFE/BswModuleDescriptions/Eth/InternalBehavior_0/ETH_EXCLUSIVE_AREA_98</CAN-ENTER-EXCLUSIVE-AREA-REF>
                        <CAN-ENTER-EXCLUSIVE-AREA-REF DEST="EXCLUSIVE-AREA">/AUTOSAR_Eth_43_PFE/BswModuleDescriptions/Eth/InternalBehavior_0/ETH_EXCLUSIVE_AREA_100</CAN-ENTER-EXCLUSIVE-AREA-REF>
                        <CAN-ENTER-EXCLUSIVE-AREA-REF DEST="EXCLUSIVE-AREA">/AUTOSAR_Eth_43_PFE/BswModuleDescriptions/Eth/InternalBehavior_0/ETH_EXCLUSIVE_AREA_102</CAN-ENTER-EXCLUSIVE-AREA-REF>
                        <CAN-ENTER-EXCLUSIVE-AREA-REF DEST="EXCLUSIVE-AREA">/AUTOSAR_Eth_43_PFE/BswModuleDescriptions/Eth/InternalBehavior_0/ETH_EXCLUSIVE_AREA_104</CAN-ENTER-EXCLUSIVE-AREA-REF>
                      </CAN-ENTER-EXCLUSIVE-AREA-REFS>
                      <MINIMUM-START-INTERVAL>0.0</MINIMUM-START-INTERVAL>
                      <IMPLEMENTED-ENTRY-REF DEST="BSW-MODULE-ENTRY">/AUTOSAR_Eth_43_PFE/BswModuleEntrys/Eth_Init</IMPLEMENTED-ENTRY-REF>
                    </BSW-CALLED-ENTITY>
                    <BSW-CALLED-ENTITY>
                      <SHORT-NAME>Eth_43_PFE_DeInit</SHORT-NAME>
                      <CAN-ENTER-EXCLUSIVE-AREA-REFS>
                        <CAN-ENTER-EXCLUSIVE-AREA-REF DEST="EXCLUSIVE-AREA">/AUTOSAR_Eth_43_PFE/BswModuleDescriptions/Eth/InternalBehavior_0/ETH_EXCLUSIVE_AREA_03</CAN-ENTER-EXCLUSIVE-AREA-REF>
                        <CAN-ENTER-EXCLUSIVE-AREA-REF DEST="EXCLUSIVE-AREA">/AUTOSAR_Eth_43_PFE/BswModuleDescriptions/Eth/InternalBehavior_0/ETH_EXCLUSIVE_AREA_10</CAN-ENTER-EXCLUSIVE-AREA-REF>
                        <CAN-ENTER-EXCLUSIVE-AREA-REF DEST="EXCLUSIVE-AREA">/AUTOSAR_Eth_43_PFE/BswModuleDescriptions/Eth/InternalBehavior_0/ETH_EXCLUSIVE_AREA_22</CAN-ENTER-EXCLUSIVE-AREA-REF>
                        <CAN-ENTER-EXCLUSIVE-AREA-REF DEST="EXCLUSIVE-AREA">/AUTOSAR_Eth_43_PFE/BswModuleDescriptions/Eth/InternalBehavior_0/ETH_EXCLUSIVE_AREA_23</CAN-ENTER-EXCLUSIVE-AREA-REF>
                        <CAN-ENTER-EXCLUSIVE-AREA-REF DEST="EXCLUSIVE-AREA">/AUTOSAR_Eth_43_PFE/BswModuleDescriptions/Eth/InternalBehavior_0/ETH_EXCLUSIVE_AREA_30</CAN-ENTER-EXCLUSIVE-AREA-REF>
                        <CAN-ENTER-EXCLUSIVE-AREA-REF DEST="EXCLUSIVE-AREA">/AUTOSAR_Eth_43_PFE/BswModuleDescriptions/Eth/InternalBehavior_0/ETH_EXCLUSIVE_AREA_31</CAN-ENTER-EXCLUSIVE-AREA-REF>
                        <CAN-ENTER-EXCLUSIVE-AREA-REF DEST="EXCLUSIVE-AREA">/AUTOSAR_Eth_43_PFE/BswModuleDescriptions/Eth/InternalBehavior_0/ETH_EXCLUSIVE_AREA_37</CAN-ENTER-EXCLUSIVE-AREA-REF>
                        <CAN-ENTER-EXCLUSIVE-AREA-REF DEST="EXCLUSIVE-AREA">/AUTOSAR_Eth_43_PFE/BswModuleDescriptions/Eth/InternalBehavior_0/ETH_EXCLUSIVE_AREA_38</CAN-ENTER-EXCLUSIVE-AREA-REF>
                        <CAN-ENTER-EXCLUSIVE-AREA-REF DEST="EXCLUSIVE-AREA">/AUTOSAR_Eth_43_PFE/BswModuleDescriptions/Eth/InternalBehavior_0/ETH_EXCLUSIVE_AREA_39</CAN-ENTER-EXCLUSIVE-AREA-REF>
                        <CAN-ENTER-EXCLUSIVE-AREA-REF DEST="EXCLUSIVE-AREA">/AUTOSAR_Eth_43_PFE/BswModuleDescriptions/Eth/InternalBehavior_0/ETH_EXCLUSIVE_AREA_42</CAN-ENTER-EXCLUSIVE-AREA-REF>
                        <CAN-ENTER-EXCLUSIVE-AREA-REF DEST="EXCLUSIVE-AREA">/AUTOSAR_Eth_43_PFE/BswModuleDescriptions/Eth/InternalBehavior_0/ETH_EXCLUSIVE_AREA_43</CAN-ENTER-EXCLUSIVE-AREA-REF>
                        <CAN-ENTER-EXCLUSIVE-AREA-REF DEST="EXCLUSIVE-AREA">/AUTOSAR_Eth_43_PFE/BswModuleDescriptions/Eth/InternalBehavior_0/ETH_EXCLUSIVE_AREA_45</CAN-ENTER-EXCLUSIVE-AREA-REF>
                        <CAN-ENTER-EXCLUSIVE-AREA-REF DEST="EXCLUSIVE-AREA">/AUTOSAR_Eth_43_PFE/BswModuleDescriptions/Eth/InternalBehavior_0/ETH_EXCLUSIVE_AREA_46</CAN-ENTER-EXCLUSIVE-AREA-REF>
                        <CAN-ENTER-EXCLUSIVE-AREA-REF DEST="EXCLUSIVE-AREA">/AUTOSAR_Eth_43_PFE/BswModuleDescriptions/Eth/InternalBehavior_0/ETH_EXCLUSIVE_AREA_47</CAN-ENTER-EXCLUSIVE-AREA-REF>
                        <CAN-ENTER-EXCLUSIVE-AREA-REF DEST="EXCLUSIVE-AREA">/AUTOSAR_Eth_43_PFE/BswModuleDescriptions/Eth/InternalBehavior_0/ETH_EXCLUSIVE_AREA_48</CAN-ENTER-EXCLUSIVE-AREA-REF>
                        <CAN-ENTER-EXCLUSIVE-AREA-REF DEST="EXCLUSIVE-AREA">/AUTOSAR_Eth_43_PFE/BswModuleDescriptions/Eth/InternalBehavior_0/ETH_EXCLUSIVE_AREA_49</CAN-ENTER-EXCLUSIVE-AREA-REF>
                        <CAN-ENTER-EXCLUSIVE-AREA-REF DEST="EXCLUSIVE-AREA">/AUTOSAR_Eth_43_PFE/BswModuleDescriptions/Eth/InternalBehavior_0/ETH_EXCLUSIVE_AREA_50</CAN-ENTER-EXCLUSIVE-AREA-REF>
                        <CAN-ENTER-EXCLUSIVE-AREA-REF DEST="EXCLUSIVE-AREA">/AUTOSAR_Eth_43_PFE/BswModuleDescriptions/Eth/InternalBehavior_0/ETH_EXCLUSIVE_AREA_51</CAN-ENTER-EXCLUSIVE-AREA-REF>
                        <CAN-ENTER-EXCLUSIVE-AREA-REF DEST="EXCLUSIVE-AREA">/AUTOSAR_Eth_43_PFE/BswModuleDescriptions/Eth/InternalBehavior_0/ETH_EXCLUSIVE_AREA_52</CAN-ENTER-EXCLUSIVE-AREA-REF>
                        <CAN-ENTER-EXCLUSIVE-AREA-REF DEST="EXCLUSIVE-AREA">/AUTOSAR_Eth_43_PFE/BswModuleDescriptions/Eth/InternalBehavior_0/ETH_EXCLUSIVE_AREA_53</CAN-ENTER-EXCLUSIVE-AREA-REF>
                        <CAN-ENTER-EXCLUSIVE-AREA-REF DEST="EXCLUSIVE-AREA">/AUTOSAR_Eth_43_PFE/BswModuleDescriptions/Eth/InternalBehavior_0/ETH_EXCLUSIVE_AREA_54</CAN-ENTER-EXCLUSIVE-AREA-REF>
                        <CAN-ENTER-EXCLUSIVE-AREA-REF DEST="EXCLUSIVE-AREA">/AUTOSAR_Eth_43_PFE/BswModuleDescriptions/Eth/InternalBehavior_0/ETH_EXCLUSIVE_AREA_55</CAN-ENTER-EXCLUSIVE-AREA-REF>
                        <CAN-ENTER-EXCLUSIVE-AREA-REF DEST="EXCLUSIVE-AREA">/AUTOSAR_Eth_43_PFE/BswModuleDescriptions/Eth/InternalBehavior_0/ETH_EXCLUSIVE_AREA_56</CAN-ENTER-EXCLUSIVE-AREA-REF>
                        <CAN-ENTER-EXCLUSIVE-AREA-REF DEST="EXCLUSIVE-AREA">/AUTOSAR_Eth_43_PFE/BswModuleDescriptions/Eth/InternalBehavior_0/ETH_EXCLUSIVE_AREA_79</CAN-ENTER-EXCLUSIVE-AREA-REF>
                        <CAN-ENTER-EXCLUSIVE-AREA-REF DEST="EXCLUSIVE-AREA">/AUTOSAR_Eth_43_PFE/BswModuleDescriptions/Eth/InternalBehavior_0/ETH_EXCLUSIVE_AREA_84</CAN-ENTER-EXCLUSIVE-AREA-REF>
                        <CAN-ENTER-EXCLUSIVE-AREA-REF DEST="EXCLUSIVE-AREA">/AUTOSAR_Eth_43_PFE/BswModuleDescriptions/Eth/InternalBehavior_0/ETH_EXCLUSIVE_AREA_86</CAN-ENTER-EXCLUSIVE-AREA-REF>
                        <CAN-ENTER-EXCLUSIVE-AREA-REF DEST="EXCLUSIVE-AREA">/AUTOSAR_Eth_43_PFE/BswModuleDescriptions/Eth/InternalBehavior_0/ETH_EXCLUSIVE_AREA_88</CAN-ENTER-EXCLUSIVE-AREA-REF>
                        <CAN-ENTER-EXCLUSIVE-AREA-REF DEST="EXCLUSIVE-AREA">/AUTOSAR_Eth_43_PFE/BswModuleDescriptions/Eth/InternalBehavior_0/ETH_EXCLUSIVE_AREA_90</CAN-ENTER-EXCLUSIVE-AREA-REF>
                        <CAN-ENTER-EXCLUSIVE-AREA-REF DEST="EXCLUSIVE-AREA">/AUTOSAR_Eth_43_PFE/BswModuleDescriptions/Eth/InternalBehavior_0/ETH_EXCLUSIVE_AREA_91</CAN-ENTER-EXCLUSIVE-AREA-REF>
                        <CAN-ENTER-EXCLUSIVE-AREA-REF DEST="EXCLUSIVE-AREA">/AUTOSAR_Eth_43_PFE/BswModuleDescriptions/Eth/InternalBehavior_0/ETH_EXCLUSIVE_AREA_94</CAN-ENTER-EXCLUSIVE-AREA-REF>
                        <CAN-ENTER-EXCLUSIVE-AREA-REF DEST="EXCLUSIVE-AREA">/AUTOSAR_Eth_43_PFE/BswModuleDescriptions/Eth/InternalBehavior_0/ETH_EXCLUSIVE_AREA_95</CAN-ENTER-EXCLUSIVE-AREA-REF>
                        <CAN-ENTER-EXCLUSIVE-AREA-REF DEST="EXCLUSIVE-AREA">/AUTOSAR_Eth_43_PFE/BswModuleDescriptions/Eth/InternalBehavior_0/ETH_EXCLUSIVE_AREA_98</CAN-ENTER-EXCLUSIVE-AREA-REF>
                        <CAN-ENTER-EXCLUSIVE-AREA-REF DEST="EXCLUSIVE-AREA">/AUTOSAR_Eth_43_PFE/BswModuleDescriptions/Eth/InternalBehavior_0/ETH_EXCLUSIVE_AREA_100</CAN-ENTER-EXCLUSIVE-AREA-REF>
                        <CAN-ENTER-EXCLUSIVE-AREA-REF DEST="EXCLUSIVE-AREA">/AUTOSAR_Eth_43_PFE/BswModuleDescriptions/Eth/InternalBehavior_0/ETH_EXCLUSIVE_AREA_102</CAN-ENTER-EXCLUSIVE-AREA-REF>
                        <CAN-ENTER-EXCLUSIVE-AREA-REF DEST="EXCLUSIVE-AREA">/AUTOSAR_Eth_43_PFE/BswModuleDescriptions/Eth/InternalBehavior_0/ETH_EXCLUSIVE_AREA_104</CAN-ENTER-EXCLUSIVE-AREA-REF>
                      </CAN-ENTER-EXCLUSIVE-AREA-REFS>
                      <MINIMUM-START-INTERVAL>0.0</MINIMUM-START-INTERVAL>
                      <IMPLEMENTED-ENTRY-REF DEST="BSW-MODULE-ENTRY">/AUTOSAR_Eth_43_PFE/BswModuleEntrys/Eth_DeInit</IMPLEMENTED-ENTRY-REF>
                    </BSW-CALLED-ENTITY>
                    [!IF "EthGeneral/EthGetPFEStatisticApi = 'true'"!][!//
                    <BSW-CALLED-ENTITY>
                      <SHORT-NAME>Eth_43_PFE_GetL2BridgeDomainStats</SHORT-NAME>
                      <CAN-ENTER-EXCLUSIVE-AREA-REFS>
                        <CAN-ENTER-EXCLUSIVE-AREA-REF DEST="EXCLUSIVE-AREA">/AUTOSAR_Eth_43_PFE/BswModuleDescriptions/Eth/InternalBehavior_0/ETH_EXCLUSIVE_AREA_23</CAN-ENTER-EXCLUSIVE-AREA-REF>
                        <CAN-ENTER-EXCLUSIVE-AREA-REF DEST="EXCLUSIVE-AREA">/AUTOSAR_Eth_43_PFE/BswModuleDescriptions/Eth/InternalBehavior_0/ETH_EXCLUSIVE_AREA_31</CAN-ENTER-EXCLUSIVE-AREA-REF>
                      </CAN-ENTER-EXCLUSIVE-AREA-REFS>
                      <MINIMUM-START-INTERVAL>0.0</MINIMUM-START-INTERVAL>
                      <IMPLEMENTED-ENTRY-REF DEST="BSW-MODULE-ENTRY">/AUTOSAR_Eth_43_PFE/BswModuleEntrys/Eth_GetL2BridgeDomainStats</IMPLEMENTED-ENTRY-REF>
                    </BSW-CALLED-ENTITY>
                    <BSW-CALLED-ENTITY>
                      <SHORT-NAME>Eth_43_PFE_GetRtableStats</SHORT-NAME>
                      <CAN-ENTER-EXCLUSIVE-AREA-REFS>
                        <CAN-ENTER-EXCLUSIVE-AREA-REF DEST="EXCLUSIVE-AREA">/AUTOSAR_Eth_43_PFE/BswModuleDescriptions/Eth/InternalBehavior_0/ETH_EXCLUSIVE_AREA_23</CAN-ENTER-EXCLUSIVE-AREA-REF>
                        <CAN-ENTER-EXCLUSIVE-AREA-REF DEST="EXCLUSIVE-AREA">/AUTOSAR_Eth_43_PFE/BswModuleDescriptions/Eth/InternalBehavior_0/ETH_EXCLUSIVE_AREA_31</CAN-ENTER-EXCLUSIVE-AREA-REF>
                      </CAN-ENTER-EXCLUSIVE-AREA-REFS>
                      <MINIMUM-START-INTERVAL>0.0</MINIMUM-START-INTERVAL>
                      <IMPLEMENTED-ENTRY-REF DEST="BSW-MODULE-ENTRY">/AUTOSAR_Eth_43_PFE/BswModuleEntrys/Eth_GetRtableStats</IMPLEMENTED-ENTRY-REF>
                    </BSW-CALLED-ENTITY>
                    <BSW-CALLED-ENTITY>
                      <SHORT-NAME>Eth_43_PFE_GetBmuStats</SHORT-NAME>
                      <MINIMUM-START-INTERVAL>0.0</MINIMUM-START-INTERVAL>
                      <IMPLEMENTED-ENTRY-REF DEST="BSW-MODULE-ENTRY">/AUTOSAR_Eth_43_PFE/BswModuleEntrys/Eth_GetBmuStats</IMPLEMENTED-ENTRY-REF>
                    </BSW-CALLED-ENTITY>
                    <BSW-CALLED-ENTITY>
                      <SHORT-NAME>Eth_43_PFE_GetGpiStats</SHORT-NAME>
                      <MINIMUM-START-INTERVAL>0.0</MINIMUM-START-INTERVAL>
                      <IMPLEMENTED-ENTRY-REF DEST="BSW-MODULE-ENTRY">/AUTOSAR_Eth_43_PFE/BswModuleEntrys/Eth_GetGpiStats</IMPLEMENTED-ENTRY-REF>
                    </BSW-CALLED-ENTITY>
                    <BSW-CALLED-ENTITY>
                      <SHORT-NAME>Eth_43_PFE_GetL2BridgeStats</SHORT-NAME>
                      <MINIMUM-START-INTERVAL>0.0</MINIMUM-START-INTERVAL>
                      <IMPLEMENTED-ENTRY-REF DEST="BSW-MODULE-ENTRY">/AUTOSAR_Eth_43_PFE/BswModuleEntrys/Eth_GetL2BridgeStats</IMPLEMENTED-ENTRY-REF>
                    </BSW-CALLED-ENTITY>
                    <BSW-CALLED-ENTITY>
                      <SHORT-NAME>Eth_43_PFE_GetWdtStats</SHORT-NAME>
                      <MINIMUM-START-INTERVAL>0.0</MINIMUM-START-INTERVAL>
                      <IMPLEMENTED-ENTRY-REF DEST="BSW-MODULE-ENTRY">/AUTOSAR_Eth_43_PFE/BswModuleEntrys/Eth_GetWdtStats</IMPLEMENTED-ENTRY-REF>
                    </BSW-CALLED-ENTITY>
                    <BSW-CALLED-ENTITY>
                      <SHORT-NAME>Eth_43_PFE_GetTmuStats</SHORT-NAME>
                      <MINIMUM-START-INTERVAL>0.0</MINIMUM-START-INTERVAL>
                      <IMPLEMENTED-ENTRY-REF DEST="BSW-MODULE-ENTRY">/AUTOSAR_Eth_43_PFE/BswModuleEntrys/Eth_GetTmuStats</IMPLEMENTED-ENTRY-REF>
                    </BSW-CALLED-ENTITY>
                    [!ENDIF!][!//
                    <BSW-CALLED-ENTITY>
                      <SHORT-NAME>Eth_43_PFE_PreInit</SHORT-NAME>
                      <MINIMUM-START-INTERVAL>0.0</MINIMUM-START-INTERVAL>
                      <IMPLEMENTED-ENTRY-REF DEST="BSW-MODULE-ENTRY">/AUTOSAR_Eth_43_PFE/BswModuleEntrys/Eth_PreInit</IMPLEMENTED-ENTRY-REF>
                    </BSW-CALLED-ENTITY>
                    <BSW-CALLED-ENTITY>
                      <SHORT-NAME>Eth_43_PFE_GetPlatform</SHORT-NAME>
                      <MINIMUM-START-INTERVAL>0.0</MINIMUM-START-INTERVAL>
                      <IMPLEMENTED-ENTRY-REF DEST="BSW-MODULE-ENTRY">/AUTOSAR_Eth_43_PFE/BswModuleEntrys/Eth_GetPlatform</IMPLEMENTED-ENTRY-REF>
                    </BSW-CALLED-ENTITY>
                    <BSW-CALLED-ENTITY>
                      <SHORT-NAME>Eth_43_PFE_SetControllerMode</SHORT-NAME>
                      <CAN-ENTER-EXCLUSIVE-AREA-REFS>
                        <CAN-ENTER-EXCLUSIVE-AREA-REF DEST="EXCLUSIVE-AREA">/AUTOSAR_Eth_43_PFE/BswModuleDescriptions/Eth/InternalBehavior_0/ETH_EXCLUSIVE_AREA_09</CAN-ENTER-EXCLUSIVE-AREA-REF>
                        <CAN-ENTER-EXCLUSIVE-AREA-REF DEST="EXCLUSIVE-AREA">/AUTOSAR_Eth_43_PFE/BswModuleDescriptions/Eth/InternalBehavior_0/ETH_EXCLUSIVE_AREA_10</CAN-ENTER-EXCLUSIVE-AREA-REF>
                        <CAN-ENTER-EXCLUSIVE-AREA-REF DEST="EXCLUSIVE-AREA">/AUTOSAR_Eth_43_PFE/BswModuleDescriptions/Eth/InternalBehavior_0/ETH_EXCLUSIVE_AREA_22</CAN-ENTER-EXCLUSIVE-AREA-REF>
                        <CAN-ENTER-EXCLUSIVE-AREA-REF DEST="EXCLUSIVE-AREA">/AUTOSAR_Eth_43_PFE/BswModuleDescriptions/Eth/InternalBehavior_0/ETH_EXCLUSIVE_AREA_30</CAN-ENTER-EXCLUSIVE-AREA-REF>
                        <CAN-ENTER-EXCLUSIVE-AREA-REF DEST="EXCLUSIVE-AREA">/AUTOSAR_Eth_43_PFE/BswModuleDescriptions/Eth/InternalBehavior_0/ETH_EXCLUSIVE_AREA_37</CAN-ENTER-EXCLUSIVE-AREA-REF>
                        <CAN-ENTER-EXCLUSIVE-AREA-REF DEST="EXCLUSIVE-AREA">/AUTOSAR_Eth_43_PFE/BswModuleDescriptions/Eth/InternalBehavior_0/ETH_EXCLUSIVE_AREA_38</CAN-ENTER-EXCLUSIVE-AREA-REF>
                        <CAN-ENTER-EXCLUSIVE-AREA-REF DEST="EXCLUSIVE-AREA">/AUTOSAR_Eth_43_PFE/BswModuleDescriptions/Eth/InternalBehavior_0/ETH_EXCLUSIVE_AREA_39</CAN-ENTER-EXCLUSIVE-AREA-REF>
                        <CAN-ENTER-EXCLUSIVE-AREA-REF DEST="EXCLUSIVE-AREA">/AUTOSAR_Eth_43_PFE/BswModuleDescriptions/Eth/InternalBehavior_0/ETH_EXCLUSIVE_AREA_45</CAN-ENTER-EXCLUSIVE-AREA-REF>
                        <CAN-ENTER-EXCLUSIVE-AREA-REF DEST="EXCLUSIVE-AREA">/AUTOSAR_Eth_43_PFE/BswModuleDescriptions/Eth/InternalBehavior_0/ETH_EXCLUSIVE_AREA_46</CAN-ENTER-EXCLUSIVE-AREA-REF>
                        <CAN-ENTER-EXCLUSIVE-AREA-REF DEST="EXCLUSIVE-AREA">/AUTOSAR_Eth_43_PFE/BswModuleDescriptions/Eth/InternalBehavior_0/ETH_EXCLUSIVE_AREA_47</CAN-ENTER-EXCLUSIVE-AREA-REF>
                        <CAN-ENTER-EXCLUSIVE-AREA-REF DEST="EXCLUSIVE-AREA">/AUTOSAR_Eth_43_PFE/BswModuleDescriptions/Eth/InternalBehavior_0/ETH_EXCLUSIVE_AREA_48</CAN-ENTER-EXCLUSIVE-AREA-REF>
                        <CAN-ENTER-EXCLUSIVE-AREA-REF DEST="EXCLUSIVE-AREA">/AUTOSAR_Eth_43_PFE/BswModuleDescriptions/Eth/InternalBehavior_0/ETH_EXCLUSIVE_AREA_49</CAN-ENTER-EXCLUSIVE-AREA-REF>
                        <CAN-ENTER-EXCLUSIVE-AREA-REF DEST="EXCLUSIVE-AREA">/AUTOSAR_Eth_43_PFE/BswModuleDescriptions/Eth/InternalBehavior_0/ETH_EXCLUSIVE_AREA_50</CAN-ENTER-EXCLUSIVE-AREA-REF>
                        <CAN-ENTER-EXCLUSIVE-AREA-REF DEST="EXCLUSIVE-AREA">/AUTOSAR_Eth_43_PFE/BswModuleDescriptions/Eth/InternalBehavior_0/ETH_EXCLUSIVE_AREA_51</CAN-ENTER-EXCLUSIVE-AREA-REF>
                        <CAN-ENTER-EXCLUSIVE-AREA-REF DEST="EXCLUSIVE-AREA">/AUTOSAR_Eth_43_PFE/BswModuleDescriptions/Eth/InternalBehavior_0/ETH_EXCLUSIVE_AREA_52</CAN-ENTER-EXCLUSIVE-AREA-REF>
                        <CAN-ENTER-EXCLUSIVE-AREA-REF DEST="EXCLUSIVE-AREA">/AUTOSAR_Eth_43_PFE/BswModuleDescriptions/Eth/InternalBehavior_0/ETH_EXCLUSIVE_AREA_54</CAN-ENTER-EXCLUSIVE-AREA-REF>
                        <CAN-ENTER-EXCLUSIVE-AREA-REF DEST="EXCLUSIVE-AREA">/AUTOSAR_Eth_43_PFE/BswModuleDescriptions/Eth/InternalBehavior_0/ETH_EXCLUSIVE_AREA_55</CAN-ENTER-EXCLUSIVE-AREA-REF>
                        <CAN-ENTER-EXCLUSIVE-AREA-REF DEST="EXCLUSIVE-AREA">/AUTOSAR_Eth_43_PFE/BswModuleDescriptions/Eth/InternalBehavior_0/ETH_EXCLUSIVE_AREA_56</CAN-ENTER-EXCLUSIVE-AREA-REF>
                        <CAN-ENTER-EXCLUSIVE-AREA-REF DEST="EXCLUSIVE-AREA">/AUTOSAR_Eth_43_PFE/BswModuleDescriptions/Eth/InternalBehavior_0/ETH_EXCLUSIVE_AREA_91</CAN-ENTER-EXCLUSIVE-AREA-REF>
                        <CAN-ENTER-EXCLUSIVE-AREA-REF DEST="EXCLUSIVE-AREA">/AUTOSAR_Eth_43_PFE/BswModuleDescriptions/Eth/InternalBehavior_0/ETH_EXCLUSIVE_AREA_94</CAN-ENTER-EXCLUSIVE-AREA-REF>
                        <CAN-ENTER-EXCLUSIVE-AREA-REF DEST="EXCLUSIVE-AREA">/AUTOSAR_Eth_43_PFE/BswModuleDescriptions/Eth/InternalBehavior_0/ETH_EXCLUSIVE_AREA_100</CAN-ENTER-EXCLUSIVE-AREA-REF>
                        <CAN-ENTER-EXCLUSIVE-AREA-REF DEST="EXCLUSIVE-AREA">/AUTOSAR_Eth_43_PFE/BswModuleDescriptions/Eth/InternalBehavior_0/ETH_EXCLUSIVE_AREA_102</CAN-ENTER-EXCLUSIVE-AREA-REF>
                      </CAN-ENTER-EXCLUSIVE-AREA-REFS>
                      <MINIMUM-START-INTERVAL>0.0</MINIMUM-START-INTERVAL>
                      <IMPLEMENTED-ENTRY-REF DEST="BSW-MODULE-ENTRY">/AUTOSAR_Eth_43_PFE/BswModuleEntrys/Eth_SetControllerMode</IMPLEMENTED-ENTRY-REF>
                    </BSW-CALLED-ENTITY>
                    <BSW-CALLED-ENTITY>
                      <SHORT-NAME>Eth_43_PFE_GetControllerMode</SHORT-NAME>
                      <MINIMUM-START-INTERVAL>0.0</MINIMUM-START-INTERVAL>
                      <IMPLEMENTED-ENTRY-REF DEST="BSW-MODULE-ENTRY">/AUTOSAR_Eth_43_PFE/BswModuleEntrys/Eth_GetControllerMode</IMPLEMENTED-ENTRY-REF>
                    </BSW-CALLED-ENTITY>
                    <BSW-CALLED-ENTITY>
                      <SHORT-NAME>Eth_43_PFE_GetPhysAddr</SHORT-NAME>
                      <MINIMUM-START-INTERVAL>0.0</MINIMUM-START-INTERVAL>
                      <IMPLEMENTED-ENTRY-REF DEST="BSW-MODULE-ENTRY">/AUTOSAR_Eth_43_PFE/BswModuleEntrys/Eth_GetPhysAddr</IMPLEMENTED-ENTRY-REF>
                    </BSW-CALLED-ENTITY>
                    <BSW-CALLED-ENTITY>
                      <SHORT-NAME>Eth_43_PFE_SetPhysAddr</SHORT-NAME>
                      <CAN-ENTER-EXCLUSIVE-AREA-REFS>
                        <CAN-ENTER-EXCLUSIVE-AREA-REF DEST="EXCLUSIVE-AREA">/AUTOSAR_Eth_43_PFE/BswModuleDescriptions/Eth/InternalBehavior_0/ETH_EXCLUSIVE_AREA_38</CAN-ENTER-EXCLUSIVE-AREA-REF>
                        <CAN-ENTER-EXCLUSIVE-AREA-REF DEST="EXCLUSIVE-AREA">/AUTOSAR_Eth_43_PFE/BswModuleDescriptions/Eth/InternalBehavior_0/ETH_EXCLUSIVE_AREA_39</CAN-ENTER-EXCLUSIVE-AREA-REF>
                        <CAN-ENTER-EXCLUSIVE-AREA-REF DEST="EXCLUSIVE-AREA">/AUTOSAR_Eth_43_PFE/BswModuleDescriptions/Eth/InternalBehavior_0/ETH_EXCLUSIVE_AREA_52</CAN-ENTER-EXCLUSIVE-AREA-REF>
                        <CAN-ENTER-EXCLUSIVE-AREA-REF DEST="EXCLUSIVE-AREA">/AUTOSAR_Eth_43_PFE/BswModuleDescriptions/Eth/InternalBehavior_0/ETH_EXCLUSIVE_AREA_54</CAN-ENTER-EXCLUSIVE-AREA-REF>
                        <CAN-ENTER-EXCLUSIVE-AREA-REF DEST="EXCLUSIVE-AREA">/AUTOSAR_Eth_43_PFE/BswModuleDescriptions/Eth/InternalBehavior_0/ETH_EXCLUSIVE_AREA_55</CAN-ENTER-EXCLUSIVE-AREA-REF>
                        <CAN-ENTER-EXCLUSIVE-AREA-REF DEST="EXCLUSIVE-AREA">/AUTOSAR_Eth_43_PFE/BswModuleDescriptions/Eth/InternalBehavior_0/ETH_EXCLUSIVE_AREA_56</CAN-ENTER-EXCLUSIVE-AREA-REF>
                        <CAN-ENTER-EXCLUSIVE-AREA-REF DEST="EXCLUSIVE-AREA">/AUTOSAR_Eth_43_PFE/BswModuleDescriptions/Eth/InternalBehavior_0/ETH_EXCLUSIVE_AREA_58</CAN-ENTER-EXCLUSIVE-AREA-REF>
                        <CAN-ENTER-EXCLUSIVE-AREA-REF DEST="EXCLUSIVE-AREA">/AUTOSAR_Eth_43_PFE/BswModuleDescriptions/Eth/InternalBehavior_0/ETH_EXCLUSIVE_AREA_59</CAN-ENTER-EXCLUSIVE-AREA-REF>
                        <CAN-ENTER-EXCLUSIVE-AREA-REF DEST="EXCLUSIVE-AREA">/AUTOSAR_Eth_43_PFE/BswModuleDescriptions/Eth/InternalBehavior_0/ETH_EXCLUSIVE_AREA_100</CAN-ENTER-EXCLUSIVE-AREA-REF>
                      </CAN-ENTER-EXCLUSIVE-AREA-REFS>
                      <MINIMUM-START-INTERVAL>0.0</MINIMUM-START-INTERVAL>
                      <IMPLEMENTED-ENTRY-REF DEST="BSW-MODULE-ENTRY">/AUTOSAR_Eth_43_PFE/BswModuleEntrys/Eth_SetPhysAddr</IMPLEMENTED-ENTRY-REF>
                    </BSW-CALLED-ENTITY>
                    <BSW-CALLED-ENTITY>
                      <SHORT-NAME>Eth_43_PFE_ProvideTxBuffer</SHORT-NAME>
                      <CAN-ENTER-EXCLUSIVE-AREA-REFS>
                        <CAN-ENTER-EXCLUSIVE-AREA-REF DEST="EXCLUSIVE-AREA">/AUTOSAR_Eth_43_PFE/BswModuleDescriptions/Eth/InternalBehavior_0/ETH_EXCLUSIVE_AREA_19</CAN-ENTER-EXCLUSIVE-AREA-REF>
                        <CAN-ENTER-EXCLUSIVE-AREA-REF DEST="EXCLUSIVE-AREA">/AUTOSAR_Eth_43_PFE/BswModuleDescriptions/Eth/InternalBehavior_0/ETH_EXCLUSIVE_AREA_55</CAN-ENTER-EXCLUSIVE-AREA-REF>
                      </CAN-ENTER-EXCLUSIVE-AREA-REFS>
                      <MINIMUM-START-INTERVAL>0.0</MINIMUM-START-INTERVAL>
                      <IMPLEMENTED-ENTRY-REF DEST="BSW-MODULE-ENTRY">/AUTOSAR_Eth_43_PFE/BswModuleEntrys/Eth_ProvideTxBuffer</IMPLEMENTED-ENTRY-REF>
                    </BSW-CALLED-ENTITY>
                    [!IF "EthGeneral/EthVendorSpecific/EthReleaseTxBufferApi = 'true'"!][!//
                    <BSW-CALLED-ENTITY>
                      <SHORT-NAME>Eth_43_PFE_ReleaseTxBuffer</SHORT-NAME>
                      <CAN-ENTER-EXCLUSIVE-AREA-REFS>
                        <CAN-ENTER-EXCLUSIVE-AREA-REF DEST="EXCLUSIVE-AREA">/AUTOSAR_Eth_43_PFE/BswModuleDescriptions/Eth/InternalBehavior_0/ETH_EXCLUSIVE_AREA_55</CAN-ENTER-EXCLUSIVE-AREA-REF>
                      </CAN-ENTER-EXCLUSIVE-AREA-REFS>
                      <MINIMUM-START-INTERVAL>0.0</MINIMUM-START-INTERVAL>
                      <IMPLEMENTED-ENTRY-REF DEST="BSW-MODULE-ENTRY">/AUTOSAR_Eth_43_PFE/BswModuleEntrys/Eth_ReleaseTxBuffer</IMPLEMENTED-ENTRY-REF>
                    </BSW-CALLED-ENTITY>
                    [!ENDIF!][!//
                    <BSW-CALLED-ENTITY>
                      <SHORT-NAME>Eth_43_PFE_UpdatePhysAddrFilter</SHORT-NAME>
                      <CAN-ENTER-EXCLUSIVE-AREA-REFS>
                        <CAN-ENTER-EXCLUSIVE-AREA-REF DEST="EXCLUSIVE-AREA">/AUTOSAR_Eth_43_PFE/BswModuleDescriptions/Eth/InternalBehavior_0/ETH_EXCLUSIVE_AREA_01</CAN-ENTER-EXCLUSIVE-AREA-REF>
                        <CAN-ENTER-EXCLUSIVE-AREA-REF DEST="EXCLUSIVE-AREA">/AUTOSAR_Eth_43_PFE/BswModuleDescriptions/Eth/InternalBehavior_0/ETH_EXCLUSIVE_AREA_03</CAN-ENTER-EXCLUSIVE-AREA-REF>
                        <CAN-ENTER-EXCLUSIVE-AREA-REF DEST="EXCLUSIVE-AREA">/AUTOSAR_Eth_43_PFE/BswModuleDescriptions/Eth/InternalBehavior_0/ETH_EXCLUSIVE_AREA_04</CAN-ENTER-EXCLUSIVE-AREA-REF>
                        <CAN-ENTER-EXCLUSIVE-AREA-REF DEST="EXCLUSIVE-AREA">/AUTOSAR_Eth_43_PFE/BswModuleDescriptions/Eth/InternalBehavior_0/ETH_EXCLUSIVE_AREA_06</CAN-ENTER-EXCLUSIVE-AREA-REF>
                        <CAN-ENTER-EXCLUSIVE-AREA-REF DEST="EXCLUSIVE-AREA">/AUTOSAR_Eth_43_PFE/BswModuleDescriptions/Eth/InternalBehavior_0/ETH_EXCLUSIVE_AREA_07</CAN-ENTER-EXCLUSIVE-AREA-REF>
                        <CAN-ENTER-EXCLUSIVE-AREA-REF DEST="EXCLUSIVE-AREA">/AUTOSAR_Eth_43_PFE/BswModuleDescriptions/Eth/InternalBehavior_0/ETH_EXCLUSIVE_AREA_08</CAN-ENTER-EXCLUSIVE-AREA-REF>
                        <CAN-ENTER-EXCLUSIVE-AREA-REF DEST="EXCLUSIVE-AREA">/AUTOSAR_Eth_43_PFE/BswModuleDescriptions/Eth/InternalBehavior_0/ETH_EXCLUSIVE_AREA_09</CAN-ENTER-EXCLUSIVE-AREA-REF>
                        <CAN-ENTER-EXCLUSIVE-AREA-REF DEST="EXCLUSIVE-AREA">/AUTOSAR_Eth_43_PFE/BswModuleDescriptions/Eth/InternalBehavior_0/ETH_EXCLUSIVE_AREA_22</CAN-ENTER-EXCLUSIVE-AREA-REF>
                        <CAN-ENTER-EXCLUSIVE-AREA-REF DEST="EXCLUSIVE-AREA">/AUTOSAR_Eth_43_PFE/BswModuleDescriptions/Eth/InternalBehavior_0/ETH_EXCLUSIVE_AREA_30</CAN-ENTER-EXCLUSIVE-AREA-REF>
                        <CAN-ENTER-EXCLUSIVE-AREA-REF DEST="EXCLUSIVE-AREA">/AUTOSAR_Eth_43_PFE/BswModuleDescriptions/Eth/InternalBehavior_0/ETH_EXCLUSIVE_AREA_38</CAN-ENTER-EXCLUSIVE-AREA-REF>
                        <CAN-ENTER-EXCLUSIVE-AREA-REF DEST="EXCLUSIVE-AREA">/AUTOSAR_Eth_43_PFE/BswModuleDescriptions/Eth/InternalBehavior_0/ETH_EXCLUSIVE_AREA_39</CAN-ENTER-EXCLUSIVE-AREA-REF>
                        <CAN-ENTER-EXCLUSIVE-AREA-REF DEST="EXCLUSIVE-AREA">/AUTOSAR_Eth_43_PFE/BswModuleDescriptions/Eth/InternalBehavior_0/ETH_EXCLUSIVE_AREA_45</CAN-ENTER-EXCLUSIVE-AREA-REF>
                        <CAN-ENTER-EXCLUSIVE-AREA-REF DEST="EXCLUSIVE-AREA">/AUTOSAR_Eth_43_PFE/BswModuleDescriptions/Eth/InternalBehavior_0/ETH_EXCLUSIVE_AREA_46</CAN-ENTER-EXCLUSIVE-AREA-REF>
                        <CAN-ENTER-EXCLUSIVE-AREA-REF DEST="EXCLUSIVE-AREA">/AUTOSAR_Eth_43_PFE/BswModuleDescriptions/Eth/InternalBehavior_0/ETH_EXCLUSIVE_AREA_47</CAN-ENTER-EXCLUSIVE-AREA-REF>
                        <CAN-ENTER-EXCLUSIVE-AREA-REF DEST="EXCLUSIVE-AREA">/AUTOSAR_Eth_43_PFE/BswModuleDescriptions/Eth/InternalBehavior_0/ETH_EXCLUSIVE_AREA_48</CAN-ENTER-EXCLUSIVE-AREA-REF>
                        <CAN-ENTER-EXCLUSIVE-AREA-REF DEST="EXCLUSIVE-AREA">/AUTOSAR_Eth_43_PFE/BswModuleDescriptions/Eth/InternalBehavior_0/ETH_EXCLUSIVE_AREA_52</CAN-ENTER-EXCLUSIVE-AREA-REF>
                        <CAN-ENTER-EXCLUSIVE-AREA-REF DEST="EXCLUSIVE-AREA">/AUTOSAR_Eth_43_PFE/BswModuleDescriptions/Eth/InternalBehavior_0/ETH_EXCLUSIVE_AREA_54</CAN-ENTER-EXCLUSIVE-AREA-REF>
                        <CAN-ENTER-EXCLUSIVE-AREA-REF DEST="EXCLUSIVE-AREA">/AUTOSAR_Eth_43_PFE/BswModuleDescriptions/Eth/InternalBehavior_0/ETH_EXCLUSIVE_AREA_55</CAN-ENTER-EXCLUSIVE-AREA-REF>
                        <CAN-ENTER-EXCLUSIVE-AREA-REF DEST="EXCLUSIVE-AREA">/AUTOSAR_Eth_43_PFE/BswModuleDescriptions/Eth/InternalBehavior_0/ETH_EXCLUSIVE_AREA_56</CAN-ENTER-EXCLUSIVE-AREA-REF>
                        <CAN-ENTER-EXCLUSIVE-AREA-REF DEST="EXCLUSIVE-AREA">/AUTOSAR_Eth_43_PFE/BswModuleDescriptions/Eth/InternalBehavior_0/ETH_EXCLUSIVE_AREA_57</CAN-ENTER-EXCLUSIVE-AREA-REF>
                        <CAN-ENTER-EXCLUSIVE-AREA-REF DEST="EXCLUSIVE-AREA">/AUTOSAR_Eth_43_PFE/BswModuleDescriptions/Eth/InternalBehavior_0/ETH_EXCLUSIVE_AREA_58</CAN-ENTER-EXCLUSIVE-AREA-REF>
                        <CAN-ENTER-EXCLUSIVE-AREA-REF DEST="EXCLUSIVE-AREA">/AUTOSAR_Eth_43_PFE/BswModuleDescriptions/Eth/InternalBehavior_0/ETH_EXCLUSIVE_AREA_59</CAN-ENTER-EXCLUSIVE-AREA-REF>
                        <CAN-ENTER-EXCLUSIVE-AREA-REF DEST="EXCLUSIVE-AREA">/AUTOSAR_Eth_43_PFE/BswModuleDescriptions/Eth/InternalBehavior_0/ETH_EXCLUSIVE_AREA_85</CAN-ENTER-EXCLUSIVE-AREA-REF>
                        <CAN-ENTER-EXCLUSIVE-AREA-REF DEST="EXCLUSIVE-AREA">/AUTOSAR_Eth_43_PFE/BswModuleDescriptions/Eth/InternalBehavior_0/ETH_EXCLUSIVE_AREA_86</CAN-ENTER-EXCLUSIVE-AREA-REF>
                        <CAN-ENTER-EXCLUSIVE-AREA-REF DEST="EXCLUSIVE-AREA">/AUTOSAR_Eth_43_PFE/BswModuleDescriptions/Eth/InternalBehavior_0/ETH_EXCLUSIVE_AREA_88</CAN-ENTER-EXCLUSIVE-AREA-REF>
                        <CAN-ENTER-EXCLUSIVE-AREA-REF DEST="EXCLUSIVE-AREA">/AUTOSAR_Eth_43_PFE/BswModuleDescriptions/Eth/InternalBehavior_0/ETH_EXCLUSIVE_AREA_90</CAN-ENTER-EXCLUSIVE-AREA-REF>
                        <CAN-ENTER-EXCLUSIVE-AREA-REF DEST="EXCLUSIVE-AREA">/AUTOSAR_Eth_43_PFE/BswModuleDescriptions/Eth/InternalBehavior_0/ETH_EXCLUSIVE_AREA_100</CAN-ENTER-EXCLUSIVE-AREA-REF>
                      </CAN-ENTER-EXCLUSIVE-AREA-REFS>
                      <MINIMUM-START-INTERVAL>0.0</MINIMUM-START-INTERVAL>
                      <IMPLEMENTED-ENTRY-REF DEST="BSW-MODULE-ENTRY">/AUTOSAR_Eth_43_PFE/BswModuleEntrys/Eth_UpdatePhysAddrFilter</IMPLEMENTED-ENTRY-REF>
                    </BSW-CALLED-ENTITY>
                    <BSW-CALLED-ENTITY>
                      <SHORT-NAME>Eth_43_PFE_Transmit</SHORT-NAME>
                      <CAN-ENTER-EXCLUSIVE-AREA-REFS>
                        <CAN-ENTER-EXCLUSIVE-AREA-REF DEST="EXCLUSIVE-AREA">/AUTOSAR_Eth_43_PFE/BswModuleDescriptions/Eth/InternalBehavior_0/ETH_EXCLUSIVE_AREA_17</CAN-ENTER-EXCLUSIVE-AREA-REF>
                        <CAN-ENTER-EXCLUSIVE-AREA-REF DEST="EXCLUSIVE-AREA">/AUTOSAR_Eth_43_PFE/BswModuleDescriptions/Eth/InternalBehavior_0/ETH_EXCLUSIVE_AREA_38</CAN-ENTER-EXCLUSIVE-AREA-REF>
                        <CAN-ENTER-EXCLUSIVE-AREA-REF DEST="EXCLUSIVE-AREA">/AUTOSAR_Eth_43_PFE/BswModuleDescriptions/Eth/InternalBehavior_0/ETH_EXCLUSIVE_AREA_39</CAN-ENTER-EXCLUSIVE-AREA-REF>
                        <CAN-ENTER-EXCLUSIVE-AREA-REF DEST="EXCLUSIVE-AREA">/AUTOSAR_Eth_43_PFE/BswModuleDescriptions/Eth/InternalBehavior_0/ETH_EXCLUSIVE_AREA_42</CAN-ENTER-EXCLUSIVE-AREA-REF>
                        <CAN-ENTER-EXCLUSIVE-AREA-REF DEST="EXCLUSIVE-AREA">/AUTOSAR_Eth_43_PFE/BswModuleDescriptions/Eth/InternalBehavior_0/ETH_EXCLUSIVE_AREA_43</CAN-ENTER-EXCLUSIVE-AREA-REF>
                        <CAN-ENTER-EXCLUSIVE-AREA-REF DEST="EXCLUSIVE-AREA">/AUTOSAR_Eth_43_PFE/BswModuleDescriptions/Eth/InternalBehavior_0/ETH_EXCLUSIVE_AREA_52</CAN-ENTER-EXCLUSIVE-AREA-REF>
                        <CAN-ENTER-EXCLUSIVE-AREA-REF DEST="EXCLUSIVE-AREA">/AUTOSAR_Eth_43_PFE/BswModuleDescriptions/Eth/InternalBehavior_0/ETH_EXCLUSIVE_AREA_54</CAN-ENTER-EXCLUSIVE-AREA-REF>
                        <CAN-ENTER-EXCLUSIVE-AREA-REF DEST="EXCLUSIVE-AREA">/AUTOSAR_Eth_43_PFE/BswModuleDescriptions/Eth/InternalBehavior_0/ETH_EXCLUSIVE_AREA_56</CAN-ENTER-EXCLUSIVE-AREA-REF>
                        <CAN-ENTER-EXCLUSIVE-AREA-REF DEST="EXCLUSIVE-AREA">/AUTOSAR_Eth_43_PFE/BswModuleDescriptions/Eth/InternalBehavior_0/ETH_EXCLUSIVE_AREA_91</CAN-ENTER-EXCLUSIVE-AREA-REF>
                        <CAN-ENTER-EXCLUSIVE-AREA-REF DEST="EXCLUSIVE-AREA">/AUTOSAR_Eth_43_PFE/BswModuleDescriptions/Eth/InternalBehavior_0/ETH_EXCLUSIVE_AREA_92</CAN-ENTER-EXCLUSIVE-AREA-REF>
                        <CAN-ENTER-EXCLUSIVE-AREA-REF DEST="EXCLUSIVE-AREA">/AUTOSAR_Eth_43_PFE/BswModuleDescriptions/Eth/InternalBehavior_0/ETH_EXCLUSIVE_AREA_93</CAN-ENTER-EXCLUSIVE-AREA-REF>
                        <CAN-ENTER-EXCLUSIVE-AREA-REF DEST="EXCLUSIVE-AREA">/AUTOSAR_Eth_43_PFE/BswModuleDescriptions/Eth/InternalBehavior_0/ETH_EXCLUSIVE_AREA_100</CAN-ENTER-EXCLUSIVE-AREA-REF>
                      </CAN-ENTER-EXCLUSIVE-AREA-REFS>
                      <MINIMUM-START-INTERVAL>0.0</MINIMUM-START-INTERVAL>
                      <IMPLEMENTED-ENTRY-REF DEST="BSW-MODULE-ENTRY">/AUTOSAR_Eth_43_PFE/BswModuleEntrys/Eth_Transmit</IMPLEMENTED-ENTRY-REF>
                    </BSW-CALLED-ENTITY>
                    <BSW-CALLED-ENTITY>
                      <SHORT-NAME>Eth_43_PFE_Receive</SHORT-NAME>
                      <CAN-ENTER-EXCLUSIVE-AREA-REFS>
                        <CAN-ENTER-EXCLUSIVE-AREA-REF DEST="EXCLUSIVE-AREA">/AUTOSAR_Eth_43_PFE/BswModuleDescriptions/Eth/InternalBehavior_0/ETH_EXCLUSIVE_AREA_38</CAN-ENTER-EXCLUSIVE-AREA-REF>
                        <CAN-ENTER-EXCLUSIVE-AREA-REF DEST="EXCLUSIVE-AREA">/AUTOSAR_Eth_43_PFE/BswModuleDescriptions/Eth/InternalBehavior_0/ETH_EXCLUSIVE_AREA_39</CAN-ENTER-EXCLUSIVE-AREA-REF>
                        <CAN-ENTER-EXCLUSIVE-AREA-REF DEST="EXCLUSIVE-AREA">/AUTOSAR_Eth_43_PFE/BswModuleDescriptions/Eth/InternalBehavior_0/ETH_EXCLUSIVE_AREA_50</CAN-ENTER-EXCLUSIVE-AREA-REF>
                        <CAN-ENTER-EXCLUSIVE-AREA-REF DEST="EXCLUSIVE-AREA">/AUTOSAR_Eth_43_PFE/BswModuleDescriptions/Eth/InternalBehavior_0/ETH_EXCLUSIVE_AREA_55</CAN-ENTER-EXCLUSIVE-AREA-REF>
                        <CAN-ENTER-EXCLUSIVE-AREA-REF DEST="EXCLUSIVE-AREA">/AUTOSAR_Eth_43_PFE/BswModuleDescriptions/Eth/InternalBehavior_0/ETH_EXCLUSIVE_AREA_56</CAN-ENTER-EXCLUSIVE-AREA-REF>
                        <CAN-ENTER-EXCLUSIVE-AREA-REF DEST="EXCLUSIVE-AREA">/AUTOSAR_Eth_43_PFE/BswModuleDescriptions/Eth/InternalBehavior_0/ETH_EXCLUSIVE_AREA_100</CAN-ENTER-EXCLUSIVE-AREA-REF>
                      </CAN-ENTER-EXCLUSIVE-AREA-REFS>
                      <MINIMUM-START-INTERVAL>0.0</MINIMUM-START-INTERVAL>
                      <IMPLEMENTED-ENTRY-REF DEST="BSW-MODULE-ENTRY">/AUTOSAR_Eth_43_PFE/BswModuleEntrys/Eth_Receive</IMPLEMENTED-ENTRY-REF>
                    </BSW-CALLED-ENTITY>
                    <BSW-CALLED-ENTITY>
                      <SHORT-NAME>Eth_43_PFE_TxConfirmation</SHORT-NAME>
                      <CAN-ENTER-EXCLUSIVE-AREA-REFS>
                        <CAN-ENTER-EXCLUSIVE-AREA-REF DEST="EXCLUSIVE-AREA">/AUTOSAR_Eth_43_PFE/BswModuleDescriptions/Eth/InternalBehavior_0/ETH_EXCLUSIVE_AREA_18</CAN-ENTER-EXCLUSIVE-AREA-REF>
                        <CAN-ENTER-EXCLUSIVE-AREA-REF DEST="EXCLUSIVE-AREA">/AUTOSAR_Eth_43_PFE/BswModuleDescriptions/Eth/InternalBehavior_0/ETH_EXCLUSIVE_AREA_20</CAN-ENTER-EXCLUSIVE-AREA-REF>
                        <CAN-ENTER-EXCLUSIVE-AREA-REF DEST="EXCLUSIVE-AREA">/AUTOSAR_Eth_43_PFE/BswModuleDescriptions/Eth/InternalBehavior_0/ETH_EXCLUSIVE_AREA_21</CAN-ENTER-EXCLUSIVE-AREA-REF>
                        <CAN-ENTER-EXCLUSIVE-AREA-REF DEST="EXCLUSIVE-AREA">/AUTOSAR_Eth_43_PFE/BswModuleDescriptions/Eth/InternalBehavior_0/ETH_EXCLUSIVE_AREA_38</CAN-ENTER-EXCLUSIVE-AREA-REF>
                        <CAN-ENTER-EXCLUSIVE-AREA-REF DEST="EXCLUSIVE-AREA">/AUTOSAR_Eth_43_PFE/BswModuleDescriptions/Eth/InternalBehavior_0/ETH_EXCLUSIVE_AREA_39</CAN-ENTER-EXCLUSIVE-AREA-REF>
                        <CAN-ENTER-EXCLUSIVE-AREA-REF DEST="EXCLUSIVE-AREA">/AUTOSAR_Eth_43_PFE/BswModuleDescriptions/Eth/InternalBehavior_0/ETH_EXCLUSIVE_AREA_40</CAN-ENTER-EXCLUSIVE-AREA-REF>
                        <CAN-ENTER-EXCLUSIVE-AREA-REF DEST="EXCLUSIVE-AREA">/AUTOSAR_Eth_43_PFE/BswModuleDescriptions/Eth/InternalBehavior_0/ETH_EXCLUSIVE_AREA_52</CAN-ENTER-EXCLUSIVE-AREA-REF>
                        <CAN-ENTER-EXCLUSIVE-AREA-REF DEST="EXCLUSIVE-AREA">/AUTOSAR_Eth_43_PFE/BswModuleDescriptions/Eth/InternalBehavior_0/ETH_EXCLUSIVE_AREA_54</CAN-ENTER-EXCLUSIVE-AREA-REF>
                        <CAN-ENTER-EXCLUSIVE-AREA-REF DEST="EXCLUSIVE-AREA">/AUTOSAR_Eth_43_PFE/BswModuleDescriptions/Eth/InternalBehavior_0/ETH_EXCLUSIVE_AREA_55</CAN-ENTER-EXCLUSIVE-AREA-REF>
                        <CAN-ENTER-EXCLUSIVE-AREA-REF DEST="EXCLUSIVE-AREA">/AUTOSAR_Eth_43_PFE/BswModuleDescriptions/Eth/InternalBehavior_0/ETH_EXCLUSIVE_AREA_56</CAN-ENTER-EXCLUSIVE-AREA-REF>
                        <CAN-ENTER-EXCLUSIVE-AREA-REF DEST="EXCLUSIVE-AREA">/AUTOSAR_Eth_43_PFE/BswModuleDescriptions/Eth/InternalBehavior_0/ETH_EXCLUSIVE_AREA_100</CAN-ENTER-EXCLUSIVE-AREA-REF>
                      </CAN-ENTER-EXCLUSIVE-AREA-REFS>
                      <MINIMUM-START-INTERVAL>0.0</MINIMUM-START-INTERVAL>
                      <IMPLEMENTED-ENTRY-REF DEST="BSW-MODULE-ENTRY">/AUTOSAR_Eth_43_PFE/BswModuleEntrys/Eth_TxConfirmation</IMPLEMENTED-ENTRY-REF>
                    </BSW-CALLED-ENTITY>
                    [!IF "EthGeneral/EthVersionInfoApi = 'true'"!][!//
                    <BSW-CALLED-ENTITY>
                      <SHORT-NAME>Eth_43_PFE_GetVersionInfo</SHORT-NAME>
                      <MINIMUM-START-INTERVAL>0.0</MINIMUM-START-INTERVAL>
                      <IMPLEMENTED-ENTRY-REF DEST="BSW-MODULE-ENTRY">/AUTOSAR_Eth_43_PFE/BswModuleEntrys/Eth_GetVersionInfo</IMPLEMENTED-ENTRY-REF>
                    </BSW-CALLED-ENTITY>
                    [!ENDIF!][!//
                    [!IF "$AllMiiDisabled = 'false'"!][!//
                    <BSW-CALLED-ENTITY>
                      <SHORT-NAME>Eth_43_PFE_WriteMii</SHORT-NAME>
                      <CAN-ENTER-EXCLUSIVE-AREA-REFS>
                        <CAN-ENTER-EXCLUSIVE-AREA-REF DEST="EXCLUSIVE-AREA">/AUTOSAR_Eth_43_PFE/BswModuleDescriptions/Eth/InternalBehavior_0/ETH_EXCLUSIVE_AREA_38</CAN-ENTER-EXCLUSIVE-AREA-REF>
                        <CAN-ENTER-EXCLUSIVE-AREA-REF DEST="EXCLUSIVE-AREA">/AUTOSAR_Eth_43_PFE/BswModuleDescriptions/Eth/InternalBehavior_0/ETH_EXCLUSIVE_AREA_39</CAN-ENTER-EXCLUSIVE-AREA-REF>
                        <CAN-ENTER-EXCLUSIVE-AREA-REF DEST="EXCLUSIVE-AREA">/AUTOSAR_Eth_43_PFE/BswModuleDescriptions/Eth/InternalBehavior_0/ETH_EXCLUSIVE_AREA_52</CAN-ENTER-EXCLUSIVE-AREA-REF>
                        <CAN-ENTER-EXCLUSIVE-AREA-REF DEST="EXCLUSIVE-AREA">/AUTOSAR_Eth_43_PFE/BswModuleDescriptions/Eth/InternalBehavior_0/ETH_EXCLUSIVE_AREA_54</CAN-ENTER-EXCLUSIVE-AREA-REF>
                        <CAN-ENTER-EXCLUSIVE-AREA-REF DEST="EXCLUSIVE-AREA">/AUTOSAR_Eth_43_PFE/BswModuleDescriptions/Eth/InternalBehavior_0/ETH_EXCLUSIVE_AREA_55</CAN-ENTER-EXCLUSIVE-AREA-REF>
                        <CAN-ENTER-EXCLUSIVE-AREA-REF DEST="EXCLUSIVE-AREA">/AUTOSAR_Eth_43_PFE/BswModuleDescriptions/Eth/InternalBehavior_0/ETH_EXCLUSIVE_AREA_56</CAN-ENTER-EXCLUSIVE-AREA-REF>
                        <CAN-ENTER-EXCLUSIVE-AREA-REF DEST="EXCLUSIVE-AREA">/AUTOSAR_Eth_43_PFE/BswModuleDescriptions/Eth/InternalBehavior_0/ETH_EXCLUSIVE_AREA_60</CAN-ENTER-EXCLUSIVE-AREA-REF>
                        <CAN-ENTER-EXCLUSIVE-AREA-REF DEST="EXCLUSIVE-AREA">/AUTOSAR_Eth_43_PFE/BswModuleDescriptions/Eth/InternalBehavior_0/ETH_EXCLUSIVE_AREA_100</CAN-ENTER-EXCLUSIVE-AREA-REF>
                      </CAN-ENTER-EXCLUSIVE-AREA-REFS>
                      <MINIMUM-START-INTERVAL>0.0</MINIMUM-START-INTERVAL>
                      <IMPLEMENTED-ENTRY-REF DEST="BSW-MODULE-ENTRY">/AUTOSAR_Eth_43_PFE/BswModuleEntrys/Eth_WriteMii</IMPLEMENTED-ENTRY-REF>
                    </BSW-CALLED-ENTITY>
                    <BSW-CALLED-ENTITY>
                      <SHORT-NAME>Eth_43_PFE_ReadMii</SHORT-NAME>
                      <CAN-ENTER-EXCLUSIVE-AREA-REFS>
                        <CAN-ENTER-EXCLUSIVE-AREA-REF DEST="EXCLUSIVE-AREA">/AUTOSAR_Eth_43_PFE/BswModuleDescriptions/Eth/InternalBehavior_0/ETH_EXCLUSIVE_AREA_38</CAN-ENTER-EXCLUSIVE-AREA-REF>
                        <CAN-ENTER-EXCLUSIVE-AREA-REF DEST="EXCLUSIVE-AREA">/AUTOSAR_Eth_43_PFE/BswModuleDescriptions/Eth/InternalBehavior_0/ETH_EXCLUSIVE_AREA_39</CAN-ENTER-EXCLUSIVE-AREA-REF>
                        <CAN-ENTER-EXCLUSIVE-AREA-REF DEST="EXCLUSIVE-AREA">/AUTOSAR_Eth_43_PFE/BswModuleDescriptions/Eth/InternalBehavior_0/ETH_EXCLUSIVE_AREA_52</CAN-ENTER-EXCLUSIVE-AREA-REF>
                        <CAN-ENTER-EXCLUSIVE-AREA-REF DEST="EXCLUSIVE-AREA">/AUTOSAR_Eth_43_PFE/BswModuleDescriptions/Eth/InternalBehavior_0/ETH_EXCLUSIVE_AREA_54</CAN-ENTER-EXCLUSIVE-AREA-REF>
                        <CAN-ENTER-EXCLUSIVE-AREA-REF DEST="EXCLUSIVE-AREA">/AUTOSAR_Eth_43_PFE/BswModuleDescriptions/Eth/InternalBehavior_0/ETH_EXCLUSIVE_AREA_55</CAN-ENTER-EXCLUSIVE-AREA-REF>
                        <CAN-ENTER-EXCLUSIVE-AREA-REF DEST="EXCLUSIVE-AREA">/AUTOSAR_Eth_43_PFE/BswModuleDescriptions/Eth/InternalBehavior_0/ETH_EXCLUSIVE_AREA_56</CAN-ENTER-EXCLUSIVE-AREA-REF>
                        <CAN-ENTER-EXCLUSIVE-AREA-REF DEST="EXCLUSIVE-AREA">/AUTOSAR_Eth_43_PFE/BswModuleDescriptions/Eth/InternalBehavior_0/ETH_EXCLUSIVE_AREA_60</CAN-ENTER-EXCLUSIVE-AREA-REF>
                        <CAN-ENTER-EXCLUSIVE-AREA-REF DEST="EXCLUSIVE-AREA">/AUTOSAR_Eth_43_PFE/BswModuleDescriptions/Eth/InternalBehavior_0/ETH_EXCLUSIVE_AREA_100</CAN-ENTER-EXCLUSIVE-AREA-REF>
                      </CAN-ENTER-EXCLUSIVE-AREA-REFS>
                      <MINIMUM-START-INTERVAL>0.0</MINIMUM-START-INTERVAL>
                      <IMPLEMENTED-ENTRY-REF DEST="BSW-MODULE-ENTRY">/AUTOSAR_Eth_43_PFE/BswModuleEntrys/Eth_ReadMii</IMPLEMENTED-ENTRY-REF>
                    </BSW-CALLED-ENTITY>
                      [!IF "EthGeneral/EthVendorSpecific/EthEnableClause45API = 'true'"!][!//
                    <BSW-CALLED-ENTITY>
                      <SHORT-NAME>Eth_43_PFE_WriteMii45</SHORT-NAME>
                      <CAN-ENTER-EXCLUSIVE-AREA-REFS>
                        <CAN-ENTER-EXCLUSIVE-AREA-REF DEST="EXCLUSIVE-AREA">/AUTOSAR_Eth_43_PFE/BswModuleDescriptions/Eth/InternalBehavior_0/ETH_EXCLUSIVE_AREA_38</CAN-ENTER-EXCLUSIVE-AREA-REF>
                        <CAN-ENTER-EXCLUSIVE-AREA-REF DEST="EXCLUSIVE-AREA">/AUTOSAR_Eth_43_PFE/BswModuleDescriptions/Eth/InternalBehavior_0/ETH_EXCLUSIVE_AREA_39</CAN-ENTER-EXCLUSIVE-AREA-REF>
                        <CAN-ENTER-EXCLUSIVE-AREA-REF DEST="EXCLUSIVE-AREA">/AUTOSAR_Eth_43_PFE/BswModuleDescriptions/Eth/InternalBehavior_0/ETH_EXCLUSIVE_AREA_52</CAN-ENTER-EXCLUSIVE-AREA-REF>
                        <CAN-ENTER-EXCLUSIVE-AREA-REF DEST="EXCLUSIVE-AREA">/AUTOSAR_Eth_43_PFE/BswModuleDescriptions/Eth/InternalBehavior_0/ETH_EXCLUSIVE_AREA_54</CAN-ENTER-EXCLUSIVE-AREA-REF>
                        <CAN-ENTER-EXCLUSIVE-AREA-REF DEST="EXCLUSIVE-AREA">/AUTOSAR_Eth_43_PFE/BswModuleDescriptions/Eth/InternalBehavior_0/ETH_EXCLUSIVE_AREA_55</CAN-ENTER-EXCLUSIVE-AREA-REF>
                        <CAN-ENTER-EXCLUSIVE-AREA-REF DEST="EXCLUSIVE-AREA">/AUTOSAR_Eth_43_PFE/BswModuleDescriptions/Eth/InternalBehavior_0/ETH_EXCLUSIVE_AREA_56</CAN-ENTER-EXCLUSIVE-AREA-REF>
                        <CAN-ENTER-EXCLUSIVE-AREA-REF DEST="EXCLUSIVE-AREA">/AUTOSAR_Eth_43_PFE/BswModuleDescriptions/Eth/InternalBehavior_0/ETH_EXCLUSIVE_AREA_60</CAN-ENTER-EXCLUSIVE-AREA-REF>
                        <CAN-ENTER-EXCLUSIVE-AREA-REF DEST="EXCLUSIVE-AREA">/AUTOSAR_Eth_43_PFE/BswModuleDescriptions/Eth/InternalBehavior_0/ETH_EXCLUSIVE_AREA_100</CAN-ENTER-EXCLUSIVE-AREA-REF>
                      </CAN-ENTER-EXCLUSIVE-AREA-REFS>
                      <MINIMUM-START-INTERVAL>0.0</MINIMUM-START-INTERVAL>
                      <IMPLEMENTED-ENTRY-REF DEST="BSW-MODULE-ENTRY">/AUTOSAR_Eth_43_PFE/BswModuleEntrys/Eth_WriteMii45</IMPLEMENTED-ENTRY-REF>
                    </BSW-CALLED-ENTITY>
                    <BSW-CALLED-ENTITY>
                      <SHORT-NAME>Eth_43_PFE_ReadMii45</SHORT-NAME>
                      <CAN-ENTER-EXCLUSIVE-AREA-REFS>
                        <CAN-ENTER-EXCLUSIVE-AREA-REF DEST="EXCLUSIVE-AREA">/AUTOSAR_Eth_43_PFE/BswModuleDescriptions/Eth/InternalBehavior_0/ETH_EXCLUSIVE_AREA_38</CAN-ENTER-EXCLUSIVE-AREA-REF>
                        <CAN-ENTER-EXCLUSIVE-AREA-REF DEST="EXCLUSIVE-AREA">/AUTOSAR_Eth_43_PFE/BswModuleDescriptions/Eth/InternalBehavior_0/ETH_EXCLUSIVE_AREA_39</CAN-ENTER-EXCLUSIVE-AREA-REF>
                        <CAN-ENTER-EXCLUSIVE-AREA-REF DEST="EXCLUSIVE-AREA">/AUTOSAR_Eth_43_PFE/BswModuleDescriptions/Eth/InternalBehavior_0/ETH_EXCLUSIVE_AREA_52</CAN-ENTER-EXCLUSIVE-AREA-REF>
                        <CAN-ENTER-EXCLUSIVE-AREA-REF DEST="EXCLUSIVE-AREA">/AUTOSAR_Eth_43_PFE/BswModuleDescriptions/Eth/InternalBehavior_0/ETH_EXCLUSIVE_AREA_54</CAN-ENTER-EXCLUSIVE-AREA-REF>
                        <CAN-ENTER-EXCLUSIVE-AREA-REF DEST="EXCLUSIVE-AREA">/AUTOSAR_Eth_43_PFE/BswModuleDescriptions/Eth/InternalBehavior_0/ETH_EXCLUSIVE_AREA_55</CAN-ENTER-EXCLUSIVE-AREA-REF>
                        <CAN-ENTER-EXCLUSIVE-AREA-REF DEST="EXCLUSIVE-AREA">/AUTOSAR_Eth_43_PFE/BswModuleDescriptions/Eth/InternalBehavior_0/ETH_EXCLUSIVE_AREA_56</CAN-ENTER-EXCLUSIVE-AREA-REF>
                        <CAN-ENTER-EXCLUSIVE-AREA-REF DEST="EXCLUSIVE-AREA">/AUTOSAR_Eth_43_PFE/BswModuleDescriptions/Eth/InternalBehavior_0/ETH_EXCLUSIVE_AREA_60</CAN-ENTER-EXCLUSIVE-AREA-REF>
                        <CAN-ENTER-EXCLUSIVE-AREA-REF DEST="EXCLUSIVE-AREA">/AUTOSAR_Eth_43_PFE/BswModuleDescriptions/Eth/InternalBehavior_0/ETH_EXCLUSIVE_AREA_100</CAN-ENTER-EXCLUSIVE-AREA-REF>
                      </CAN-ENTER-EXCLUSIVE-AREA-REFS>
                      <MINIMUM-START-INTERVAL>0.0</MINIMUM-START-INTERVAL>
                      <IMPLEMENTED-ENTRY-REF DEST="BSW-MODULE-ENTRY">/AUTOSAR_Eth_43_PFE/BswModuleEntrys/Eth_ReadMii45</IMPLEMENTED-ENTRY-REF>
                    </BSW-CALLED-ENTITY>
                      [!ENDIF!][!//
                    [!ENDIF!][!//
                    [!IF "EthGeneral/EthGetCounterValuesApi = 'true'"!][!//
                    <BSW-CALLED-ENTITY>
                      <SHORT-NAME>Eth_43_PFE_GetCounterValues</SHORT-NAME>
                      <CAN-ENTER-EXCLUSIVE-AREA-REFS>
                        <CAN-ENTER-EXCLUSIVE-AREA-REF DEST="EXCLUSIVE-AREA">/AUTOSAR_Eth_43_PFE/BswModuleDescriptions/Eth/InternalBehavior_0/ETH_EXCLUSIVE_AREA_38</CAN-ENTER-EXCLUSIVE-AREA-REF>
                        <CAN-ENTER-EXCLUSIVE-AREA-REF DEST="EXCLUSIVE-AREA">/AUTOSAR_Eth_43_PFE/BswModuleDescriptions/Eth/InternalBehavior_0/ETH_EXCLUSIVE_AREA_39</CAN-ENTER-EXCLUSIVE-AREA-REF>
                        <CAN-ENTER-EXCLUSIVE-AREA-REF DEST="EXCLUSIVE-AREA">/AUTOSAR_Eth_43_PFE/BswModuleDescriptions/Eth/InternalBehavior_0/ETH_EXCLUSIVE_AREA_52</CAN-ENTER-EXCLUSIVE-AREA-REF>
                        <CAN-ENTER-EXCLUSIVE-AREA-REF DEST="EXCLUSIVE-AREA">/AUTOSAR_Eth_43_PFE/BswModuleDescriptions/Eth/InternalBehavior_0/ETH_EXCLUSIVE_AREA_54</CAN-ENTER-EXCLUSIVE-AREA-REF>
                        <CAN-ENTER-EXCLUSIVE-AREA-REF DEST="EXCLUSIVE-AREA">/AUTOSAR_Eth_43_PFE/BswModuleDescriptions/Eth/InternalBehavior_0/ETH_EXCLUSIVE_AREA_55</CAN-ENTER-EXCLUSIVE-AREA-REF>
                        <CAN-ENTER-EXCLUSIVE-AREA-REF DEST="EXCLUSIVE-AREA">/AUTOSAR_Eth_43_PFE/BswModuleDescriptions/Eth/InternalBehavior_0/ETH_EXCLUSIVE_AREA_56</CAN-ENTER-EXCLUSIVE-AREA-REF>
                        <CAN-ENTER-EXCLUSIVE-AREA-REF DEST="EXCLUSIVE-AREA">/AUTOSAR_Eth_43_PFE/BswModuleDescriptions/Eth/InternalBehavior_0/ETH_EXCLUSIVE_AREA_100</CAN-ENTER-EXCLUSIVE-AREA-REF>
                      </CAN-ENTER-EXCLUSIVE-AREA-REFS>
                      <MINIMUM-START-INTERVAL>0.0</MINIMUM-START-INTERVAL>
                      <IMPLEMENTED-ENTRY-REF DEST="BSW-MODULE-ENTRY">/AUTOSAR_Eth_43_PFE/BswModuleEntrys/Eth_GetCounterValues</IMPLEMENTED-ENTRY-REF>
                    </BSW-CALLED-ENTITY>
                    [!ENDIF!][!//
                    [!IF "EthGeneral/EthGetClassStatisticApi = 'true'"!][!//
                    <BSW-CALLED-ENTITY>
                      <SHORT-NAME>Eth_43_PFE_GetClassStats</SHORT-NAME>
                      <CAN-ENTER-EXCLUSIVE-AREA-REFS>
                        <CAN-ENTER-EXCLUSIVE-AREA-REF DEST="EXCLUSIVE-AREA">/AUTOSAR_Eth_43_PFE/BswModuleDescriptions/Eth/InternalBehavior_0/ETH_EXCLUSIVE_AREA_28</CAN-ENTER-EXCLUSIVE-AREA-REF>
                      </CAN-ENTER-EXCLUSIVE-AREA-REFS>
                      <MINIMUM-START-INTERVAL>0.0</MINIMUM-START-INTERVAL>
                      <IMPLEMENTED-ENTRY-REF DEST="BSW-MODULE-ENTRY">/AUTOSAR_Eth_43_PFE/BswModuleEntrys/Eth_GetClassStats</IMPLEMENTED-ENTRY-REF>
                    </BSW-CALLED-ENTITY>
                    [!ENDIF!][!//
                    [!IF "EthGeneral/EthGetRxStatsApi = 'true'"!][!//
                    <BSW-CALLED-ENTITY>
                      <SHORT-NAME>Eth_43_PFE_GetRxStats</SHORT-NAME>
                      <CAN-ENTER-EXCLUSIVE-AREA-REFS>
                        <CAN-ENTER-EXCLUSIVE-AREA-REF DEST="EXCLUSIVE-AREA">/AUTOSAR_Eth_43_PFE/BswModuleDescriptions/Eth/InternalBehavior_0/ETH_EXCLUSIVE_AREA_38</CAN-ENTER-EXCLUSIVE-AREA-REF>
                        <CAN-ENTER-EXCLUSIVE-AREA-REF DEST="EXCLUSIVE-AREA">/AUTOSAR_Eth_43_PFE/BswModuleDescriptions/Eth/InternalBehavior_0/ETH_EXCLUSIVE_AREA_39</CAN-ENTER-EXCLUSIVE-AREA-REF>
                        <CAN-ENTER-EXCLUSIVE-AREA-REF DEST="EXCLUSIVE-AREA">/AUTOSAR_Eth_43_PFE/BswModuleDescriptions/Eth/InternalBehavior_0/ETH_EXCLUSIVE_AREA_52</CAN-ENTER-EXCLUSIVE-AREA-REF>
                        <CAN-ENTER-EXCLUSIVE-AREA-REF DEST="EXCLUSIVE-AREA">/AUTOSAR_Eth_43_PFE/BswModuleDescriptions/Eth/InternalBehavior_0/ETH_EXCLUSIVE_AREA_54</CAN-ENTER-EXCLUSIVE-AREA-REF>
                        <CAN-ENTER-EXCLUSIVE-AREA-REF DEST="EXCLUSIVE-AREA">/AUTOSAR_Eth_43_PFE/BswModuleDescriptions/Eth/InternalBehavior_0/ETH_EXCLUSIVE_AREA_55</CAN-ENTER-EXCLUSIVE-AREA-REF>
                        <CAN-ENTER-EXCLUSIVE-AREA-REF DEST="EXCLUSIVE-AREA">/AUTOSAR_Eth_43_PFE/BswModuleDescriptions/Eth/InternalBehavior_0/ETH_EXCLUSIVE_AREA_56</CAN-ENTER-EXCLUSIVE-AREA-REF>
                        <CAN-ENTER-EXCLUSIVE-AREA-REF DEST="EXCLUSIVE-AREA">/AUTOSAR_Eth_43_PFE/BswModuleDescriptions/Eth/InternalBehavior_0/ETH_EXCLUSIVE_AREA_100</CAN-ENTER-EXCLUSIVE-AREA-REF>
                      </CAN-ENTER-EXCLUSIVE-AREA-REFS>
                      <MINIMUM-START-INTERVAL>0.0</MINIMUM-START-INTERVAL>
                      <IMPLEMENTED-ENTRY-REF DEST="BSW-MODULE-ENTRY">/AUTOSAR_Eth_43_PFE/BswModuleEntrys/Eth_GetRxStats</IMPLEMENTED-ENTRY-REF>
                    </BSW-CALLED-ENTITY>
                    [!ENDIF!][!//
                    [!IF "EthGeneral/EthGetTxStatsApi = 'true'"!][!//
                    <BSW-CALLED-ENTITY>
                      <SHORT-NAME>Eth_43_PFE_GetTxStats</SHORT-NAME>
                      <CAN-ENTER-EXCLUSIVE-AREA-REFS>
                        <CAN-ENTER-EXCLUSIVE-AREA-REF DEST="EXCLUSIVE-AREA">/AUTOSAR_Eth_43_PFE/BswModuleDescriptions/Eth/InternalBehavior_0/ETH_EXCLUSIVE_AREA_38</CAN-ENTER-EXCLUSIVE-AREA-REF>
                        <CAN-ENTER-EXCLUSIVE-AREA-REF DEST="EXCLUSIVE-AREA">/AUTOSAR_Eth_43_PFE/BswModuleDescriptions/Eth/InternalBehavior_0/ETH_EXCLUSIVE_AREA_39</CAN-ENTER-EXCLUSIVE-AREA-REF>
                        <CAN-ENTER-EXCLUSIVE-AREA-REF DEST="EXCLUSIVE-AREA">/AUTOSAR_Eth_43_PFE/BswModuleDescriptions/Eth/InternalBehavior_0/ETH_EXCLUSIVE_AREA_52</CAN-ENTER-EXCLUSIVE-AREA-REF>
                        <CAN-ENTER-EXCLUSIVE-AREA-REF DEST="EXCLUSIVE-AREA">/AUTOSAR_Eth_43_PFE/BswModuleDescriptions/Eth/InternalBehavior_0/ETH_EXCLUSIVE_AREA_54</CAN-ENTER-EXCLUSIVE-AREA-REF>
                        <CAN-ENTER-EXCLUSIVE-AREA-REF DEST="EXCLUSIVE-AREA">/AUTOSAR_Eth_43_PFE/BswModuleDescriptions/Eth/InternalBehavior_0/ETH_EXCLUSIVE_AREA_55</CAN-ENTER-EXCLUSIVE-AREA-REF>
                        <CAN-ENTER-EXCLUSIVE-AREA-REF DEST="EXCLUSIVE-AREA">/AUTOSAR_Eth_43_PFE/BswModuleDescriptions/Eth/InternalBehavior_0/ETH_EXCLUSIVE_AREA_56</CAN-ENTER-EXCLUSIVE-AREA-REF>
                        <CAN-ENTER-EXCLUSIVE-AREA-REF DEST="EXCLUSIVE-AREA">/AUTOSAR_Eth_43_PFE/BswModuleDescriptions/Eth/InternalBehavior_0/ETH_EXCLUSIVE_AREA_100</CAN-ENTER-EXCLUSIVE-AREA-REF>
                      </CAN-ENTER-EXCLUSIVE-AREA-REFS>
                      <MINIMUM-START-INTERVAL>0.0</MINIMUM-START-INTERVAL>
                      <IMPLEMENTED-ENTRY-REF DEST="BSW-MODULE-ENTRY">/AUTOSAR_Eth_43_PFE/BswModuleEntrys/Eth_GetTxStats</IMPLEMENTED-ENTRY-REF>
                    </BSW-CALLED-ENTITY>
                    [!ENDIF!][!//
                    [!IF "EthGeneral/EthGetTxErrorCounterValuesApi = 'true'"!][!//
                    <BSW-CALLED-ENTITY>
                      <SHORT-NAME>Eth_43_PFE_GetTxErrorCounterValues</SHORT-NAME>
                      <CAN-ENTER-EXCLUSIVE-AREA-REFS>
                        <CAN-ENTER-EXCLUSIVE-AREA-REF DEST="EXCLUSIVE-AREA">/AUTOSAR_Eth_43_PFE/BswModuleDescriptions/Eth/InternalBehavior_0/ETH_EXCLUSIVE_AREA_38</CAN-ENTER-EXCLUSIVE-AREA-REF>
                        <CAN-ENTER-EXCLUSIVE-AREA-REF DEST="EXCLUSIVE-AREA">/AUTOSAR_Eth_43_PFE/BswModuleDescriptions/Eth/InternalBehavior_0/ETH_EXCLUSIVE_AREA_39</CAN-ENTER-EXCLUSIVE-AREA-REF>
                        <CAN-ENTER-EXCLUSIVE-AREA-REF DEST="EXCLUSIVE-AREA">/AUTOSAR_Eth_43_PFE/BswModuleDescriptions/Eth/InternalBehavior_0/ETH_EXCLUSIVE_AREA_52</CAN-ENTER-EXCLUSIVE-AREA-REF>
                        <CAN-ENTER-EXCLUSIVE-AREA-REF DEST="EXCLUSIVE-AREA">/AUTOSAR_Eth_43_PFE/BswModuleDescriptions/Eth/InternalBehavior_0/ETH_EXCLUSIVE_AREA_54</CAN-ENTER-EXCLUSIVE-AREA-REF>
                        <CAN-ENTER-EXCLUSIVE-AREA-REF DEST="EXCLUSIVE-AREA">/AUTOSAR_Eth_43_PFE/BswModuleDescriptions/Eth/InternalBehavior_0/ETH_EXCLUSIVE_AREA_55</CAN-ENTER-EXCLUSIVE-AREA-REF>
                        <CAN-ENTER-EXCLUSIVE-AREA-REF DEST="EXCLUSIVE-AREA">/AUTOSAR_Eth_43_PFE/BswModuleDescriptions/Eth/InternalBehavior_0/ETH_EXCLUSIVE_AREA_56</CAN-ENTER-EXCLUSIVE-AREA-REF>
                        <CAN-ENTER-EXCLUSIVE-AREA-REF DEST="EXCLUSIVE-AREA">/AUTOSAR_Eth_43_PFE/BswModuleDescriptions/Eth/InternalBehavior_0/ETH_EXCLUSIVE_AREA_100</CAN-ENTER-EXCLUSIVE-AREA-REF>
                      </CAN-ENTER-EXCLUSIVE-AREA-REFS>
                      <MINIMUM-START-INTERVAL>0.0</MINIMUM-START-INTERVAL>
                      <IMPLEMENTED-ENTRY-REF DEST="BSW-MODULE-ENTRY">/AUTOSAR_Eth_43_PFE/BswModuleEntrys/Eth_GetTxErrorCounterValues</IMPLEMENTED-ENTRY-REF>
                    </BSW-CALLED-ENTITY>
                    [!ENDIF!][!//
                    [!IF "EthGeneral/EthGlobalTimeSupport = 'true'"!][!//
                    <BSW-CALLED-ENTITY>
                      <SHORT-NAME>Eth_43_PFE_GetEgressTimeStamp</SHORT-NAME>
                      <MINIMUM-START-INTERVAL>0.0</MINIMUM-START-INTERVAL>
                      <IMPLEMENTED-ENTRY-REF DEST="BSW-MODULE-ENTRY">/AUTOSAR_Eth_43_PFE/BswModuleEntrys/Eth_GetEgressTimeStamp</IMPLEMENTED-ENTRY-REF>
                    </BSW-CALLED-ENTITY>
                    <BSW-CALLED-ENTITY>
                      <SHORT-NAME>Eth_43_PFE_GetIngressTimeStamp</SHORT-NAME>
                      <CAN-ENTER-EXCLUSIVE-AREA-REFS>
                        <CAN-ENTER-EXCLUSIVE-AREA-REF DEST="EXCLUSIVE-AREA">/AUTOSAR_Eth_43_PFE/BswModuleDescriptions/Eth/InternalBehavior_0/ETH_EXCLUSIVE_AREA_40</CAN-ENTER-EXCLUSIVE-AREA-REF>
                        <CAN-ENTER-EXCLUSIVE-AREA-REF DEST="EXCLUSIVE-AREA">/AUTOSAR_Eth_43_PFE/BswModuleDescriptions/Eth/InternalBehavior_0/ETH_EXCLUSIVE_AREA_100</CAN-ENTER-EXCLUSIVE-AREA-REF>
                      </CAN-ENTER-EXCLUSIVE-AREA-REFS>
                      <MINIMUM-START-INTERVAL>0.0</MINIMUM-START-INTERVAL>
                      <IMPLEMENTED-ENTRY-REF DEST="BSW-MODULE-ENTRY">/AUTOSAR_Eth_43_PFE/BswModuleEntrys/Eth_GetIngressTimeStamp</IMPLEMENTED-ENTRY-REF>
                    </BSW-CALLED-ENTITY>
                    <BSW-CALLED-ENTITY>
                      <SHORT-NAME>Eth_43_PFE_GetCurrentTime</SHORT-NAME>
                      <MINIMUM-START-INTERVAL>0.0</MINIMUM-START-INTERVAL>
                      <IMPLEMENTED-ENTRY-REF DEST="BSW-MODULE-ENTRY">/AUTOSAR_Eth_43_PFE/BswModuleEntrys/Eth_GetCurrentTime</IMPLEMENTED-ENTRY-REF>
                    </BSW-CALLED-ENTITY>
                      [!IF "EthGeneral/EthVendorSpecific/EthPfeMultiInstance = 'false' or EthGeneral/EthVendorSpecific/EthPfeSlaveMode = 'false'"!][!//
                    <BSW-CALLED-ENTITY>
                      <SHORT-NAME>Eth_43_PFE_SetGlobalTime</SHORT-NAME>
                      <CAN-ENTER-EXCLUSIVE-AREA-REFS>
                        <CAN-ENTER-EXCLUSIVE-AREA-REF DEST="EXCLUSIVE-AREA">/AUTOSAR_Eth_43_PFE/BswModuleDescriptions/Eth/InternalBehavior_0/ETH_EXCLUSIVE_AREA_64</CAN-ENTER-EXCLUSIVE-AREA-REF>
                      </CAN-ENTER-EXCLUSIVE-AREA-REFS>
                      <MINIMUM-START-INTERVAL>0.0</MINIMUM-START-INTERVAL>
                      <IMPLEMENTED-ENTRY-REF DEST="BSW-MODULE-ENTRY">/AUTOSAR_Eth_43_PFE/BswModuleEntrys/Eth_SetGlobalTime</IMPLEMENTED-ENTRY-REF>
                    </BSW-CALLED-ENTITY>
                    <BSW-CALLED-ENTITY>
                      <SHORT-NAME>Eth_43_PFE_SetCorrectionTime</SHORT-NAME>
                      <CAN-ENTER-EXCLUSIVE-AREA-REFS>
                        <CAN-ENTER-EXCLUSIVE-AREA-REF DEST="EXCLUSIVE-AREA">/AUTOSAR_Eth_43_PFE/BswModuleDescriptions/Eth/InternalBehavior_0/ETH_EXCLUSIVE_AREA_62</CAN-ENTER-EXCLUSIVE-AREA-REF>
                        <CAN-ENTER-EXCLUSIVE-AREA-REF DEST="EXCLUSIVE-AREA">/AUTOSAR_Eth_43_PFE/BswModuleDescriptions/Eth/InternalBehavior_0/ETH_EXCLUSIVE_AREA_63</CAN-ENTER-EXCLUSIVE-AREA-REF>
                        <CAN-ENTER-EXCLUSIVE-AREA-REF DEST="EXCLUSIVE-AREA">/AUTOSAR_Eth_43_PFE/BswModuleDescriptions/Eth/InternalBehavior_0/ETH_EXCLUSIVE_AREA_100</CAN-ENTER-EXCLUSIVE-AREA-REF>
                      </CAN-ENTER-EXCLUSIVE-AREA-REFS>
                      <MINIMUM-START-INTERVAL>0.0</MINIMUM-START-INTERVAL>
                      <IMPLEMENTED-ENTRY-REF DEST="BSW-MODULE-ENTRY">/AUTOSAR_Eth_43_PFE/BswModuleEntrys/Eth_SetCorrectionTime</IMPLEMENTED-ENTRY-REF>
                    </BSW-CALLED-ENTITY>
                      [!ENDIF!][!//
                    <BSW-CALLED-ENTITY>
                      <SHORT-NAME>Eth_43_PFE_EnableEgressTimeStamp</SHORT-NAME>
                      <MINIMUM-START-INTERVAL>0.0</MINIMUM-START-INTERVAL>
                      <IMPLEMENTED-ENTRY-REF DEST="BSW-MODULE-ENTRY">/AUTOSAR_Eth_43_PFE/BswModuleEntrys/Eth_EnableEgressTimeStamp</IMPLEMENTED-ENTRY-REF>
                    </BSW-CALLED-ENTITY>
                    [!ENDIF!][!//
                    [!IF "EthGeneral/EthVendorSpecific/PfeEnableFCI = 'true'"!][!//
                    <BSW-CALLED-ENTITY>
                      <SHORT-NAME>fci_open</SHORT-NAME>
                      <MINIMUM-START-INTERVAL>0.0</MINIMUM-START-INTERVAL>
                      <IMPLEMENTED-ENTRY-REF DEST="BSW-MODULE-ENTRY">/AUTOSAR_Eth_43_PFE/BswModuleEntrys/fci_open</IMPLEMENTED-ENTRY-REF>
                    </BSW-CALLED-ENTITY>
                    <BSW-CALLED-ENTITY>
                      <SHORT-NAME>fci_close</SHORT-NAME>
                      <MINIMUM-START-INTERVAL>0.0</MINIMUM-START-INTERVAL>
                      <IMPLEMENTED-ENTRY-REF DEST="BSW-MODULE-ENTRY">/AUTOSAR_Eth_43_PFE/BswModuleEntrys/fci_close</IMPLEMENTED-ENTRY-REF>
                    </BSW-CALLED-ENTITY>
                    <BSW-CALLED-ENTITY>
                      <SHORT-NAME>fci_catch</SHORT-NAME>
                      <MINIMUM-START-INTERVAL>0.0</MINIMUM-START-INTERVAL>
                      <IMPLEMENTED-ENTRY-REF DEST="BSW-MODULE-ENTRY">/AUTOSAR_Eth_43_PFE/BswModuleEntrys/fci_catch</IMPLEMENTED-ENTRY-REF>
                    </BSW-CALLED-ENTITY>
                    <BSW-CALLED-ENTITY>
                      <SHORT-NAME>fci_cmd</SHORT-NAME>
                      <CAN-ENTER-EXCLUSIVE-AREA-REFS>
                        <CAN-ENTER-EXCLUSIVE-AREA-REF DEST="EXCLUSIVE-AREA">/AUTOSAR_Eth_43_PFE/BswModuleDescriptions/Eth/InternalBehavior_0/ETH_EXCLUSIVE_AREA_01</CAN-ENTER-EXCLUSIVE-AREA-REF>
                        <CAN-ENTER-EXCLUSIVE-AREA-REF DEST="EXCLUSIVE-AREA">/AUTOSAR_Eth_43_PFE/BswModuleDescriptions/Eth/InternalBehavior_0/ETH_EXCLUSIVE_AREA_03</CAN-ENTER-EXCLUSIVE-AREA-REF>
                        <CAN-ENTER-EXCLUSIVE-AREA-REF DEST="EXCLUSIVE-AREA">/AUTOSAR_Eth_43_PFE/BswModuleDescriptions/Eth/InternalBehavior_0/ETH_EXCLUSIVE_AREA_04</CAN-ENTER-EXCLUSIVE-AREA-REF>
                        <CAN-ENTER-EXCLUSIVE-AREA-REF DEST="EXCLUSIVE-AREA">/AUTOSAR_Eth_43_PFE/BswModuleDescriptions/Eth/InternalBehavior_0/ETH_EXCLUSIVE_AREA_05</CAN-ENTER-EXCLUSIVE-AREA-REF>
                        <CAN-ENTER-EXCLUSIVE-AREA-REF DEST="EXCLUSIVE-AREA">/AUTOSAR_Eth_43_PFE/BswModuleDescriptions/Eth/InternalBehavior_0/ETH_EXCLUSIVE_AREA_07</CAN-ENTER-EXCLUSIVE-AREA-REF>
                        <CAN-ENTER-EXCLUSIVE-AREA-REF DEST="EXCLUSIVE-AREA">/AUTOSAR_Eth_43_PFE/BswModuleDescriptions/Eth/InternalBehavior_0/ETH_EXCLUSIVE_AREA_08</CAN-ENTER-EXCLUSIVE-AREA-REF>
                        <CAN-ENTER-EXCLUSIVE-AREA-REF DEST="EXCLUSIVE-AREA">/AUTOSAR_Eth_43_PFE/BswModuleDescriptions/Eth/InternalBehavior_0/ETH_EXCLUSIVE_AREA_09</CAN-ENTER-EXCLUSIVE-AREA-REF>
                        <CAN-ENTER-EXCLUSIVE-AREA-REF DEST="EXCLUSIVE-AREA">/AUTOSAR_Eth_43_PFE/BswModuleDescriptions/Eth/InternalBehavior_0/ETH_EXCLUSIVE_AREA_10</CAN-ENTER-EXCLUSIVE-AREA-REF>
                        <CAN-ENTER-EXCLUSIVE-AREA-REF DEST="EXCLUSIVE-AREA">/AUTOSAR_Eth_43_PFE/BswModuleDescriptions/Eth/InternalBehavior_0/ETH_EXCLUSIVE_AREA_11</CAN-ENTER-EXCLUSIVE-AREA-REF>
                        <CAN-ENTER-EXCLUSIVE-AREA-REF DEST="EXCLUSIVE-AREA">/AUTOSAR_Eth_43_PFE/BswModuleDescriptions/Eth/InternalBehavior_0/ETH_EXCLUSIVE_AREA_12</CAN-ENTER-EXCLUSIVE-AREA-REF>
                        <CAN-ENTER-EXCLUSIVE-AREA-REF DEST="EXCLUSIVE-AREA">/AUTOSAR_Eth_43_PFE/BswModuleDescriptions/Eth/InternalBehavior_0/ETH_EXCLUSIVE_AREA_13</CAN-ENTER-EXCLUSIVE-AREA-REF>
                        <CAN-ENTER-EXCLUSIVE-AREA-REF DEST="EXCLUSIVE-AREA">/AUTOSAR_Eth_43_PFE/BswModuleDescriptions/Eth/InternalBehavior_0/ETH_EXCLUSIVE_AREA_14</CAN-ENTER-EXCLUSIVE-AREA-REF>
                        <CAN-ENTER-EXCLUSIVE-AREA-REF DEST="EXCLUSIVE-AREA">/AUTOSAR_Eth_43_PFE/BswModuleDescriptions/Eth/InternalBehavior_0/ETH_EXCLUSIVE_AREA_15</CAN-ENTER-EXCLUSIVE-AREA-REF>
                        <CAN-ENTER-EXCLUSIVE-AREA-REF DEST="EXCLUSIVE-AREA">/AUTOSAR_Eth_43_PFE/BswModuleDescriptions/Eth/InternalBehavior_0/ETH_EXCLUSIVE_AREA_16</CAN-ENTER-EXCLUSIVE-AREA-REF>
                        <CAN-ENTER-EXCLUSIVE-AREA-REF DEST="EXCLUSIVE-AREA">/AUTOSAR_Eth_43_PFE/BswModuleDescriptions/Eth/InternalBehavior_0/ETH_EXCLUSIVE_AREA_22</CAN-ENTER-EXCLUSIVE-AREA-REF>
                        <CAN-ENTER-EXCLUSIVE-AREA-REF DEST="EXCLUSIVE-AREA">/AUTOSAR_Eth_43_PFE/BswModuleDescriptions/Eth/InternalBehavior_0/ETH_EXCLUSIVE_AREA_23</CAN-ENTER-EXCLUSIVE-AREA-REF>
                        <CAN-ENTER-EXCLUSIVE-AREA-REF DEST="EXCLUSIVE-AREA">/AUTOSAR_Eth_43_PFE/BswModuleDescriptions/Eth/InternalBehavior_0/ETH_EXCLUSIVE_AREA_26</CAN-ENTER-EXCLUSIVE-AREA-REF>
                        <CAN-ENTER-EXCLUSIVE-AREA-REF DEST="EXCLUSIVE-AREA">/AUTOSAR_Eth_43_PFE/BswModuleDescriptions/Eth/InternalBehavior_0/ETH_EXCLUSIVE_AREA_27</CAN-ENTER-EXCLUSIVE-AREA-REF>
                        <CAN-ENTER-EXCLUSIVE-AREA-REF DEST="EXCLUSIVE-AREA">/AUTOSAR_Eth_43_PFE/BswModuleDescriptions/Eth/InternalBehavior_0/ETH_EXCLUSIVE_AREA_28</CAN-ENTER-EXCLUSIVE-AREA-REF>
                        <CAN-ENTER-EXCLUSIVE-AREA-REF DEST="EXCLUSIVE-AREA">/AUTOSAR_Eth_43_PFE/BswModuleDescriptions/Eth/InternalBehavior_0/ETH_EXCLUSIVE_AREA_30</CAN-ENTER-EXCLUSIVE-AREA-REF>
                        <CAN-ENTER-EXCLUSIVE-AREA-REF DEST="EXCLUSIVE-AREA">/AUTOSAR_Eth_43_PFE/BswModuleDescriptions/Eth/InternalBehavior_0/ETH_EXCLUSIVE_AREA_31</CAN-ENTER-EXCLUSIVE-AREA-REF>
                        <CAN-ENTER-EXCLUSIVE-AREA-REF DEST="EXCLUSIVE-AREA">/AUTOSAR_Eth_43_PFE/BswModuleDescriptions/Eth/InternalBehavior_0/ETH_EXCLUSIVE_AREA_34</CAN-ENTER-EXCLUSIVE-AREA-REF>
                        <CAN-ENTER-EXCLUSIVE-AREA-REF DEST="EXCLUSIVE-AREA">/AUTOSAR_Eth_43_PFE/BswModuleDescriptions/Eth/InternalBehavior_0/ETH_EXCLUSIVE_AREA_38</CAN-ENTER-EXCLUSIVE-AREA-REF>
                        <CAN-ENTER-EXCLUSIVE-AREA-REF DEST="EXCLUSIVE-AREA">/AUTOSAR_Eth_43_PFE/BswModuleDescriptions/Eth/InternalBehavior_0/ETH_EXCLUSIVE_AREA_39</CAN-ENTER-EXCLUSIVE-AREA-REF>
                        <CAN-ENTER-EXCLUSIVE-AREA-REF DEST="EXCLUSIVE-AREA">/AUTOSAR_Eth_43_PFE/BswModuleDescriptions/Eth/InternalBehavior_0/ETH_EXCLUSIVE_AREA_41</CAN-ENTER-EXCLUSIVE-AREA-REF>
                        <CAN-ENTER-EXCLUSIVE-AREA-REF DEST="EXCLUSIVE-AREA">/AUTOSAR_Eth_43_PFE/BswModuleDescriptions/Eth/InternalBehavior_0/ETH_EXCLUSIVE_AREA_45</CAN-ENTER-EXCLUSIVE-AREA-REF>
                        <CAN-ENTER-EXCLUSIVE-AREA-REF DEST="EXCLUSIVE-AREA">/AUTOSAR_Eth_43_PFE/BswModuleDescriptions/Eth/InternalBehavior_0/ETH_EXCLUSIVE_AREA_46</CAN-ENTER-EXCLUSIVE-AREA-REF>
                        <CAN-ENTER-EXCLUSIVE-AREA-REF DEST="EXCLUSIVE-AREA">/AUTOSAR_Eth_43_PFE/BswModuleDescriptions/Eth/InternalBehavior_0/ETH_EXCLUSIVE_AREA_47</CAN-ENTER-EXCLUSIVE-AREA-REF>
                        <CAN-ENTER-EXCLUSIVE-AREA-REF DEST="EXCLUSIVE-AREA">/AUTOSAR_Eth_43_PFE/BswModuleDescriptions/Eth/InternalBehavior_0/ETH_EXCLUSIVE_AREA_48</CAN-ENTER-EXCLUSIVE-AREA-REF>
                        <CAN-ENTER-EXCLUSIVE-AREA-REF DEST="EXCLUSIVE-AREA">/AUTOSAR_Eth_43_PFE/BswModuleDescriptions/Eth/InternalBehavior_0/ETH_EXCLUSIVE_AREA_52</CAN-ENTER-EXCLUSIVE-AREA-REF>
                        <CAN-ENTER-EXCLUSIVE-AREA-REF DEST="EXCLUSIVE-AREA">/AUTOSAR_Eth_43_PFE/BswModuleDescriptions/Eth/InternalBehavior_0/ETH_EXCLUSIVE_AREA_54</CAN-ENTER-EXCLUSIVE-AREA-REF>
                        <CAN-ENTER-EXCLUSIVE-AREA-REF DEST="EXCLUSIVE-AREA">/AUTOSAR_Eth_43_PFE/BswModuleDescriptions/Eth/InternalBehavior_0/ETH_EXCLUSIVE_AREA_55</CAN-ENTER-EXCLUSIVE-AREA-REF>
                        <CAN-ENTER-EXCLUSIVE-AREA-REF DEST="EXCLUSIVE-AREA">/AUTOSAR_Eth_43_PFE/BswModuleDescriptions/Eth/InternalBehavior_0/ETH_EXCLUSIVE_AREA_56</CAN-ENTER-EXCLUSIVE-AREA-REF>
                        <CAN-ENTER-EXCLUSIVE-AREA-REF DEST="EXCLUSIVE-AREA">/AUTOSAR_Eth_43_PFE/BswModuleDescriptions/Eth/InternalBehavior_0/ETH_EXCLUSIVE_AREA_58</CAN-ENTER-EXCLUSIVE-AREA-REF>
                        <CAN-ENTER-EXCLUSIVE-AREA-REF DEST="EXCLUSIVE-AREA">/AUTOSAR_Eth_43_PFE/BswModuleDescriptions/Eth/InternalBehavior_0/ETH_EXCLUSIVE_AREA_59</CAN-ENTER-EXCLUSIVE-AREA-REF>
                        <CAN-ENTER-EXCLUSIVE-AREA-REF DEST="EXCLUSIVE-AREA">/AUTOSAR_Eth_43_PFE/BswModuleDescriptions/Eth/InternalBehavior_0/ETH_EXCLUSIVE_AREA_65</CAN-ENTER-EXCLUSIVE-AREA-REF>
                        <CAN-ENTER-EXCLUSIVE-AREA-REF DEST="EXCLUSIVE-AREA">/AUTOSAR_Eth_43_PFE/BswModuleDescriptions/Eth/InternalBehavior_0/ETH_EXCLUSIVE_AREA_66</CAN-ENTER-EXCLUSIVE-AREA-REF>
                        <CAN-ENTER-EXCLUSIVE-AREA-REF DEST="EXCLUSIVE-AREA">/AUTOSAR_Eth_43_PFE/BswModuleDescriptions/Eth/InternalBehavior_0/ETH_EXCLUSIVE_AREA_67</CAN-ENTER-EXCLUSIVE-AREA-REF>
                        <CAN-ENTER-EXCLUSIVE-AREA-REF DEST="EXCLUSIVE-AREA">/AUTOSAR_Eth_43_PFE/BswModuleDescriptions/Eth/InternalBehavior_0/ETH_EXCLUSIVE_AREA_68</CAN-ENTER-EXCLUSIVE-AREA-REF>
                        <CAN-ENTER-EXCLUSIVE-AREA-REF DEST="EXCLUSIVE-AREA">/AUTOSAR_Eth_43_PFE/BswModuleDescriptions/Eth/InternalBehavior_0/ETH_EXCLUSIVE_AREA_69</CAN-ENTER-EXCLUSIVE-AREA-REF>
                        <CAN-ENTER-EXCLUSIVE-AREA-REF DEST="EXCLUSIVE-AREA">/AUTOSAR_Eth_43_PFE/BswModuleDescriptions/Eth/InternalBehavior_0/ETH_EXCLUSIVE_AREA_70</CAN-ENTER-EXCLUSIVE-AREA-REF>
                        <CAN-ENTER-EXCLUSIVE-AREA-REF DEST="EXCLUSIVE-AREA">/AUTOSAR_Eth_43_PFE/BswModuleDescriptions/Eth/InternalBehavior_0/ETH_EXCLUSIVE_AREA_71</CAN-ENTER-EXCLUSIVE-AREA-REF>
                        <CAN-ENTER-EXCLUSIVE-AREA-REF DEST="EXCLUSIVE-AREA">/AUTOSAR_Eth_43_PFE/BswModuleDescriptions/Eth/InternalBehavior_0/ETH_EXCLUSIVE_AREA_72</CAN-ENTER-EXCLUSIVE-AREA-REF>
                        <CAN-ENTER-EXCLUSIVE-AREA-REF DEST="EXCLUSIVE-AREA">/AUTOSAR_Eth_43_PFE/BswModuleDescriptions/Eth/InternalBehavior_0/ETH_EXCLUSIVE_AREA_73</CAN-ENTER-EXCLUSIVE-AREA-REF>
                        <CAN-ENTER-EXCLUSIVE-AREA-REF DEST="EXCLUSIVE-AREA">/AUTOSAR_Eth_43_PFE/BswModuleDescriptions/Eth/InternalBehavior_0/ETH_EXCLUSIVE_AREA_74</CAN-ENTER-EXCLUSIVE-AREA-REF>
                        <CAN-ENTER-EXCLUSIVE-AREA-REF DEST="EXCLUSIVE-AREA">/AUTOSAR_Eth_43_PFE/BswModuleDescriptions/Eth/InternalBehavior_0/ETH_EXCLUSIVE_AREA_75</CAN-ENTER-EXCLUSIVE-AREA-REF>
                        <CAN-ENTER-EXCLUSIVE-AREA-REF DEST="EXCLUSIVE-AREA">/AUTOSAR_Eth_43_PFE/BswModuleDescriptions/Eth/InternalBehavior_0/ETH_EXCLUSIVE_AREA_76</CAN-ENTER-EXCLUSIVE-AREA-REF>
                        <CAN-ENTER-EXCLUSIVE-AREA-REF DEST="EXCLUSIVE-AREA">/AUTOSAR_Eth_43_PFE/BswModuleDescriptions/Eth/InternalBehavior_0/ETH_EXCLUSIVE_AREA_77</CAN-ENTER-EXCLUSIVE-AREA-REF>
                        <CAN-ENTER-EXCLUSIVE-AREA-REF DEST="EXCLUSIVE-AREA">/AUTOSAR_Eth_43_PFE/BswModuleDescriptions/Eth/InternalBehavior_0/ETH_EXCLUSIVE_AREA_78</CAN-ENTER-EXCLUSIVE-AREA-REF>
                        <CAN-ENTER-EXCLUSIVE-AREA-REF DEST="EXCLUSIVE-AREA">/AUTOSAR_Eth_43_PFE/BswModuleDescriptions/Eth/InternalBehavior_0/ETH_EXCLUSIVE_AREA_79</CAN-ENTER-EXCLUSIVE-AREA-REF>
                        <CAN-ENTER-EXCLUSIVE-AREA-REF DEST="EXCLUSIVE-AREA">/AUTOSAR_Eth_43_PFE/BswModuleDescriptions/Eth/InternalBehavior_0/ETH_EXCLUSIVE_AREA_81</CAN-ENTER-EXCLUSIVE-AREA-REF>
                        <CAN-ENTER-EXCLUSIVE-AREA-REF DEST="EXCLUSIVE-AREA">/AUTOSAR_Eth_43_PFE/BswModuleDescriptions/Eth/InternalBehavior_0/ETH_EXCLUSIVE_AREA_82</CAN-ENTER-EXCLUSIVE-AREA-REF>
                        <CAN-ENTER-EXCLUSIVE-AREA-REF DEST="EXCLUSIVE-AREA">/AUTOSAR_Eth_43_PFE/BswModuleDescriptions/Eth/InternalBehavior_0/ETH_EXCLUSIVE_AREA_85</CAN-ENTER-EXCLUSIVE-AREA-REF>
                        <CAN-ENTER-EXCLUSIVE-AREA-REF DEST="EXCLUSIVE-AREA">/AUTOSAR_Eth_43_PFE/BswModuleDescriptions/Eth/InternalBehavior_0/ETH_EXCLUSIVE_AREA_86</CAN-ENTER-EXCLUSIVE-AREA-REF>
                        <CAN-ENTER-EXCLUSIVE-AREA-REF DEST="EXCLUSIVE-AREA">/AUTOSAR_Eth_43_PFE/BswModuleDescriptions/Eth/InternalBehavior_0/ETH_EXCLUSIVE_AREA_87</CAN-ENTER-EXCLUSIVE-AREA-REF>
                        <CAN-ENTER-EXCLUSIVE-AREA-REF DEST="EXCLUSIVE-AREA">/AUTOSAR_Eth_43_PFE/BswModuleDescriptions/Eth/InternalBehavior_0/ETH_EXCLUSIVE_AREA_88</CAN-ENTER-EXCLUSIVE-AREA-REF>
                        <CAN-ENTER-EXCLUSIVE-AREA-REF DEST="EXCLUSIVE-AREA">/AUTOSAR_Eth_43_PFE/BswModuleDescriptions/Eth/InternalBehavior_0/ETH_EXCLUSIVE_AREA_89</CAN-ENTER-EXCLUSIVE-AREA-REF>
                        <CAN-ENTER-EXCLUSIVE-AREA-REF DEST="EXCLUSIVE-AREA">/AUTOSAR_Eth_43_PFE/BswModuleDescriptions/Eth/InternalBehavior_0/ETH_EXCLUSIVE_AREA_90</CAN-ENTER-EXCLUSIVE-AREA-REF>
                        <CAN-ENTER-EXCLUSIVE-AREA-REF DEST="EXCLUSIVE-AREA">/AUTOSAR_Eth_43_PFE/BswModuleDescriptions/Eth/InternalBehavior_0/ETH_EXCLUSIVE_AREA_95</CAN-ENTER-EXCLUSIVE-AREA-REF>
                        <CAN-ENTER-EXCLUSIVE-AREA-REF DEST="EXCLUSIVE-AREA">/AUTOSAR_Eth_43_PFE/BswModuleDescriptions/Eth/InternalBehavior_0/ETH_EXCLUSIVE_AREA_96</CAN-ENTER-EXCLUSIVE-AREA-REF>
                        <CAN-ENTER-EXCLUSIVE-AREA-REF DEST="EXCLUSIVE-AREA">/AUTOSAR_Eth_43_PFE/BswModuleDescriptions/Eth/InternalBehavior_0/ETH_EXCLUSIVE_AREA_97</CAN-ENTER-EXCLUSIVE-AREA-REF>
                        <CAN-ENTER-EXCLUSIVE-AREA-REF DEST="EXCLUSIVE-AREA">/AUTOSAR_Eth_43_PFE/BswModuleDescriptions/Eth/InternalBehavior_0/ETH_EXCLUSIVE_AREA_99</CAN-ENTER-EXCLUSIVE-AREA-REF>
                        <CAN-ENTER-EXCLUSIVE-AREA-REF DEST="EXCLUSIVE-AREA">/AUTOSAR_Eth_43_PFE/BswModuleDescriptions/Eth/InternalBehavior_0/ETH_EXCLUSIVE_AREA_100</CAN-ENTER-EXCLUSIVE-AREA-REF>
                        <CAN-ENTER-EXCLUSIVE-AREA-REF DEST="EXCLUSIVE-AREA">/AUTOSAR_Eth_43_PFE/BswModuleDescriptions/Eth/InternalBehavior_0/ETH_EXCLUSIVE_AREA_101</CAN-ENTER-EXCLUSIVE-AREA-REF>
                        <CAN-ENTER-EXCLUSIVE-AREA-REF DEST="EXCLUSIVE-AREA">/AUTOSAR_Eth_43_PFE/BswModuleDescriptions/Eth/InternalBehavior_0/ETH_EXCLUSIVE_AREA_102</CAN-ENTER-EXCLUSIVE-AREA-REF>
                        <CAN-ENTER-EXCLUSIVE-AREA-REF DEST="EXCLUSIVE-AREA">/AUTOSAR_Eth_43_PFE/BswModuleDescriptions/Eth/InternalBehavior_0/ETH_EXCLUSIVE_AREA_103</CAN-ENTER-EXCLUSIVE-AREA-REF>
                        <CAN-ENTER-EXCLUSIVE-AREA-REF DEST="EXCLUSIVE-AREA">/AUTOSAR_Eth_43_PFE/BswModuleDescriptions/Eth/InternalBehavior_0/ETH_EXCLUSIVE_AREA_104</CAN-ENTER-EXCLUSIVE-AREA-REF>
                      </CAN-ENTER-EXCLUSIVE-AREA-REFS>
                      <MINIMUM-START-INTERVAL>0.0</MINIMUM-START-INTERVAL>
                      <IMPLEMENTED-ENTRY-REF DEST="BSW-MODULE-ENTRY">/AUTOSAR_Eth_43_PFE/BswModuleEntrys/fci_cmd</IMPLEMENTED-ENTRY-REF>
                    </BSW-CALLED-ENTITY>
                    <BSW-CALLED-ENTITY>
                      <SHORT-NAME>fci_query</SHORT-NAME>
                      <CAN-ENTER-EXCLUSIVE-AREA-REFS>
                        <CAN-ENTER-EXCLUSIVE-AREA-REF DEST="EXCLUSIVE-AREA">/AUTOSAR_Eth_43_PFE/BswModuleDescriptions/Eth/InternalBehavior_0/ETH_EXCLUSIVE_AREA_01</CAN-ENTER-EXCLUSIVE-AREA-REF>
                        <CAN-ENTER-EXCLUSIVE-AREA-REF DEST="EXCLUSIVE-AREA">/AUTOSAR_Eth_43_PFE/BswModuleDescriptions/Eth/InternalBehavior_0/ETH_EXCLUSIVE_AREA_03</CAN-ENTER-EXCLUSIVE-AREA-REF>
                        <CAN-ENTER-EXCLUSIVE-AREA-REF DEST="EXCLUSIVE-AREA">/AUTOSAR_Eth_43_PFE/BswModuleDescriptions/Eth/InternalBehavior_0/ETH_EXCLUSIVE_AREA_04</CAN-ENTER-EXCLUSIVE-AREA-REF>
                        <CAN-ENTER-EXCLUSIVE-AREA-REF DEST="EXCLUSIVE-AREA">/AUTOSAR_Eth_43_PFE/BswModuleDescriptions/Eth/InternalBehavior_0/ETH_EXCLUSIVE_AREA_05</CAN-ENTER-EXCLUSIVE-AREA-REF>
                        <CAN-ENTER-EXCLUSIVE-AREA-REF DEST="EXCLUSIVE-AREA">/AUTOSAR_Eth_43_PFE/BswModuleDescriptions/Eth/InternalBehavior_0/ETH_EXCLUSIVE_AREA_07</CAN-ENTER-EXCLUSIVE-AREA-REF>
                        <CAN-ENTER-EXCLUSIVE-AREA-REF DEST="EXCLUSIVE-AREA">/AUTOSAR_Eth_43_PFE/BswModuleDescriptions/Eth/InternalBehavior_0/ETH_EXCLUSIVE_AREA_08</CAN-ENTER-EXCLUSIVE-AREA-REF>
                        <CAN-ENTER-EXCLUSIVE-AREA-REF DEST="EXCLUSIVE-AREA">/AUTOSAR_Eth_43_PFE/BswModuleDescriptions/Eth/InternalBehavior_0/ETH_EXCLUSIVE_AREA_09</CAN-ENTER-EXCLUSIVE-AREA-REF>
                        <CAN-ENTER-EXCLUSIVE-AREA-REF DEST="EXCLUSIVE-AREA">/AUTOSAR_Eth_43_PFE/BswModuleDescriptions/Eth/InternalBehavior_0/ETH_EXCLUSIVE_AREA_10</CAN-ENTER-EXCLUSIVE-AREA-REF>
                        <CAN-ENTER-EXCLUSIVE-AREA-REF DEST="EXCLUSIVE-AREA">/AUTOSAR_Eth_43_PFE/BswModuleDescriptions/Eth/InternalBehavior_0/ETH_EXCLUSIVE_AREA_11</CAN-ENTER-EXCLUSIVE-AREA-REF>
                        <CAN-ENTER-EXCLUSIVE-AREA-REF DEST="EXCLUSIVE-AREA">/AUTOSAR_Eth_43_PFE/BswModuleDescriptions/Eth/InternalBehavior_0/ETH_EXCLUSIVE_AREA_12</CAN-ENTER-EXCLUSIVE-AREA-REF>
                        <CAN-ENTER-EXCLUSIVE-AREA-REF DEST="EXCLUSIVE-AREA">/AUTOSAR_Eth_43_PFE/BswModuleDescriptions/Eth/InternalBehavior_0/ETH_EXCLUSIVE_AREA_13</CAN-ENTER-EXCLUSIVE-AREA-REF>
                        <CAN-ENTER-EXCLUSIVE-AREA-REF DEST="EXCLUSIVE-AREA">/AUTOSAR_Eth_43_PFE/BswModuleDescriptions/Eth/InternalBehavior_0/ETH_EXCLUSIVE_AREA_14</CAN-ENTER-EXCLUSIVE-AREA-REF>
                        <CAN-ENTER-EXCLUSIVE-AREA-REF DEST="EXCLUSIVE-AREA">/AUTOSAR_Eth_43_PFE/BswModuleDescriptions/Eth/InternalBehavior_0/ETH_EXCLUSIVE_AREA_15</CAN-ENTER-EXCLUSIVE-AREA-REF>
                        <CAN-ENTER-EXCLUSIVE-AREA-REF DEST="EXCLUSIVE-AREA">/AUTOSAR_Eth_43_PFE/BswModuleDescriptions/Eth/InternalBehavior_0/ETH_EXCLUSIVE_AREA_16</CAN-ENTER-EXCLUSIVE-AREA-REF>
                        <CAN-ENTER-EXCLUSIVE-AREA-REF DEST="EXCLUSIVE-AREA">/AUTOSAR_Eth_43_PFE/BswModuleDescriptions/Eth/InternalBehavior_0/ETH_EXCLUSIVE_AREA_22</CAN-ENTER-EXCLUSIVE-AREA-REF>
                        <CAN-ENTER-EXCLUSIVE-AREA-REF DEST="EXCLUSIVE-AREA">/AUTOSAR_Eth_43_PFE/BswModuleDescriptions/Eth/InternalBehavior_0/ETH_EXCLUSIVE_AREA_23</CAN-ENTER-EXCLUSIVE-AREA-REF>
                        <CAN-ENTER-EXCLUSIVE-AREA-REF DEST="EXCLUSIVE-AREA">/AUTOSAR_Eth_43_PFE/BswModuleDescriptions/Eth/InternalBehavior_0/ETH_EXCLUSIVE_AREA_26</CAN-ENTER-EXCLUSIVE-AREA-REF>
                        <CAN-ENTER-EXCLUSIVE-AREA-REF DEST="EXCLUSIVE-AREA">/AUTOSAR_Eth_43_PFE/BswModuleDescriptions/Eth/InternalBehavior_0/ETH_EXCLUSIVE_AREA_27</CAN-ENTER-EXCLUSIVE-AREA-REF>
                        <CAN-ENTER-EXCLUSIVE-AREA-REF DEST="EXCLUSIVE-AREA">/AUTOSAR_Eth_43_PFE/BswModuleDescriptions/Eth/InternalBehavior_0/ETH_EXCLUSIVE_AREA_28</CAN-ENTER-EXCLUSIVE-AREA-REF>
                        <CAN-ENTER-EXCLUSIVE-AREA-REF DEST="EXCLUSIVE-AREA">/AUTOSAR_Eth_43_PFE/BswModuleDescriptions/Eth/InternalBehavior_0/ETH_EXCLUSIVE_AREA_30</CAN-ENTER-EXCLUSIVE-AREA-REF>
                        <CAN-ENTER-EXCLUSIVE-AREA-REF DEST="EXCLUSIVE-AREA">/AUTOSAR_Eth_43_PFE/BswModuleDescriptions/Eth/InternalBehavior_0/ETH_EXCLUSIVE_AREA_31</CAN-ENTER-EXCLUSIVE-AREA-REF>
                        <CAN-ENTER-EXCLUSIVE-AREA-REF DEST="EXCLUSIVE-AREA">/AUTOSAR_Eth_43_PFE/BswModuleDescriptions/Eth/InternalBehavior_0/ETH_EXCLUSIVE_AREA_34</CAN-ENTER-EXCLUSIVE-AREA-REF>
                        <CAN-ENTER-EXCLUSIVE-AREA-REF DEST="EXCLUSIVE-AREA">/AUTOSAR_Eth_43_PFE/BswModuleDescriptions/Eth/InternalBehavior_0/ETH_EXCLUSIVE_AREA_38</CAN-ENTER-EXCLUSIVE-AREA-REF>
                        <CAN-ENTER-EXCLUSIVE-AREA-REF DEST="EXCLUSIVE-AREA">/AUTOSAR_Eth_43_PFE/BswModuleDescriptions/Eth/InternalBehavior_0/ETH_EXCLUSIVE_AREA_39</CAN-ENTER-EXCLUSIVE-AREA-REF>
                        <CAN-ENTER-EXCLUSIVE-AREA-REF DEST="EXCLUSIVE-AREA">/AUTOSAR_Eth_43_PFE/BswModuleDescriptions/Eth/InternalBehavior_0/ETH_EXCLUSIVE_AREA_41</CAN-ENTER-EXCLUSIVE-AREA-REF>
                        <CAN-ENTER-EXCLUSIVE-AREA-REF DEST="EXCLUSIVE-AREA">/AUTOSAR_Eth_43_PFE/BswModuleDescriptions/Eth/InternalBehavior_0/ETH_EXCLUSIVE_AREA_45</CAN-ENTER-EXCLUSIVE-AREA-REF>
                        <CAN-ENTER-EXCLUSIVE-AREA-REF DEST="EXCLUSIVE-AREA">/AUTOSAR_Eth_43_PFE/BswModuleDescriptions/Eth/InternalBehavior_0/ETH_EXCLUSIVE_AREA_46</CAN-ENTER-EXCLUSIVE-AREA-REF>
                        <CAN-ENTER-EXCLUSIVE-AREA-REF DEST="EXCLUSIVE-AREA">/AUTOSAR_Eth_43_PFE/BswModuleDescriptions/Eth/InternalBehavior_0/ETH_EXCLUSIVE_AREA_47</CAN-ENTER-EXCLUSIVE-AREA-REF>
                        <CAN-ENTER-EXCLUSIVE-AREA-REF DEST="EXCLUSIVE-AREA">/AUTOSAR_Eth_43_PFE/BswModuleDescriptions/Eth/InternalBehavior_0/ETH_EXCLUSIVE_AREA_48</CAN-ENTER-EXCLUSIVE-AREA-REF>
                        <CAN-ENTER-EXCLUSIVE-AREA-REF DEST="EXCLUSIVE-AREA">/AUTOSAR_Eth_43_PFE/BswModuleDescriptions/Eth/InternalBehavior_0/ETH_EXCLUSIVE_AREA_52</CAN-ENTER-EXCLUSIVE-AREA-REF>
                        <CAN-ENTER-EXCLUSIVE-AREA-REF DEST="EXCLUSIVE-AREA">/AUTOSAR_Eth_43_PFE/BswModuleDescriptions/Eth/InternalBehavior_0/ETH_EXCLUSIVE_AREA_54</CAN-ENTER-EXCLUSIVE-AREA-REF>
                        <CAN-ENTER-EXCLUSIVE-AREA-REF DEST="EXCLUSIVE-AREA">/AUTOSAR_Eth_43_PFE/BswModuleDescriptions/Eth/InternalBehavior_0/ETH_EXCLUSIVE_AREA_55</CAN-ENTER-EXCLUSIVE-AREA-REF>
                        <CAN-ENTER-EXCLUSIVE-AREA-REF DEST="EXCLUSIVE-AREA">/AUTOSAR_Eth_43_PFE/BswModuleDescriptions/Eth/InternalBehavior_0/ETH_EXCLUSIVE_AREA_56</CAN-ENTER-EXCLUSIVE-AREA-REF>
                        <CAN-ENTER-EXCLUSIVE-AREA-REF DEST="EXCLUSIVE-AREA">/AUTOSAR_Eth_43_PFE/BswModuleDescriptions/Eth/InternalBehavior_0/ETH_EXCLUSIVE_AREA_58</CAN-ENTER-EXCLUSIVE-AREA-REF>
                        <CAN-ENTER-EXCLUSIVE-AREA-REF DEST="EXCLUSIVE-AREA">/AUTOSAR_Eth_43_PFE/BswModuleDescriptions/Eth/InternalBehavior_0/ETH_EXCLUSIVE_AREA_59</CAN-ENTER-EXCLUSIVE-AREA-REF>
                        <CAN-ENTER-EXCLUSIVE-AREA-REF DEST="EXCLUSIVE-AREA">/AUTOSAR_Eth_43_PFE/BswModuleDescriptions/Eth/InternalBehavior_0/ETH_EXCLUSIVE_AREA_65</CAN-ENTER-EXCLUSIVE-AREA-REF>
                        <CAN-ENTER-EXCLUSIVE-AREA-REF DEST="EXCLUSIVE-AREA">/AUTOSAR_Eth_43_PFE/BswModuleDescriptions/Eth/InternalBehavior_0/ETH_EXCLUSIVE_AREA_66</CAN-ENTER-EXCLUSIVE-AREA-REF>
                        <CAN-ENTER-EXCLUSIVE-AREA-REF DEST="EXCLUSIVE-AREA">/AUTOSAR_Eth_43_PFE/BswModuleDescriptions/Eth/InternalBehavior_0/ETH_EXCLUSIVE_AREA_67</CAN-ENTER-EXCLUSIVE-AREA-REF>
                        <CAN-ENTER-EXCLUSIVE-AREA-REF DEST="EXCLUSIVE-AREA">/AUTOSAR_Eth_43_PFE/BswModuleDescriptions/Eth/InternalBehavior_0/ETH_EXCLUSIVE_AREA_68</CAN-ENTER-EXCLUSIVE-AREA-REF>
                        <CAN-ENTER-EXCLUSIVE-AREA-REF DEST="EXCLUSIVE-AREA">/AUTOSAR_Eth_43_PFE/BswModuleDescriptions/Eth/InternalBehavior_0/ETH_EXCLUSIVE_AREA_69</CAN-ENTER-EXCLUSIVE-AREA-REF>
                        <CAN-ENTER-EXCLUSIVE-AREA-REF DEST="EXCLUSIVE-AREA">/AUTOSAR_Eth_43_PFE/BswModuleDescriptions/Eth/InternalBehavior_0/ETH_EXCLUSIVE_AREA_70</CAN-ENTER-EXCLUSIVE-AREA-REF>
                        <CAN-ENTER-EXCLUSIVE-AREA-REF DEST="EXCLUSIVE-AREA">/AUTOSAR_Eth_43_PFE/BswModuleDescriptions/Eth/InternalBehavior_0/ETH_EXCLUSIVE_AREA_71</CAN-ENTER-EXCLUSIVE-AREA-REF>
                        <CAN-ENTER-EXCLUSIVE-AREA-REF DEST="EXCLUSIVE-AREA">/AUTOSAR_Eth_43_PFE/BswModuleDescriptions/Eth/InternalBehavior_0/ETH_EXCLUSIVE_AREA_72</CAN-ENTER-EXCLUSIVE-AREA-REF>
                        <CAN-ENTER-EXCLUSIVE-AREA-REF DEST="EXCLUSIVE-AREA">/AUTOSAR_Eth_43_PFE/BswModuleDescriptions/Eth/InternalBehavior_0/ETH_EXCLUSIVE_AREA_73</CAN-ENTER-EXCLUSIVE-AREA-REF>
                        <CAN-ENTER-EXCLUSIVE-AREA-REF DEST="EXCLUSIVE-AREA">/AUTOSAR_Eth_43_PFE/BswModuleDescriptions/Eth/InternalBehavior_0/ETH_EXCLUSIVE_AREA_74</CAN-ENTER-EXCLUSIVE-AREA-REF>
                        <CAN-ENTER-EXCLUSIVE-AREA-REF DEST="EXCLUSIVE-AREA">/AUTOSAR_Eth_43_PFE/BswModuleDescriptions/Eth/InternalBehavior_0/ETH_EXCLUSIVE_AREA_75</CAN-ENTER-EXCLUSIVE-AREA-REF>
                        <CAN-ENTER-EXCLUSIVE-AREA-REF DEST="EXCLUSIVE-AREA">/AUTOSAR_Eth_43_PFE/BswModuleDescriptions/Eth/InternalBehavior_0/ETH_EXCLUSIVE_AREA_76</CAN-ENTER-EXCLUSIVE-AREA-REF>
                        <CAN-ENTER-EXCLUSIVE-AREA-REF DEST="EXCLUSIVE-AREA">/AUTOSAR_Eth_43_PFE/BswModuleDescriptions/Eth/InternalBehavior_0/ETH_EXCLUSIVE_AREA_77</CAN-ENTER-EXCLUSIVE-AREA-REF>
                        <CAN-ENTER-EXCLUSIVE-AREA-REF DEST="EXCLUSIVE-AREA">/AUTOSAR_Eth_43_PFE/BswModuleDescriptions/Eth/InternalBehavior_0/ETH_EXCLUSIVE_AREA_78</CAN-ENTER-EXCLUSIVE-AREA-REF>
                        <CAN-ENTER-EXCLUSIVE-AREA-REF DEST="EXCLUSIVE-AREA">/AUTOSAR_Eth_43_PFE/BswModuleDescriptions/Eth/InternalBehavior_0/ETH_EXCLUSIVE_AREA_79</CAN-ENTER-EXCLUSIVE-AREA-REF>
                        <CAN-ENTER-EXCLUSIVE-AREA-REF DEST="EXCLUSIVE-AREA">/AUTOSAR_Eth_43_PFE/BswModuleDescriptions/Eth/InternalBehavior_0/ETH_EXCLUSIVE_AREA_81</CAN-ENTER-EXCLUSIVE-AREA-REF>
                        <CAN-ENTER-EXCLUSIVE-AREA-REF DEST="EXCLUSIVE-AREA">/AUTOSAR_Eth_43_PFE/BswModuleDescriptions/Eth/InternalBehavior_0/ETH_EXCLUSIVE_AREA_82</CAN-ENTER-EXCLUSIVE-AREA-REF>
                        <CAN-ENTER-EXCLUSIVE-AREA-REF DEST="EXCLUSIVE-AREA">/AUTOSAR_Eth_43_PFE/BswModuleDescriptions/Eth/InternalBehavior_0/ETH_EXCLUSIVE_AREA_85</CAN-ENTER-EXCLUSIVE-AREA-REF>
                        <CAN-ENTER-EXCLUSIVE-AREA-REF DEST="EXCLUSIVE-AREA">/AUTOSAR_Eth_43_PFE/BswModuleDescriptions/Eth/InternalBehavior_0/ETH_EXCLUSIVE_AREA_86</CAN-ENTER-EXCLUSIVE-AREA-REF>
                        <CAN-ENTER-EXCLUSIVE-AREA-REF DEST="EXCLUSIVE-AREA">/AUTOSAR_Eth_43_PFE/BswModuleDescriptions/Eth/InternalBehavior_0/ETH_EXCLUSIVE_AREA_87</CAN-ENTER-EXCLUSIVE-AREA-REF>
                        <CAN-ENTER-EXCLUSIVE-AREA-REF DEST="EXCLUSIVE-AREA">/AUTOSAR_Eth_43_PFE/BswModuleDescriptions/Eth/InternalBehavior_0/ETH_EXCLUSIVE_AREA_88</CAN-ENTER-EXCLUSIVE-AREA-REF>
                        <CAN-ENTER-EXCLUSIVE-AREA-REF DEST="EXCLUSIVE-AREA">/AUTOSAR_Eth_43_PFE/BswModuleDescriptions/Eth/InternalBehavior_0/ETH_EXCLUSIVE_AREA_89</CAN-ENTER-EXCLUSIVE-AREA-REF>
                        <CAN-ENTER-EXCLUSIVE-AREA-REF DEST="EXCLUSIVE-AREA">/AUTOSAR_Eth_43_PFE/BswModuleDescriptions/Eth/InternalBehavior_0/ETH_EXCLUSIVE_AREA_90</CAN-ENTER-EXCLUSIVE-AREA-REF>
                        <CAN-ENTER-EXCLUSIVE-AREA-REF DEST="EXCLUSIVE-AREA">/AUTOSAR_Eth_43_PFE/BswModuleDescriptions/Eth/InternalBehavior_0/ETH_EXCLUSIVE_AREA_95</CAN-ENTER-EXCLUSIVE-AREA-REF>
                        <CAN-ENTER-EXCLUSIVE-AREA-REF DEST="EXCLUSIVE-AREA">/AUTOSAR_Eth_43_PFE/BswModuleDescriptions/Eth/InternalBehavior_0/ETH_EXCLUSIVE_AREA_96</CAN-ENTER-EXCLUSIVE-AREA-REF>
                        <CAN-ENTER-EXCLUSIVE-AREA-REF DEST="EXCLUSIVE-AREA">/AUTOSAR_Eth_43_PFE/BswModuleDescriptions/Eth/InternalBehavior_0/ETH_EXCLUSIVE_AREA_97</CAN-ENTER-EXCLUSIVE-AREA-REF>
                        <CAN-ENTER-EXCLUSIVE-AREA-REF DEST="EXCLUSIVE-AREA">/AUTOSAR_Eth_43_PFE/BswModuleDescriptions/Eth/InternalBehavior_0/ETH_EXCLUSIVE_AREA_99</CAN-ENTER-EXCLUSIVE-AREA-REF>
                        <CAN-ENTER-EXCLUSIVE-AREA-REF DEST="EXCLUSIVE-AREA">/AUTOSAR_Eth_43_PFE/BswModuleDescriptions/Eth/InternalBehavior_0/ETH_EXCLUSIVE_AREA_100</CAN-ENTER-EXCLUSIVE-AREA-REF>
                        <CAN-ENTER-EXCLUSIVE-AREA-REF DEST="EXCLUSIVE-AREA">/AUTOSAR_Eth_43_PFE/BswModuleDescriptions/Eth/InternalBehavior_0/ETH_EXCLUSIVE_AREA_101</CAN-ENTER-EXCLUSIVE-AREA-REF>
                        <CAN-ENTER-EXCLUSIVE-AREA-REF DEST="EXCLUSIVE-AREA">/AUTOSAR_Eth_43_PFE/BswModuleDescriptions/Eth/InternalBehavior_0/ETH_EXCLUSIVE_AREA_102</CAN-ENTER-EXCLUSIVE-AREA-REF>
                        <CAN-ENTER-EXCLUSIVE-AREA-REF DEST="EXCLUSIVE-AREA">/AUTOSAR_Eth_43_PFE/BswModuleDescriptions/Eth/InternalBehavior_0/ETH_EXCLUSIVE_AREA_103</CAN-ENTER-EXCLUSIVE-AREA-REF>
                        <CAN-ENTER-EXCLUSIVE-AREA-REF DEST="EXCLUSIVE-AREA">/AUTOSAR_Eth_43_PFE/BswModuleDescriptions/Eth/InternalBehavior_0/ETH_EXCLUSIVE_AREA_104</CAN-ENTER-EXCLUSIVE-AREA-REF>
                      </CAN-ENTER-EXCLUSIVE-AREA-REFS>
                      <MINIMUM-START-INTERVAL>0.0</MINIMUM-START-INTERVAL>
                      <IMPLEMENTED-ENTRY-REF DEST="BSW-MODULE-ENTRY">/AUTOSAR_Eth_43_PFE/BswModuleEntrys/fci_query</IMPLEMENTED-ENTRY-REF>
                    </BSW-CALLED-ENTITY>
                    <BSW-CALLED-ENTITY>
                      <SHORT-NAME>fci_write</SHORT-NAME>
                      <CAN-ENTER-EXCLUSIVE-AREA-REFS>
                        <CAN-ENTER-EXCLUSIVE-AREA-REF DEST="EXCLUSIVE-AREA">/AUTOSAR_Eth_43_PFE/BswModuleDescriptions/Eth/InternalBehavior_0/ETH_EXCLUSIVE_AREA_01</CAN-ENTER-EXCLUSIVE-AREA-REF>
                        <CAN-ENTER-EXCLUSIVE-AREA-REF DEST="EXCLUSIVE-AREA">/AUTOSAR_Eth_43_PFE/BswModuleDescriptions/Eth/InternalBehavior_0/ETH_EXCLUSIVE_AREA_03</CAN-ENTER-EXCLUSIVE-AREA-REF>
                        <CAN-ENTER-EXCLUSIVE-AREA-REF DEST="EXCLUSIVE-AREA">/AUTOSAR_Eth_43_PFE/BswModuleDescriptions/Eth/InternalBehavior_0/ETH_EXCLUSIVE_AREA_04</CAN-ENTER-EXCLUSIVE-AREA-REF>
                        <CAN-ENTER-EXCLUSIVE-AREA-REF DEST="EXCLUSIVE-AREA">/AUTOSAR_Eth_43_PFE/BswModuleDescriptions/Eth/InternalBehavior_0/ETH_EXCLUSIVE_AREA_05</CAN-ENTER-EXCLUSIVE-AREA-REF>
                        <CAN-ENTER-EXCLUSIVE-AREA-REF DEST="EXCLUSIVE-AREA">/AUTOSAR_Eth_43_PFE/BswModuleDescriptions/Eth/InternalBehavior_0/ETH_EXCLUSIVE_AREA_07</CAN-ENTER-EXCLUSIVE-AREA-REF>
                        <CAN-ENTER-EXCLUSIVE-AREA-REF DEST="EXCLUSIVE-AREA">/AUTOSAR_Eth_43_PFE/BswModuleDescriptions/Eth/InternalBehavior_0/ETH_EXCLUSIVE_AREA_08</CAN-ENTER-EXCLUSIVE-AREA-REF>
                        <CAN-ENTER-EXCLUSIVE-AREA-REF DEST="EXCLUSIVE-AREA">/AUTOSAR_Eth_43_PFE/BswModuleDescriptions/Eth/InternalBehavior_0/ETH_EXCLUSIVE_AREA_09</CAN-ENTER-EXCLUSIVE-AREA-REF>
                        <CAN-ENTER-EXCLUSIVE-AREA-REF DEST="EXCLUSIVE-AREA">/AUTOSAR_Eth_43_PFE/BswModuleDescriptions/Eth/InternalBehavior_0/ETH_EXCLUSIVE_AREA_10</CAN-ENTER-EXCLUSIVE-AREA-REF>
                        <CAN-ENTER-EXCLUSIVE-AREA-REF DEST="EXCLUSIVE-AREA">/AUTOSAR_Eth_43_PFE/BswModuleDescriptions/Eth/InternalBehavior_0/ETH_EXCLUSIVE_AREA_11</CAN-ENTER-EXCLUSIVE-AREA-REF>
                        <CAN-ENTER-EXCLUSIVE-AREA-REF DEST="EXCLUSIVE-AREA">/AUTOSAR_Eth_43_PFE/BswModuleDescriptions/Eth/InternalBehavior_0/ETH_EXCLUSIVE_AREA_12</CAN-ENTER-EXCLUSIVE-AREA-REF>
                        <CAN-ENTER-EXCLUSIVE-AREA-REF DEST="EXCLUSIVE-AREA">/AUTOSAR_Eth_43_PFE/BswModuleDescriptions/Eth/InternalBehavior_0/ETH_EXCLUSIVE_AREA_13</CAN-ENTER-EXCLUSIVE-AREA-REF>
                        <CAN-ENTER-EXCLUSIVE-AREA-REF DEST="EXCLUSIVE-AREA">/AUTOSAR_Eth_43_PFE/BswModuleDescriptions/Eth/InternalBehavior_0/ETH_EXCLUSIVE_AREA_14</CAN-ENTER-EXCLUSIVE-AREA-REF>
                        <CAN-ENTER-EXCLUSIVE-AREA-REF DEST="EXCLUSIVE-AREA">/AUTOSAR_Eth_43_PFE/BswModuleDescriptions/Eth/InternalBehavior_0/ETH_EXCLUSIVE_AREA_15</CAN-ENTER-EXCLUSIVE-AREA-REF>
                        <CAN-ENTER-EXCLUSIVE-AREA-REF DEST="EXCLUSIVE-AREA">/AUTOSAR_Eth_43_PFE/BswModuleDescriptions/Eth/InternalBehavior_0/ETH_EXCLUSIVE_AREA_16</CAN-ENTER-EXCLUSIVE-AREA-REF>
                        <CAN-ENTER-EXCLUSIVE-AREA-REF DEST="EXCLUSIVE-AREA">/AUTOSAR_Eth_43_PFE/BswModuleDescriptions/Eth/InternalBehavior_0/ETH_EXCLUSIVE_AREA_22</CAN-ENTER-EXCLUSIVE-AREA-REF>
                        <CAN-ENTER-EXCLUSIVE-AREA-REF DEST="EXCLUSIVE-AREA">/AUTOSAR_Eth_43_PFE/BswModuleDescriptions/Eth/InternalBehavior_0/ETH_EXCLUSIVE_AREA_23</CAN-ENTER-EXCLUSIVE-AREA-REF>
                        <CAN-ENTER-EXCLUSIVE-AREA-REF DEST="EXCLUSIVE-AREA">/AUTOSAR_Eth_43_PFE/BswModuleDescriptions/Eth/InternalBehavior_0/ETH_EXCLUSIVE_AREA_26</CAN-ENTER-EXCLUSIVE-AREA-REF>
                        <CAN-ENTER-EXCLUSIVE-AREA-REF DEST="EXCLUSIVE-AREA">/AUTOSAR_Eth_43_PFE/BswModuleDescriptions/Eth/InternalBehavior_0/ETH_EXCLUSIVE_AREA_27</CAN-ENTER-EXCLUSIVE-AREA-REF>
                        <CAN-ENTER-EXCLUSIVE-AREA-REF DEST="EXCLUSIVE-AREA">/AUTOSAR_Eth_43_PFE/BswModuleDescriptions/Eth/InternalBehavior_0/ETH_EXCLUSIVE_AREA_28</CAN-ENTER-EXCLUSIVE-AREA-REF>
                        <CAN-ENTER-EXCLUSIVE-AREA-REF DEST="EXCLUSIVE-AREA">/AUTOSAR_Eth_43_PFE/BswModuleDescriptions/Eth/InternalBehavior_0/ETH_EXCLUSIVE_AREA_30</CAN-ENTER-EXCLUSIVE-AREA-REF>
                        <CAN-ENTER-EXCLUSIVE-AREA-REF DEST="EXCLUSIVE-AREA">/AUTOSAR_Eth_43_PFE/BswModuleDescriptions/Eth/InternalBehavior_0/ETH_EXCLUSIVE_AREA_31</CAN-ENTER-EXCLUSIVE-AREA-REF>
                        <CAN-ENTER-EXCLUSIVE-AREA-REF DEST="EXCLUSIVE-AREA">/AUTOSAR_Eth_43_PFE/BswModuleDescriptions/Eth/InternalBehavior_0/ETH_EXCLUSIVE_AREA_34</CAN-ENTER-EXCLUSIVE-AREA-REF>
                        <CAN-ENTER-EXCLUSIVE-AREA-REF DEST="EXCLUSIVE-AREA">/AUTOSAR_Eth_43_PFE/BswModuleDescriptions/Eth/InternalBehavior_0/ETH_EXCLUSIVE_AREA_38</CAN-ENTER-EXCLUSIVE-AREA-REF>
                        <CAN-ENTER-EXCLUSIVE-AREA-REF DEST="EXCLUSIVE-AREA">/AUTOSAR_Eth_43_PFE/BswModuleDescriptions/Eth/InternalBehavior_0/ETH_EXCLUSIVE_AREA_39</CAN-ENTER-EXCLUSIVE-AREA-REF>
                        <CAN-ENTER-EXCLUSIVE-AREA-REF DEST="EXCLUSIVE-AREA">/AUTOSAR_Eth_43_PFE/BswModuleDescriptions/Eth/InternalBehavior_0/ETH_EXCLUSIVE_AREA_41</CAN-ENTER-EXCLUSIVE-AREA-REF>
                        <CAN-ENTER-EXCLUSIVE-AREA-REF DEST="EXCLUSIVE-AREA">/AUTOSAR_Eth_43_PFE/BswModuleDescriptions/Eth/InternalBehavior_0/ETH_EXCLUSIVE_AREA_45</CAN-ENTER-EXCLUSIVE-AREA-REF>
                        <CAN-ENTER-EXCLUSIVE-AREA-REF DEST="EXCLUSIVE-AREA">/AUTOSAR_Eth_43_PFE/BswModuleDescriptions/Eth/InternalBehavior_0/ETH_EXCLUSIVE_AREA_46</CAN-ENTER-EXCLUSIVE-AREA-REF>
                        <CAN-ENTER-EXCLUSIVE-AREA-REF DEST="EXCLUSIVE-AREA">/AUTOSAR_Eth_43_PFE/BswModuleDescriptions/Eth/InternalBehavior_0/ETH_EXCLUSIVE_AREA_47</CAN-ENTER-EXCLUSIVE-AREA-REF>
                        <CAN-ENTER-EXCLUSIVE-AREA-REF DEST="EXCLUSIVE-AREA">/AUTOSAR_Eth_43_PFE/BswModuleDescriptions/Eth/InternalBehavior_0/ETH_EXCLUSIVE_AREA_48</CAN-ENTER-EXCLUSIVE-AREA-REF>
                        <CAN-ENTER-EXCLUSIVE-AREA-REF DEST="EXCLUSIVE-AREA">/AUTOSAR_Eth_43_PFE/BswModuleDescriptions/Eth/InternalBehavior_0/ETH_EXCLUSIVE_AREA_52</CAN-ENTER-EXCLUSIVE-AREA-REF>
                        <CAN-ENTER-EXCLUSIVE-AREA-REF DEST="EXCLUSIVE-AREA">/AUTOSAR_Eth_43_PFE/BswModuleDescriptions/Eth/InternalBehavior_0/ETH_EXCLUSIVE_AREA_54</CAN-ENTER-EXCLUSIVE-AREA-REF>
                        <CAN-ENTER-EXCLUSIVE-AREA-REF DEST="EXCLUSIVE-AREA">/AUTOSAR_Eth_43_PFE/BswModuleDescriptions/Eth/InternalBehavior_0/ETH_EXCLUSIVE_AREA_55</CAN-ENTER-EXCLUSIVE-AREA-REF>
                        <CAN-ENTER-EXCLUSIVE-AREA-REF DEST="EXCLUSIVE-AREA">/AUTOSAR_Eth_43_PFE/BswModuleDescriptions/Eth/InternalBehavior_0/ETH_EXCLUSIVE_AREA_56</CAN-ENTER-EXCLUSIVE-AREA-REF>
                        <CAN-ENTER-EXCLUSIVE-AREA-REF DEST="EXCLUSIVE-AREA">/AUTOSAR_Eth_43_PFE/BswModuleDescriptions/Eth/InternalBehavior_0/ETH_EXCLUSIVE_AREA_58</CAN-ENTER-EXCLUSIVE-AREA-REF>
                        <CAN-ENTER-EXCLUSIVE-AREA-REF DEST="EXCLUSIVE-AREA">/AUTOSAR_Eth_43_PFE/BswModuleDescriptions/Eth/InternalBehavior_0/ETH_EXCLUSIVE_AREA_59</CAN-ENTER-EXCLUSIVE-AREA-REF>
                        <CAN-ENTER-EXCLUSIVE-AREA-REF DEST="EXCLUSIVE-AREA">/AUTOSAR_Eth_43_PFE/BswModuleDescriptions/Eth/InternalBehavior_0/ETH_EXCLUSIVE_AREA_65</CAN-ENTER-EXCLUSIVE-AREA-REF>
                        <CAN-ENTER-EXCLUSIVE-AREA-REF DEST="EXCLUSIVE-AREA">/AUTOSAR_Eth_43_PFE/BswModuleDescriptions/Eth/InternalBehavior_0/ETH_EXCLUSIVE_AREA_66</CAN-ENTER-EXCLUSIVE-AREA-REF>
                        <CAN-ENTER-EXCLUSIVE-AREA-REF DEST="EXCLUSIVE-AREA">/AUTOSAR_Eth_43_PFE/BswModuleDescriptions/Eth/InternalBehavior_0/ETH_EXCLUSIVE_AREA_67</CAN-ENTER-EXCLUSIVE-AREA-REF>
                        <CAN-ENTER-EXCLUSIVE-AREA-REF DEST="EXCLUSIVE-AREA">/AUTOSAR_Eth_43_PFE/BswModuleDescriptions/Eth/InternalBehavior_0/ETH_EXCLUSIVE_AREA_68</CAN-ENTER-EXCLUSIVE-AREA-REF>
                        <CAN-ENTER-EXCLUSIVE-AREA-REF DEST="EXCLUSIVE-AREA">/AUTOSAR_Eth_43_PFE/BswModuleDescriptions/Eth/InternalBehavior_0/ETH_EXCLUSIVE_AREA_69</CAN-ENTER-EXCLUSIVE-AREA-REF>
                        <CAN-ENTER-EXCLUSIVE-AREA-REF DEST="EXCLUSIVE-AREA">/AUTOSAR_Eth_43_PFE/BswModuleDescriptions/Eth/InternalBehavior_0/ETH_EXCLUSIVE_AREA_70</CAN-ENTER-EXCLUSIVE-AREA-REF>
                        <CAN-ENTER-EXCLUSIVE-AREA-REF DEST="EXCLUSIVE-AREA">/AUTOSAR_Eth_43_PFE/BswModuleDescriptions/Eth/InternalBehavior_0/ETH_EXCLUSIVE_AREA_71</CAN-ENTER-EXCLUSIVE-AREA-REF>
                        <CAN-ENTER-EXCLUSIVE-AREA-REF DEST="EXCLUSIVE-AREA">/AUTOSAR_Eth_43_PFE/BswModuleDescriptions/Eth/InternalBehavior_0/ETH_EXCLUSIVE_AREA_72</CAN-ENTER-EXCLUSIVE-AREA-REF>
                        <CAN-ENTER-EXCLUSIVE-AREA-REF DEST="EXCLUSIVE-AREA">/AUTOSAR_Eth_43_PFE/BswModuleDescriptions/Eth/InternalBehavior_0/ETH_EXCLUSIVE_AREA_73</CAN-ENTER-EXCLUSIVE-AREA-REF>
                        <CAN-ENTER-EXCLUSIVE-AREA-REF DEST="EXCLUSIVE-AREA">/AUTOSAR_Eth_43_PFE/BswModuleDescriptions/Eth/InternalBehavior_0/ETH_EXCLUSIVE_AREA_74</CAN-ENTER-EXCLUSIVE-AREA-REF>
                        <CAN-ENTER-EXCLUSIVE-AREA-REF DEST="EXCLUSIVE-AREA">/AUTOSAR_Eth_43_PFE/BswModuleDescriptions/Eth/InternalBehavior_0/ETH_EXCLUSIVE_AREA_75</CAN-ENTER-EXCLUSIVE-AREA-REF>
                        <CAN-ENTER-EXCLUSIVE-AREA-REF DEST="EXCLUSIVE-AREA">/AUTOSAR_Eth_43_PFE/BswModuleDescriptions/Eth/InternalBehavior_0/ETH_EXCLUSIVE_AREA_76</CAN-ENTER-EXCLUSIVE-AREA-REF>
                        <CAN-ENTER-EXCLUSIVE-AREA-REF DEST="EXCLUSIVE-AREA">/AUTOSAR_Eth_43_PFE/BswModuleDescriptions/Eth/InternalBehavior_0/ETH_EXCLUSIVE_AREA_77</CAN-ENTER-EXCLUSIVE-AREA-REF>
                        <CAN-ENTER-EXCLUSIVE-AREA-REF DEST="EXCLUSIVE-AREA">/AUTOSAR_Eth_43_PFE/BswModuleDescriptions/Eth/InternalBehavior_0/ETH_EXCLUSIVE_AREA_78</CAN-ENTER-EXCLUSIVE-AREA-REF>
                        <CAN-ENTER-EXCLUSIVE-AREA-REF DEST="EXCLUSIVE-AREA">/AUTOSAR_Eth_43_PFE/BswModuleDescriptions/Eth/InternalBehavior_0/ETH_EXCLUSIVE_AREA_79</CAN-ENTER-EXCLUSIVE-AREA-REF>
                        <CAN-ENTER-EXCLUSIVE-AREA-REF DEST="EXCLUSIVE-AREA">/AUTOSAR_Eth_43_PFE/BswModuleDescriptions/Eth/InternalBehavior_0/ETH_EXCLUSIVE_AREA_81</CAN-ENTER-EXCLUSIVE-AREA-REF>
                        <CAN-ENTER-EXCLUSIVE-AREA-REF DEST="EXCLUSIVE-AREA">/AUTOSAR_Eth_43_PFE/BswModuleDescriptions/Eth/InternalBehavior_0/ETH_EXCLUSIVE_AREA_82</CAN-ENTER-EXCLUSIVE-AREA-REF>
                        <CAN-ENTER-EXCLUSIVE-AREA-REF DEST="EXCLUSIVE-AREA">/AUTOSAR_Eth_43_PFE/BswModuleDescriptions/Eth/InternalBehavior_0/ETH_EXCLUSIVE_AREA_85</CAN-ENTER-EXCLUSIVE-AREA-REF>
                        <CAN-ENTER-EXCLUSIVE-AREA-REF DEST="EXCLUSIVE-AREA">/AUTOSAR_Eth_43_PFE/BswModuleDescriptions/Eth/InternalBehavior_0/ETH_EXCLUSIVE_AREA_86</CAN-ENTER-EXCLUSIVE-AREA-REF>
                        <CAN-ENTER-EXCLUSIVE-AREA-REF DEST="EXCLUSIVE-AREA">/AUTOSAR_Eth_43_PFE/BswModuleDescriptions/Eth/InternalBehavior_0/ETH_EXCLUSIVE_AREA_87</CAN-ENTER-EXCLUSIVE-AREA-REF>
                        <CAN-ENTER-EXCLUSIVE-AREA-REF DEST="EXCLUSIVE-AREA">/AUTOSAR_Eth_43_PFE/BswModuleDescriptions/Eth/InternalBehavior_0/ETH_EXCLUSIVE_AREA_88</CAN-ENTER-EXCLUSIVE-AREA-REF>
                        <CAN-ENTER-EXCLUSIVE-AREA-REF DEST="EXCLUSIVE-AREA">/AUTOSAR_Eth_43_PFE/BswModuleDescriptions/Eth/InternalBehavior_0/ETH_EXCLUSIVE_AREA_89</CAN-ENTER-EXCLUSIVE-AREA-REF>
                        <CAN-ENTER-EXCLUSIVE-AREA-REF DEST="EXCLUSIVE-AREA">/AUTOSAR_Eth_43_PFE/BswModuleDescriptions/Eth/InternalBehavior_0/ETH_EXCLUSIVE_AREA_90</CAN-ENTER-EXCLUSIVE-AREA-REF>
                        <CAN-ENTER-EXCLUSIVE-AREA-REF DEST="EXCLUSIVE-AREA">/AUTOSAR_Eth_43_PFE/BswModuleDescriptions/Eth/InternalBehavior_0/ETH_EXCLUSIVE_AREA_95</CAN-ENTER-EXCLUSIVE-AREA-REF>
                        <CAN-ENTER-EXCLUSIVE-AREA-REF DEST="EXCLUSIVE-AREA">/AUTOSAR_Eth_43_PFE/BswModuleDescriptions/Eth/InternalBehavior_0/ETH_EXCLUSIVE_AREA_96</CAN-ENTER-EXCLUSIVE-AREA-REF>
                        <CAN-ENTER-EXCLUSIVE-AREA-REF DEST="EXCLUSIVE-AREA">/AUTOSAR_Eth_43_PFE/BswModuleDescriptions/Eth/InternalBehavior_0/ETH_EXCLUSIVE_AREA_97</CAN-ENTER-EXCLUSIVE-AREA-REF>
                        <CAN-ENTER-EXCLUSIVE-AREA-REF DEST="EXCLUSIVE-AREA">/AUTOSAR_Eth_43_PFE/BswModuleDescriptions/Eth/InternalBehavior_0/ETH_EXCLUSIVE_AREA_99</CAN-ENTER-EXCLUSIVE-AREA-REF>
                        <CAN-ENTER-EXCLUSIVE-AREA-REF DEST="EXCLUSIVE-AREA">/AUTOSAR_Eth_43_PFE/BswModuleDescriptions/Eth/InternalBehavior_0/ETH_EXCLUSIVE_AREA_100</CAN-ENTER-EXCLUSIVE-AREA-REF>
                        <CAN-ENTER-EXCLUSIVE-AREA-REF DEST="EXCLUSIVE-AREA">/AUTOSAR_Eth_43_PFE/BswModuleDescriptions/Eth/InternalBehavior_0/ETH_EXCLUSIVE_AREA_101</CAN-ENTER-EXCLUSIVE-AREA-REF>
                        <CAN-ENTER-EXCLUSIVE-AREA-REF DEST="EXCLUSIVE-AREA">/AUTOSAR_Eth_43_PFE/BswModuleDescriptions/Eth/InternalBehavior_0/ETH_EXCLUSIVE_AREA_102</CAN-ENTER-EXCLUSIVE-AREA-REF>
                        <CAN-ENTER-EXCLUSIVE-AREA-REF DEST="EXCLUSIVE-AREA">/AUTOSAR_Eth_43_PFE/BswModuleDescriptions/Eth/InternalBehavior_0/ETH_EXCLUSIVE_AREA_103</CAN-ENTER-EXCLUSIVE-AREA-REF>
                        <CAN-ENTER-EXCLUSIVE-AREA-REF DEST="EXCLUSIVE-AREA">/AUTOSAR_Eth_43_PFE/BswModuleDescriptions/Eth/InternalBehavior_0/ETH_EXCLUSIVE_AREA_104</CAN-ENTER-EXCLUSIVE-AREA-REF>
                      </CAN-ENTER-EXCLUSIVE-AREA-REFS>
                      <MINIMUM-START-INTERVAL>0.0</MINIMUM-START-INTERVAL>
                      <IMPLEMENTED-ENTRY-REF DEST="BSW-MODULE-ENTRY">/AUTOSAR_Eth_43_PFE/BswModuleEntrys/fci_write</IMPLEMENTED-ENTRY-REF>
                    </BSW-CALLED-ENTITY>
                    <BSW-CALLED-ENTITY>
                      <SHORT-NAME>fci_register_cb</SHORT-NAME>
                      <MINIMUM-START-INTERVAL>0.0</MINIMUM-START-INTERVAL>
                      <IMPLEMENTED-ENTRY-REF DEST="BSW-MODULE-ENTRY">/AUTOSAR_Eth_43_PFE/BswModuleEntrys/fci_register_cb</IMPLEMENTED-ENTRY-REF>
                    </BSW-CALLED-ENTITY>
                    <BSW-CALLED-ENTITY>
                      <SHORT-NAME>fci_fd</SHORT-NAME>
                      <MINIMUM-START-INTERVAL>0.0</MINIMUM-START-INTERVAL>
                      <IMPLEMENTED-ENTRY-REF DEST="BSW-MODULE-ENTRY">/AUTOSAR_Eth_43_PFE/BswModuleEntrys/fci_fd</IMPLEMENTED-ENTRY-REF>
                    </BSW-CALLED-ENTITY>
                    [!ENDIF!][!//
                    <BSW-SCHEDULABLE-ENTITY>
                      <SHORT-NAME>Eth_43_PFE_MainFunction</SHORT-NAME>
                      <CAN-ENTER-EXCLUSIVE-AREA-REFS>
                        <CAN-ENTER-EXCLUSIVE-AREA-REF DEST="EXCLUSIVE-AREA">/AUTOSAR_Eth_43_PFE/BswModuleDescriptions/Eth/InternalBehavior_0/ETH_EXCLUSIVE_AREA_18</CAN-ENTER-EXCLUSIVE-AREA-REF>
                        <CAN-ENTER-EXCLUSIVE-AREA-REF DEST="EXCLUSIVE-AREA">/AUTOSAR_Eth_43_PFE/BswModuleDescriptions/Eth/InternalBehavior_0/ETH_EXCLUSIVE_AREA_21</CAN-ENTER-EXCLUSIVE-AREA-REF>
                        <CAN-ENTER-EXCLUSIVE-AREA-REF DEST="EXCLUSIVE-AREA">/AUTOSAR_Eth_43_PFE/BswModuleDescriptions/Eth/InternalBehavior_0/ETH_EXCLUSIVE_AREA_22</CAN-ENTER-EXCLUSIVE-AREA-REF>
                        <CAN-ENTER-EXCLUSIVE-AREA-REF DEST="EXCLUSIVE-AREA">/AUTOSAR_Eth_43_PFE/BswModuleDescriptions/Eth/InternalBehavior_0/ETH_EXCLUSIVE_AREA_25</CAN-ENTER-EXCLUSIVE-AREA-REF>
                        <CAN-ENTER-EXCLUSIVE-AREA-REF DEST="EXCLUSIVE-AREA">/AUTOSAR_Eth_43_PFE/BswModuleDescriptions/Eth/InternalBehavior_0/ETH_EXCLUSIVE_AREA_30</CAN-ENTER-EXCLUSIVE-AREA-REF>
                        <CAN-ENTER-EXCLUSIVE-AREA-REF DEST="EXCLUSIVE-AREA">/AUTOSAR_Eth_43_PFE/BswModuleDescriptions/Eth/InternalBehavior_0/ETH_EXCLUSIVE_AREA_35</CAN-ENTER-EXCLUSIVE-AREA-REF>
                        <CAN-ENTER-EXCLUSIVE-AREA-REF DEST="EXCLUSIVE-AREA">/AUTOSAR_Eth_43_PFE/BswModuleDescriptions/Eth/InternalBehavior_0/ETH_EXCLUSIVE_AREA_36</CAN-ENTER-EXCLUSIVE-AREA-REF>
                        <CAN-ENTER-EXCLUSIVE-AREA-REF DEST="EXCLUSIVE-AREA">/AUTOSAR_Eth_43_PFE/BswModuleDescriptions/Eth/InternalBehavior_0/ETH_EXCLUSIVE_AREA_38</CAN-ENTER-EXCLUSIVE-AREA-REF>
                        <CAN-ENTER-EXCLUSIVE-AREA-REF DEST="EXCLUSIVE-AREA">/AUTOSAR_Eth_43_PFE/BswModuleDescriptions/Eth/InternalBehavior_0/ETH_EXCLUSIVE_AREA_39</CAN-ENTER-EXCLUSIVE-AREA-REF>
                        <CAN-ENTER-EXCLUSIVE-AREA-REF DEST="EXCLUSIVE-AREA">/AUTOSAR_Eth_43_PFE/BswModuleDescriptions/Eth/InternalBehavior_0/ETH_EXCLUSIVE_AREA_40</CAN-ENTER-EXCLUSIVE-AREA-REF>
                        <CAN-ENTER-EXCLUSIVE-AREA-REF DEST="EXCLUSIVE-AREA">/AUTOSAR_Eth_43_PFE/BswModuleDescriptions/Eth/InternalBehavior_0/ETH_EXCLUSIVE_AREA_50</CAN-ENTER-EXCLUSIVE-AREA-REF>
                        <CAN-ENTER-EXCLUSIVE-AREA-REF DEST="EXCLUSIVE-AREA">/AUTOSAR_Eth_43_PFE/BswModuleDescriptions/Eth/InternalBehavior_0/ETH_EXCLUSIVE_AREA_52</CAN-ENTER-EXCLUSIVE-AREA-REF>
                        <CAN-ENTER-EXCLUSIVE-AREA-REF DEST="EXCLUSIVE-AREA">/AUTOSAR_Eth_43_PFE/BswModuleDescriptions/Eth/InternalBehavior_0/ETH_EXCLUSIVE_AREA_54</CAN-ENTER-EXCLUSIVE-AREA-REF>
                        <CAN-ENTER-EXCLUSIVE-AREA-REF DEST="EXCLUSIVE-AREA">/AUTOSAR_Eth_43_PFE/BswModuleDescriptions/Eth/InternalBehavior_0/ETH_EXCLUSIVE_AREA_55</CAN-ENTER-EXCLUSIVE-AREA-REF>
                        <CAN-ENTER-EXCLUSIVE-AREA-REF DEST="EXCLUSIVE-AREA">/AUTOSAR_Eth_43_PFE/BswModuleDescriptions/Eth/InternalBehavior_0/ETH_EXCLUSIVE_AREA_56</CAN-ENTER-EXCLUSIVE-AREA-REF>
                        <CAN-ENTER-EXCLUSIVE-AREA-REF DEST="EXCLUSIVE-AREA">/AUTOSAR_Eth_43_PFE/BswModuleDescriptions/Eth/InternalBehavior_0/ETH_EXCLUSIVE_AREA_80</CAN-ENTER-EXCLUSIVE-AREA-REF>
                        <CAN-ENTER-EXCLUSIVE-AREA-REF DEST="EXCLUSIVE-AREA">/AUTOSAR_Eth_43_PFE/BswModuleDescriptions/Eth/InternalBehavior_0/ETH_EXCLUSIVE_AREA_95</CAN-ENTER-EXCLUSIVE-AREA-REF>
                        <CAN-ENTER-EXCLUSIVE-AREA-REF DEST="EXCLUSIVE-AREA">/AUTOSAR_Eth_43_PFE/BswModuleDescriptions/Eth/InternalBehavior_0/ETH_EXCLUSIVE_AREA_100</CAN-ENTER-EXCLUSIVE-AREA-REF>
                      </CAN-ENTER-EXCLUSIVE-AREA-REFS>
                      <MINIMUM-START-INTERVAL>0.0</MINIMUM-START-INTERVAL>
                      <IMPLEMENTED-ENTRY-REF DEST="BSW-MODULE-ENTRY">/AUTOSAR_Eth_43_PFE/BswModuleEntrys/Eth_MainFunction</IMPLEMENTED-ENTRY-REF>
                    </BSW-SCHEDULABLE-ENTITY>
                    <BSW-INTERRUPT-ENTITY>
                      <SHORT-NAME>Eth_43_PFE_HifIrqHdlr_0</SHORT-NAME>
                      <MINIMUM-START-INTERVAL>0.0</MINIMUM-START-INTERVAL>
                      <IMPLEMENTED-ENTRY-REF DEST="BSW-MODULE-ENTRY">/AUTOSAR_Eth_43_PFE/BswModuleEntrys/Eth_HifIrqHdlr_0</IMPLEMENTED-ENTRY-REF>
                      <INTERRUPT-CATEGORY>CAT-2</INTERRUPT-CATEGORY>
                      <INTERRUPT-SOURCE>Hardware</INTERRUPT-SOURCE>
                    </BSW-INTERRUPT-ENTITY>
                    <BSW-INTERRUPT-ENTITY>
                      <SHORT-NAME>Eth_43_PFE_HifIrqHdlr_1</SHORT-NAME>
                      <MINIMUM-START-INTERVAL>0.0</MINIMUM-START-INTERVAL>
                      <IMPLEMENTED-ENTRY-REF DEST="BSW-MODULE-ENTRY">/AUTOSAR_Eth_43_PFE/BswModuleEntrys/Eth_HifIrqHdlr_1</IMPLEMENTED-ENTRY-REF>
                      <INTERRUPT-CATEGORY>CAT-2</INTERRUPT-CATEGORY>
                      <INTERRUPT-SOURCE>Hardware</INTERRUPT-SOURCE>
                    </BSW-INTERRUPT-ENTITY>
                    <BSW-INTERRUPT-ENTITY>
                      <SHORT-NAME>Eth_43_PFE_HifIrqHdlr_2</SHORT-NAME>
                      <MINIMUM-START-INTERVAL>0.0</MINIMUM-START-INTERVAL>
                      <IMPLEMENTED-ENTRY-REF DEST="BSW-MODULE-ENTRY">/AUTOSAR_Eth_43_PFE/BswModuleEntrys/Eth_HifIrqHdlr_2</IMPLEMENTED-ENTRY-REF>
                      <INTERRUPT-CATEGORY>CAT-2</INTERRUPT-CATEGORY>
                      <INTERRUPT-SOURCE>Hardware</INTERRUPT-SOURCE>
                    </BSW-INTERRUPT-ENTITY>
                    <BSW-INTERRUPT-ENTITY>
                      <SHORT-NAME>Eth_43_PFE_HifIrqHdlr_3</SHORT-NAME>
                      <MINIMUM-START-INTERVAL>0.0</MINIMUM-START-INTERVAL>
                      <IMPLEMENTED-ENTRY-REF DEST="BSW-MODULE-ENTRY">/AUTOSAR_Eth_43_PFE/BswModuleEntrys/Eth_HifIrqHdlr_3</IMPLEMENTED-ENTRY-REF>
                      <INTERRUPT-CATEGORY>CAT-2</INTERRUPT-CATEGORY>
                      <INTERRUPT-SOURCE>Hardware</INTERRUPT-SOURCE>
                    </BSW-INTERRUPT-ENTITY>
                    <BSW-INTERRUPT-ENTITY>
                      <SHORT-NAME>Eth_43_PFE_HifNoCpyIrqHdlr</SHORT-NAME>
                      <MINIMUM-START-INTERVAL>0.0</MINIMUM-START-INTERVAL>
                      <IMPLEMENTED-ENTRY-REF DEST="BSW-MODULE-ENTRY">/AUTOSAR_Eth_43_PFE/BswModuleEntrys/Eth_HifNoCpyIrqHdlr</IMPLEMENTED-ENTRY-REF>
                      <INTERRUPT-CATEGORY>CAT-2</INTERRUPT-CATEGORY>
                      <INTERRUPT-SOURCE>Hardware</INTERRUPT-SOURCE>
                    </BSW-INTERRUPT-ENTITY>
                    <BSW-INTERRUPT-ENTITY>
                      <SHORT-NAME>Eth_43_PFE_BmuIrqHdlr</SHORT-NAME>
                      <MINIMUM-START-INTERVAL>0.0</MINIMUM-START-INTERVAL>
                      <IMPLEMENTED-ENTRY-REF DEST="BSW-MODULE-ENTRY">/AUTOSAR_Eth_43_PFE/BswModuleEntrys/Eth_BmuIrqHdlr</IMPLEMENTED-ENTRY-REF>
                      <INTERRUPT-CATEGORY>CAT-2</INTERRUPT-CATEGORY>
                      <INTERRUPT-SOURCE>Hardware</INTERRUPT-SOURCE>
                    </BSW-INTERRUPT-ENTITY>
                  </ENTITYS>
                  <EVENTS>
                    <BSW-TIMING-EVENT>
                      <SHORT-NAME>EthTimingEvent_MainFunction</SHORT-NAME>
                      <STARTS-ON-EVENT-REF DEST="BSW-SCHEDULABLE-ENTITY">/AUTOSAR_Eth_43_PFE/BswModuleDescriptions/Eth/InternalBehavior_0/Eth_43_PFE_MainFunction</STARTS-ON-EVENT-REF>
                      <PERIOD>[!IF "node:exists(EthGeneral/EthMainFunctionPeriod)"!][!"EthGeneral/EthMainFunctionPeriod"!][!ELSE!]0[!ENDIF!]</PERIOD>
                    </BSW-TIMING-EVENT>
                  </EVENTS>
                </BSW-INTERNAL-BEHAVIOR>
              </INTERNAL-BEHAVIORS>
            </BSW-MODULE-DESCRIPTION>
          </ELEMENTS>
        </AR-PACKAGE>
