AUTOSAR XML (schema 00046)
package /AUTOSAR_Fr_43_LLCE/BswModuleDescriptions
  bsw module description Fr: module-id=81
    provided-entrys:
      Flexray_43_LLCE_Ip_SetBasicDynamicTxFrame
      Fr_AbortCommunication
      Fr_AckAbsoluteTimerIRQ
      Fr_AllSlots
      Fr_AllowColdstart
      Fr_CancelAbsoluteTimer
      Fr_CancelTxLPdu
      Fr_CheckTxLPduStatus
      Fr_ControllerInit
      Fr_DeInit
      Fr_DisableAbsoluteTimerIRQ
      Fr_DisableLPdu
      Fr_EnableAbsoluteTimerIRQ
      Fr_GetAbsoluteTimerIRQStatus
      Fr_GetChannelStatus
      Fr_GetClockCorrection
      Fr_GetGlobalTime
      Fr_GetNmVector
      Fr_GetNumOfStartupFrames
      Fr_GetPOCStatus
      Fr_GetSyncFrameList
      Fr_GetVersionInfo
      Fr_GetWakeupRxStatus
      Fr_HaltCommunication
      Fr_Init
      Fr_PrepareLPdu
      Fr_ReadCCConfig
      Fr_ReceiveRxLPdu
      Fr_ReconfigLPdu
      Fr_SendWUP
      Fr_SetAbsoluteTimer
      Fr_SetWakeupChannel
      Fr_StartCommunication
      Fr_TransmitTxLPdu
      FLEXRAY0_CERR_IRQHandler
      FLEXRAY0_CH0_RX_FIFO_IRQHandler
      FLEXRAY0_CH1_RX_FIFO_IRQHandler
      FLEXRAY0_RX_BUFF_IRQHandler
      FLEXRAY0_STATUS_IRQHandler
      FLEXRAY0_TX_BUFF_IRQHandler
      FLEXRAY0_WKUP_IRQHandler
      FLEXRAY1_CERR_IRQHandler
      FLEXRAY1_CH0_RX_FIFO_IRQHandler
      FLEXRAY1_CH1_RX_FIFO_IRQHandler
      FLEXRAY1_RX_BUFF_IRQHandler
      FLEXRAY1_STATUS_IRQHandler
      FLEXRAY1_TX_BUFF_IRQHandler
      FLEXRAY1_WKUP_IRQHandler
      Flexray_Llce_Frpe_IRQHandler
    bsw internal behavior InternalBehavior_0
      15 x exclusive area:
        FR_EXCLUSIVE_AREA_{00..14}
      34 x bsw called entity:
        Flexray_43_LLCE_Ip_SetBasicDynamicTxFrame: can-enter-exclusive-area=FR_EXCLUSIVE_AREA_12, implemented-entry=Flexray_43_LLCE_Ip_SetBasicDynamicTxFrame
        Fr_43_LLCE_AbortCommunication: implemented-entry=Fr_AbortCommunication
        Fr_43_LLCE_AckAbsoluteTimerIRQ: implemented-entry=Fr_AckAbsoluteTimerIRQ
        Fr_43_LLCE_AllSlots: implemented-entry=Fr_AllSlots
        Fr_43_LLCE_AllowColdstart: implemented-entry=Fr_AllowColdstart
        Fr_43_LLCE_CancelAbsoluteTimer: can-enter-exclusive-area=FR_EXCLUSIVE_AREA_02, implemented-entry=Fr_CancelAbsoluteTimer
        Fr_43_LLCE_CancelTxLPdu: can-enter-exclusive-area=FR_EXCLUSIVE_AREA_11, implemented-entry=Fr_CancelTxLPdu
        Fr_43_LLCE_CheckTxLPduStatus: implemented-entry=Fr_CheckTxLPduStatus
        Fr_43_LLCE_ControllerInit: can-enter-exclusive-area=[FR_EXCLUSIVE_AREA_02, FR_EXCLUSIVE_AREA_06, FR_EXCLUSIVE_AREA_14], implemented-entry=Fr_ControllerInit
        Fr_43_LLCE_DeInit: can-enter-exclusive-area=FR_EXCLUSIVE_AREA_05, implemented-entry=Fr_DeInit
        Fr_43_LLCE_DisableAbsoluteTimerIRQ: can-enter-exclusive-area=FR_EXCLUSIVE_AREA_03, implemented-entry=Fr_DisableAbsoluteTimerIRQ
        Fr_43_LLCE_DisableLPdu: can-enter-exclusive-area=FR_EXCLUSIVE_AREA_10, implemented-entry=Fr_DisableLPdu
        Fr_43_LLCE_EnableAbsoluteTimerIRQ: can-enter-exclusive-area=[FR_EXCLUSIVE_AREA_03, FR_EXCLUSIVE_AREA_04], implemented-entry=Fr_EnableAbsoluteTimerIRQ
        Fr_43_LLCE_GetAbsoluteTimerIRQStatus: implemented-entry=Fr_GetAbsoluteTimerIRQStatus
        Fr_43_LLCE_GetChannelStatus: implemented-entry=Fr_GetChannelStatus
        Fr_43_LLCE_GetClockCorrection: implemented-entry=Fr_GetClockCorrection
        Fr_43_LLCE_GetGlobalTime: implemented-entry=Fr_GetGlobalTime
        Fr_43_LLCE_GetNmVector: implemented-entry=Fr_GetNmVector
        Fr_43_LLCE_GetNumOfStartupFrames: implemented-entry=Fr_GetNumOfStartupFrames
        Fr_43_LLCE_GetPOCStatus: implemented-entry=Fr_GetPOCStatus
        Fr_43_LLCE_GetSyncFrameList: implemented-entry=Fr_GetSyncFrameList
        Fr_43_LLCE_GetVersionInfo: implemented-entry=Fr_GetVersionInfo
        Fr_43_LLCE_GetWakeupRxStatus: implemented-entry=Fr_GetWakeupRxStatus
        Fr_43_LLCE_HaltCommunication: implemented-entry=Fr_HaltCommunication
        Fr_43_LLCE_Init: implemented-entry=Fr_Init
        Fr_43_LLCE_PrepareLPdu: can-enter-exclusive-area=FR_EXCLUSIVE_AREA_13, implemented-entry=Fr_PrepareLPdu
        Fr_43_LLCE_ReadCCConfig: implemented-entry=Fr_ReadCCConfig
        Fr_43_LLCE_ReceiveRxLPdu: can-enter-exclusive-area=[FR_EXCLUSIVE_AREA_07, FR_EXCLUSIVE_AREA_08], implemented-entry=Fr_ReceiveRxLPdu
        Fr_43_LLCE_ReconfigLPdu: can-enter-exclusive-area=FR_EXCLUSIVE_AREA_13, implemented-entry=Fr_ReconfigLPdu
        Fr_43_LLCE_SendWUP: implemented-entry=Fr_SendWUP
        Fr_43_LLCE_SetAbsoluteTimer: can-enter-exclusive-area=[FR_EXCLUSIVE_AREA_00, FR_EXCLUSIVE_AREA_01, FR_EXCLUSIVE_AREA_02], implemented-entry=Fr_SetAbsoluteTimer
        Fr_43_LLCE_SetWakeupChannel: implemented-entry=Fr_SetWakeupChannel
        Fr_43_LLCE_StartCommunication: implemented-entry=Fr_StartCommunication
        Fr_43_LLCE_TransmitTxLPdu: can-enter-exclusive-area=FR_EXCLUSIVE_AREA_09, implemented-entry=Fr_TransmitTxLPdu
      15 x bsw interrupt entity, all with interrupt-category=CAT-2, interrupt-source=Hardware:
        FLEXRAY0_CERR_IRQHandler: implemented-entry=FLEXRAY0_CERR_IRQHandler
        FLEXRAY0_CH0_RX_FIFO_IRQHandler: implemented-entry=FLEXRAY0_CH0_RX_FIFO_IRQHandler
        FLEXRAY0_CH1_RX_FIFO_IRQHandler: implemented-entry=FLEXRAY0_CH1_RX_FIFO_IRQHandler
        FLEXRAY0_RX_BUFF_IRQHandler: implemented-entry=FLEXRAY0_RX_BUFF_IRQHandler
        FLEXRAY0_STATUS_IRQHandler: implemented-entry=FLEXRAY0_STATUS_IRQHandler
        FLEXRAY0_TX_BUFF_IRQHandler: implemented-entry=FLEXRAY0_TX_BUFF_IRQHandler
        FLEXRAY0_WKUP_IRQHandler: implemented-entry=FLEXRAY0_WKUP_IRQHandler
        FLEXRAY1_CERR_IRQHandler: implemented-entry=FLEXRAY1_CERR_IRQHandler
        FLEXRAY1_CH0_RX_FIFO_IRQHandler: implemented-entry=FLEXRAY1_CH0_RX_FIFO_IRQHandler
        FLEXRAY1_CH1_RX_FIFO_IRQHandler: implemented-entry=FLEXRAY1_CH1_RX_FIFO_IRQHandler
        FLEXRAY1_RX_BUFF_IRQHandler: implemented-entry=FLEXRAY1_RX_BUFF_IRQHandler
        FLEXRAY1_STATUS_IRQHandler: implemented-entry=FLEXRAY1_STATUS_IRQHandler
        FLEXRAY1_TX_BUFF_IRQHandler: implemented-entry=FLEXRAY1_TX_BUFF_IRQHandler
        FLEXRAY1_WKUP_IRQHandler: implemented-entry=FLEXRAY1_WKUP_IRQHandler
        Flexray_Llce_Frpe_IRQHandler: implemented-entry=Flexray_Llce_Frpe_IRQHandler
package /AUTOSAR_Fr_43_LLCE/BswModuleEntrys
  49 x bsw module entry, all with sw-service-impl-policy=STANDARD:
    Flexray_43_LLCE_Ip_SetBasicDynamicTxFrame: service-id=0x100, is-reentrant=false, is-synchronous=false, call-type=REGULAR, execution-context=UNSPECIFIED
    Fr_AbortCommunication: service-id=0x05, is-reentrant=false, is-synchronous=true, call-type=REGULAR, execution-context=UNSPECIFIED
    Fr_AckAbsoluteTimerIRQ: service-id=0x17, is-reentrant=false, is-synchronous=true, call-type=REGULAR, execution-context=UNSPECIFIED
    Fr_AllSlots: service-id=0x24, is-reentrant=false, is-synchronous=false, call-type=REGULAR, execution-context=UNSPECIFIED
    Fr_AllowColdstart: service-id=0x23, is-reentrant=false, is-synchronous=false, call-type=REGULAR, execution-context=UNSPECIFIED
    Fr_CancelAbsoluteTimer: service-id=0x13, is-reentrant=false, is-synchronous=true, call-type=REGULAR, execution-context=UNSPECIFIED
    Fr_CancelTxLPdu: service-id=0x2d, is-reentrant=false, is-synchronous=true, call-type=REGULAR, execution-context=UNSPECIFIED
    Fr_CheckTxLPduStatus: service-id=0x0d, is-reentrant=false, is-synchronous=true, call-type=REGULAR, execution-context=UNSPECIFIED
    Fr_ControllerInit: service-id=0x00, is-reentrant=false, is-synchronous=true, call-type=REGULAR, execution-context=UNSPECIFIED
    Fr_DeInit: service-id=0x2f, is-reentrant=false, is-synchronous=false, call-type=REGULAR, execution-context=UNSPECIFIED
    Fr_DisableAbsoluteTimerIRQ: service-id=0x19, is-reentrant=false, is-synchronous=true, call-type=REGULAR, execution-context=UNSPECIFIED
    Fr_DisableLPdu: service-id=0x26, is-reentrant=false, is-synchronous=true, call-type=REGULAR, execution-context=UNSPECIFIED
    Fr_EnableAbsoluteTimerIRQ: service-id=0x15, is-reentrant=false, is-synchronous=true, call-type=REGULAR, execution-context=UNSPECIFIED
    Fr_GetAbsoluteTimerIRQStatus: service-id=0x20, is-reentrant=false, is-synchronous=true, call-type=REGULAR, execution-context=UNSPECIFIED
    Fr_GetChannelStatus: service-id=0x28, is-reentrant=false, is-synchronous=true, call-type=REGULAR, execution-context=UNSPECIFIED
    Fr_GetClockCorrection: service-id=0x29, is-reentrant=false, is-synchronous=true, call-type=REGULAR, execution-context=UNSPECIFIED
    Fr_GetGlobalTime: service-id=0x10, is-reentrant=false, is-synchronous=true, call-type=REGULAR, execution-context=UNSPECIFIED
    Fr_GetNmVector: service-id=0x22, is-reentrant=false, is-synchronous=true, call-type=REGULAR, execution-context=UNSPECIFIED
    Fr_GetNumOfStartupFrames: service-id=0x27, is-reentrant=false, is-synchronous=true, call-type=REGULAR, execution-context=UNSPECIFIED
    Fr_GetPOCStatus: service-id=0x0a, is-reentrant=false, is-synchronous=true, call-type=REGULAR, execution-context=UNSPECIFIED
    Fr_GetSyncFrameList: service-id=0x2a, is-reentrant=false, is-synchronous=true, call-type=REGULAR, execution-context=UNSPECIFIED
    Fr_GetVersionInfo: service-id=0x1b, is-reentrant=true, is-synchronous=true, call-type=REGULAR, execution-context=UNSPECIFIED
    Fr_GetWakeupRxStatus: service-id=0x2b, is-reentrant=false, is-synchronous=true, call-type=REGULAR, execution-context=UNSPECIFIED
    Fr_HaltCommunication: service-id=0x04, is-reentrant=false, is-synchronous=false, call-type=REGULAR, execution-context=UNSPECIFIED
    Fr_Init: service-id=0x1c, is-reentrant=false, is-synchronous=true, call-type=REGULAR, execution-context=UNSPECIFIED
    Fr_PrepareLPdu: service-id=0x1f, is-reentrant=false, is-synchronous=true, call-type=REGULAR, execution-context=UNSPECIFIED
    Fr_ReadCCConfig: service-id=0x2e, is-reentrant=false, is-synchronous=true, call-type=REGULAR, execution-context=UNSPECIFIED
    Fr_ReceiveRxLPdu: service-id=0x0c, is-reentrant=false, is-synchronous=true, call-type=REGULAR, execution-context=UNSPECIFIED
    Fr_ReconfigLPdu: service-id=0x25, is-reentrant=false, is-synchronous=true, call-type=REGULAR, execution-context=UNSPECIFIED
    Fr_SendWUP: service-id=0x06, is-reentrant=false, is-synchronous=false, call-type=REGULAR, execution-context=UNSPECIFIED
    Fr_SetAbsoluteTimer: service-id=0x11, is-reentrant=false, is-synchronous=true, call-type=REGULAR, execution-context=UNSPECIFIED
    Fr_SetWakeupChannel: service-id=0x07, is-reentrant=false, is-synchronous=true, call-type=REGULAR, execution-context=UNSPECIFIED
    Fr_StartCommunication: service-id=0x03, is-reentrant=false, is-synchronous=false, call-type=REGULAR, execution-context=UNSPECIFIED
    Fr_TransmitTxLPdu: service-id=0x0b, is-reentrant=false, is-synchronous=false, call-type=REGULAR, execution-context=UNSPECIFIED
    FLEXRAY0_CERR_IRQHandler: service-id=0, is-reentrant=false, is-synchronous=true, call-type=INTERRUPT, execution-context=INTERRUPT-CAT-2
    FLEXRAY0_CH0_RX_FIFO_IRQHandler: service-id=0, is-reentrant=false, is-synchronous=true, call-type=INTERRUPT, execution-context=INTERRUPT-CAT-2
    FLEXRAY0_CH1_RX_FIFO_IRQHandler: service-id=0, is-reentrant=false, is-synchronous=true, call-type=INTERRUPT, execution-context=INTERRUPT-CAT-2
    FLEXRAY0_RX_BUFF_IRQHandler: service-id=0, is-reentrant=false, is-synchronous=true, call-type=INTERRUPT, execution-context=INTERRUPT-CAT-2
    FLEXRAY0_STATUS_IRQHandler: service-id=0, is-reentrant=false, is-synchronous=true, call-type=INTERRUPT, execution-context=INTERRUPT-CAT-2
    FLEXRAY0_TX_BUFF_IRQHandler: service-id=0, is-reentrant=false, is-synchronous=true, call-type=INTERRUPT, execution-context=INTERRUPT-CAT-2
    FLEXRAY0_WKUP_IRQHandler: service-id=0, is-reentrant=false, is-synchronous=true, call-type=INTERRUPT, execution-context=INTERRUPT-CAT-2
    FLEXRAY1_CERR_IRQHandler: service-id=0, is-reentrant=false, is-synchronous=true, call-type=INTERRUPT, execution-context=INTERRUPT-CAT-2
    FLEXRAY1_CH0_RX_FIFO_IRQHandler: service-id=0, is-reentrant=false, is-synchronous=true, call-type=INTERRUPT, execution-context=INTERRUPT-CAT-2
    FLEXRAY1_CH1_RX_FIFO_IRQHandler: service-id=0, is-reentrant=false, is-synchronous=true, call-type=INTERRUPT, execution-context=INTERRUPT-CAT-2
    FLEXRAY1_RX_BUFF_IRQHandler: service-id=0, is-reentrant=false, is-synchronous=true, call-type=INTERRUPT, execution-context=INTERRUPT-CAT-2
    FLEXRAY1_STATUS_IRQHandler: service-id=0, is-reentrant=false, is-synchronous=true, call-type=INTERRUPT, execution-context=INTERRUPT-CAT-2
    FLEXRAY1_TX_BUFF_IRQHandler: service-id=0, is-reentrant=false, is-synchronous=true, call-type=INTERRUPT, execution-context=INTERRUPT-CAT-2
    FLEXRAY1_WKUP_IRQHandler: service-id=0, is-reentrant=false, is-synchronous=true, call-type=INTERRUPT, execution-context=INTERRUPT-CAT-2
    Flexray_Llce_Frpe_IRQHandler: service-id=0, is-reentrant=false, is-synchronous=true, call-type=INTERRUPT, execution-context=INTERRUPT-CAT-2
package /Fr_43_LLCE_TS_T40D11M10I7R0/Implementations
  bsw implementation BswImplementation_0: programming-language=C, sw-version=1.0.7, vendor-id=43, ar-release-version=4.4.0, behavior=InternalBehavior_0, vendor-api-infix=LLCE, vendor-specific-module-def=Fr
    code-descriptors:
      code Files
        artifact-descriptors:
          short-label=config::Fr_43_LLCE.xdm, category=SWCFG
          short-label=doc::RTD_FR_LLCE_IM.pdf, category=SWDOC
          short-label=doc::RTD_FR_LLCE_UM.pdf, category=SWDOC
          short-label=EB::Fr.xdm, category=SWCFG
          short-label=examples::EBT::S32G2::FR_ExternalCommunication_node1_S32G274A_M7::generate::epc::BaseNXP.xdm, category=SWCFG
          short-label=examples::EBT::S32G2::FR_ExternalCommunication_node1_S32G274A_M7::generate::epc::Dem.xdm, category=SWCFG
          short-label=examples::EBT::S32G2::FR_ExternalCommunication_node1_S32G274A_M7::generate::epc::FrIf.xdm, category=SWCFG
          short-label=examples::EBT::S32G2::FR_ExternalCommunication_node1_S32G274A_M7::generate::epc::Fr_43_LLCE.xdm, category=SWCFG
          short-label=examples::EBT::S32G2::FR_ExternalCommunication_node1_S32G274A_M7::generate::epc::Mcu.xdm, category=SWCFG
          short-label=examples::EBT::S32G2::FR_ExternalCommunication_node1_S32G274A_M7::generate::epc::Platform.xdm, category=SWCFG
          short-label=examples::EBT::S32G2::FR_ExternalCommunication_node1_S32G274A_M7::generate::epc::Port.xdm, category=SWCFG
          short-label=examples::EBT::S32G2::FR_ExternalCommunication_node1_S32G274A_M7::generate::epc::Resource.xdm, category=SWCFG
          short-label=examples::EBT::S32G2::FR_ExternalCommunication_node1_S32G274A_M7::include::check_example.h, category=SWHDR
          short-label=examples::EBT::S32G2::FR_ExternalCommunication_node1_S32G274A_M7::include::Llce_Firmware_Load.h, category=SWHDR
          short-label=examples::EBT::S32G2::FR_ExternalCommunication_node1_S32G274A_M7::src::Llce_Firmware_Load.c, category=SWSRC
          short-label=examples::EBT::S32G2::FR_ExternalCommunication_node1_S32G274A_M7::src::main.c, category=SWSRC
          short-label=examples::EBT::S32G2::FR_ExternalCommunication_node1_S32G274A_M7::TresosProject::FR_ExternalCommunication_node1_S32G274A_M7::.prefs::preferences.xdm, category=SWCFG
          short-label=examples::EBT::S32G2::FR_ExternalCommunication_node1_S32G274A_M7::TresosProject::FR_ExternalCommunication_node1_S32G274A_M7::config::BaseNXP.xdm, category=SWCFG
          short-label=examples::EBT::S32G2::FR_ExternalCommunication_node1_S32G274A_M7::TresosProject::FR_ExternalCommunication_node1_S32G274A_M7::config::Dem.xdm, category=SWCFG
          short-label=examples::EBT::S32G2::FR_ExternalCommunication_node1_S32G274A_M7::TresosProject::FR_ExternalCommunication_node1_S32G274A_M7::config::EcuC.xdm, category=SWCFG
          short-label=examples::EBT::S32G2::FR_ExternalCommunication_node1_S32G274A_M7::TresosProject::FR_ExternalCommunication_node1_S32G274A_M7::config::FrIf.xdm, category=SWCFG
          short-label=examples::EBT::S32G2::FR_ExternalCommunication_node1_S32G274A_M7::TresosProject::FR_ExternalCommunication_node1_S32G274A_M7::config::Fr_43_LLCE.xdm, category=SWCFG
          short-label=examples::EBT::S32G2::FR_ExternalCommunication_node1_S32G274A_M7::TresosProject::FR_ExternalCommunication_node1_S32G274A_M7::config::Mcu.xdm, category=SWCFG
          short-label=examples::EBT::S32G2::FR_ExternalCommunication_node1_S32G274A_M7::TresosProject::FR_ExternalCommunication_node1_S32G274A_M7::config::Platform.xdm, category=SWCFG
          short-label=examples::EBT::S32G2::FR_ExternalCommunication_node1_S32G274A_M7::TresosProject::FR_ExternalCommunication_node1_S32G274A_M7::config::Port.xdm, category=SWCFG
          short-label=examples::EBT::S32G2::FR_ExternalCommunication_node1_S32G274A_M7::TresosProject::FR_ExternalCommunication_node1_S32G274A_M7::config::Resource.xdm, category=SWCFG
          short-label=examples::EBT::S32G2::FR_ExternalCommunication_node2_S32G274A_M7::generate::epc::BaseNXP.xdm, category=SWCFG
          short-label=examples::EBT::S32G2::FR_ExternalCommunication_node2_S32G274A_M7::generate::epc::Dem.xdm, category=SWCFG
          short-label=examples::EBT::S32G2::FR_ExternalCommunication_node2_S32G274A_M7::generate::epc::FrIf.xdm, category=SWCFG
          short-label=examples::EBT::S32G2::FR_ExternalCommunication_node2_S32G274A_M7::generate::epc::Fr_43_LLCE.xdm, category=SWCFG
          short-label=examples::EBT::S32G2::FR_ExternalCommunication_node2_S32G274A_M7::generate::epc::Mcu.xdm, category=SWCFG
          short-label=examples::EBT::S32G2::FR_ExternalCommunication_node2_S32G274A_M7::generate::epc::Platform.xdm, category=SWCFG
          short-label=examples::EBT::S32G2::FR_ExternalCommunication_node2_S32G274A_M7::generate::epc::Port.xdm, category=SWCFG
          short-label=examples::EBT::S32G2::FR_ExternalCommunication_node2_S32G274A_M7::generate::epc::Resource.xdm, category=SWCFG
          short-label=examples::EBT::S32G2::FR_ExternalCommunication_node2_S32G274A_M7::include::check_example.h, category=SWHDR
          short-label=examples::EBT::S32G2::FR_ExternalCommunication_node2_S32G274A_M7::include::Llce_Firmware_Load.h, category=SWHDR
          short-label=examples::EBT::S32G2::FR_ExternalCommunication_node2_S32G274A_M7::src::Llce_Firmware_Load.c, category=SWSRC
          short-label=examples::EBT::S32G2::FR_ExternalCommunication_node2_S32G274A_M7::src::main.c, category=SWSRC
          short-label=examples::EBT::S32G2::FR_ExternalCommunication_node2_S32G274A_M7::TresosProject::FR_ExternalCommunication_node2_S32G274A_M7::.prefs::preferences.xdm, category=SWCFG
          short-label=examples::EBT::S32G2::FR_ExternalCommunication_node2_S32G274A_M7::TresosProject::FR_ExternalCommunication_node2_S32G274A_M7::config::BaseNXP.xdm, category=SWCFG
          short-label=examples::EBT::S32G2::FR_ExternalCommunication_node2_S32G274A_M7::TresosProject::FR_ExternalCommunication_node2_S32G274A_M7::config::Dem.xdm, category=SWCFG
          short-label=examples::EBT::S32G2::FR_ExternalCommunication_node2_S32G274A_M7::TresosProject::FR_ExternalCommunication_node2_S32G274A_M7::config::EcuC.xdm, category=SWCFG
          short-label=examples::EBT::S32G2::FR_ExternalCommunication_node2_S32G274A_M7::TresosProject::FR_ExternalCommunication_node2_S32G274A_M7::config::FrIf.xdm, category=SWCFG
          short-label=examples::EBT::S32G2::FR_ExternalCommunication_node2_S32G274A_M7::TresosProject::FR_ExternalCommunication_node2_S32G274A_M7::config::Fr_43_LLCE.xdm, category=SWCFG
          short-label=examples::EBT::S32G2::FR_ExternalCommunication_node2_S32G274A_M7::TresosProject::FR_ExternalCommunication_node2_S32G274A_M7::config::Mcu.xdm, category=SWCFG
          short-label=examples::EBT::S32G2::FR_ExternalCommunication_node2_S32G274A_M7::TresosProject::FR_ExternalCommunication_node2_S32G274A_M7::config::Platform.xdm, category=SWCFG
          short-label=examples::EBT::S32G2::FR_ExternalCommunication_node2_S32G274A_M7::TresosProject::FR_ExternalCommunication_node2_S32G274A_M7::config::Port.xdm, category=SWCFG
          short-label=examples::EBT::S32G2::FR_ExternalCommunication_node2_S32G274A_M7::TresosProject::FR_ExternalCommunication_node2_S32G274A_M7::config::Resource.xdm, category=SWCFG
          short-label=examples::EBT::S32G3::FR_ExternalCommunication_node1_S32G399A_M7::generate::epc::BaseNXP.xdm, category=SWCFG
          short-label=examples::EBT::S32G3::FR_ExternalCommunication_node1_S32G399A_M7::generate::epc::Dem.xdm, category=SWCFG
          short-label=examples::EBT::S32G3::FR_ExternalCommunication_node1_S32G399A_M7::generate::epc::FrIf.xdm, category=SWCFG
          short-label=examples::EBT::S32G3::FR_ExternalCommunication_node1_S32G399A_M7::generate::epc::Fr_43_LLCE.xdm, category=SWCFG
          short-label=examples::EBT::S32G3::FR_ExternalCommunication_node1_S32G399A_M7::generate::epc::Mcu.xdm, category=SWCFG
          short-label=examples::EBT::S32G3::FR_ExternalCommunication_node1_S32G399A_M7::generate::epc::Platform.xdm, category=SWCFG
          short-label=examples::EBT::S32G3::FR_ExternalCommunication_node1_S32G399A_M7::generate::epc::Port.xdm, category=SWCFG
          short-label=examples::EBT::S32G3::FR_ExternalCommunication_node1_S32G399A_M7::generate::epc::Resource.xdm, category=SWCFG
          short-label=examples::EBT::S32G3::FR_ExternalCommunication_node1_S32G399A_M7::include::check_example.h, category=SWHDR
          short-label=examples::EBT::S32G3::FR_ExternalCommunication_node1_S32G399A_M7::include::Llce_Firmware_Load.h, category=SWHDR
          short-label=examples::EBT::S32G3::FR_ExternalCommunication_node1_S32G399A_M7::src::Llce_Firmware_Load.c, category=SWSRC
          short-label=examples::EBT::S32G3::FR_ExternalCommunication_node1_S32G399A_M7::src::main.c, category=SWSRC
          short-label=examples::EBT::S32G3::FR_ExternalCommunication_node1_S32G399A_M7::TresosProject::FR_ExternalCommunication_node1_S32G399A_M7::.prefs::preferences.xdm, category=SWCFG
          short-label=examples::EBT::S32G3::FR_ExternalCommunication_node1_S32G399A_M7::TresosProject::FR_ExternalCommunication_node1_S32G399A_M7::config::BaseNXP.xdm, category=SWCFG
          short-label=examples::EBT::S32G3::FR_ExternalCommunication_node1_S32G399A_M7::TresosProject::FR_ExternalCommunication_node1_S32G399A_M7::config::Dem.xdm, category=SWCFG
          short-label=examples::EBT::S32G3::FR_ExternalCommunication_node1_S32G399A_M7::TresosProject::FR_ExternalCommunication_node1_S32G399A_M7::config::EcuC.xdm, category=SWCFG
          short-label=examples::EBT::S32G3::FR_ExternalCommunication_node1_S32G399A_M7::TresosProject::FR_ExternalCommunication_node1_S32G399A_M7::config::FrIf.xdm, category=SWCFG
          short-label=examples::EBT::S32G3::FR_ExternalCommunication_node1_S32G399A_M7::TresosProject::FR_ExternalCommunication_node1_S32G399A_M7::config::Fr_43_LLCE.xdm, category=SWCFG
          short-label=examples::EBT::S32G3::FR_ExternalCommunication_node1_S32G399A_M7::TresosProject::FR_ExternalCommunication_node1_S32G399A_M7::config::Mcu.xdm, category=SWCFG
          short-label=examples::EBT::S32G3::FR_ExternalCommunication_node1_S32G399A_M7::TresosProject::FR_ExternalCommunication_node1_S32G399A_M7::config::Platform.xdm, category=SWCFG
          short-label=examples::EBT::S32G3::FR_ExternalCommunication_node1_S32G399A_M7::TresosProject::FR_ExternalCommunication_node1_S32G399A_M7::config::Port.xdm, category=SWCFG
          short-label=examples::EBT::S32G3::FR_ExternalCommunication_node1_S32G399A_M7::TresosProject::FR_ExternalCommunication_node1_S32G399A_M7::config::Resource.xdm, category=SWCFG
          short-label=examples::EBT::S32G3::FR_ExternalCommunication_node2_S32G399A_M7::generate::epc::BaseNXP.xdm, category=SWCFG
          short-label=examples::EBT::S32G3::FR_ExternalCommunication_node2_S32G399A_M7::generate::epc::Dem.xdm, category=SWCFG
          short-label=examples::EBT::S32G3::FR_ExternalCommunication_node2_S32G399A_M7::generate::epc::FrIf.xdm, category=SWCFG
          short-label=examples::EBT::S32G3::FR_ExternalCommunication_node2_S32G399A_M7::generate::epc::Fr_43_LLCE.xdm, category=SWCFG
          short-label=examples::EBT::S32G3::FR_ExternalCommunication_node2_S32G399A_M7::generate::epc::Mcu.xdm, category=SWCFG
          short-label=examples::EBT::S32G3::FR_ExternalCommunication_node2_S32G399A_M7::generate::epc::Platform.xdm, category=SWCFG
          short-label=examples::EBT::S32G3::FR_ExternalCommunication_node2_S32G399A_M7::generate::epc::Port.xdm, category=SWCFG
          short-label=examples::EBT::S32G3::FR_ExternalCommunication_node2_S32G399A_M7::generate::epc::Resource.xdm, category=SWCFG
          short-label=examples::EBT::S32G3::FR_ExternalCommunication_node2_S32G399A_M7::include::check_example.h, category=SWHDR
          short-label=examples::EBT::S32G3::FR_ExternalCommunication_node2_S32G399A_M7::include::Llce_Firmware_Load.h, category=SWHDR
          short-label=examples::EBT::S32G3::FR_ExternalCommunication_node2_S32G399A_M7::src::Llce_Firmware_Load.c, category=SWSRC
          short-label=examples::EBT::S32G3::FR_ExternalCommunication_node2_S32G399A_M7::src::main.c, category=SWSRC
          short-label=examples::EBT::S32G3::FR_ExternalCommunication_node2_S32G399A_M7::TresosProject::FR_ExternalCommunication_node2_S32G399A_M7::.prefs::preferences.xdm, category=SWCFG
          short-label=examples::EBT::S32G3::FR_ExternalCommunication_node2_S32G399A_M7::TresosProject::FR_ExternalCommunication_node2_S32G399A_M7::config::BaseNXP.xdm, category=SWCFG
          short-label=examples::EBT::S32G3::FR_ExternalCommunication_node2_S32G399A_M7::TresosProject::FR_ExternalCommunication_node2_S32G399A_M7::config::Dem.xdm, category=SWCFG
          short-label=examples::EBT::S32G3::FR_ExternalCommunication_node2_S32G399A_M7::TresosProject::FR_ExternalCommunication_node2_S32G399A_M7::config::EcuC.xdm, category=SWCFG
          short-label=examples::EBT::S32G3::FR_ExternalCommunication_node2_S32G399A_M7::TresosProject::FR_ExternalCommunication_node2_S32G399A_M7::config::FrIf.xdm, category=SWCFG
          short-label=examples::EBT::S32G3::FR_ExternalCommunication_node2_S32G399A_M7::TresosProject::FR_ExternalCommunication_node2_S32G399A_M7::config::Fr_43_LLCE.xdm, category=SWCFG
          short-label=examples::EBT::S32G3::FR_ExternalCommunication_node2_S32G399A_M7::TresosProject::FR_ExternalCommunication_node2_S32G399A_M7::config::Mcu.xdm, category=SWCFG
          short-label=examples::EBT::S32G3::FR_ExternalCommunication_node2_S32G399A_M7::TresosProject::FR_ExternalCommunication_node2_S32G399A_M7::config::Platform.xdm, category=SWCFG
          short-label=examples::EBT::S32G3::FR_ExternalCommunication_node2_S32G399A_M7::TresosProject::FR_ExternalCommunication_node2_S32G399A_M7::config::Port.xdm, category=SWCFG
          short-label=examples::EBT::S32G3::FR_ExternalCommunication_node2_S32G399A_M7::TresosProject::FR_ExternalCommunication_node2_S32G399A_M7::config::Resource.xdm, category=SWCFG
          short-label=examples::S32DS::S32G2::FR_ExternalCommunication_node1_S32G274A_M7::include::check_example.h, category=SWHDR
          short-label=examples::S32DS::S32G2::FR_ExternalCommunication_node1_S32G274A_M7::include::Llce_Firmware_Load.h, category=SWHDR
          short-label=examples::S32DS::S32G2::FR_ExternalCommunication_node1_S32G274A_M7::Project_Settings::Startup_Code::exceptions.c, category=SWSRC
          short-label=examples::S32DS::S32G2::FR_ExternalCommunication_node1_S32G274A_M7::Project_Settings::Startup_Code::nvic.c, category=SWSRC
          short-label=examples::S32DS::S32G2::FR_ExternalCommunication_node1_S32G274A_M7::Project_Settings::Startup_Code::startup.c, category=SWSRC
          short-label=examples::S32DS::S32G2::FR_ExternalCommunication_node1_S32G274A_M7::Project_Settings::Startup_Code::system.c, category=SWSRC
          short-label=examples::S32DS::S32G2::FR_ExternalCommunication_node1_S32G274A_M7::src::Llce_Firmware_Load.c, category=SWSRC
          short-label=examples::S32DS::S32G2::FR_ExternalCommunication_node1_S32G274A_M7::src::main.c, category=SWSRC
          short-label=examples::S32DS::S32G2::FR_ExternalCommunication_node2_S32G274A_M7::include::check_example.h, category=SWHDR
          short-label=examples::S32DS::S32G2::FR_ExternalCommunication_node2_S32G274A_M7::include::Llce_Firmware_Load.h, category=SWHDR
          short-label=examples::S32DS::S32G2::FR_ExternalCommunication_node2_S32G274A_M7::Project_Settings::Startup_Code::exceptions.c, category=SWSRC
          short-label=examples::S32DS::S32G2::FR_ExternalCommunication_node2_S32G274A_M7::Project_Settings::Startup_Code::nvic.c, category=SWSRC
          short-label=examples::S32DS::S32G2::FR_ExternalCommunication_node2_S32G274A_M7::Project_Settings::Startup_Code::startup.c, category=SWSRC
          short-label=examples::S32DS::S32G2::FR_ExternalCommunication_node2_S32G274A_M7::Project_Settings::Startup_Code::system.c, category=SWSRC
          short-label=examples::S32DS::S32G2::FR_ExternalCommunication_node2_S32G274A_M7::src::Llce_Firmware_Load.c, category=SWSRC
          short-label=examples::S32DS::S32G2::FR_ExternalCommunication_node2_S32G274A_M7::src::main.c, category=SWSRC
          short-label=examples::S32DS::S32G3::FR_ExternalCommunication_node1_S32G399A_M7::include::check_example.h, category=SWHDR
          short-label=examples::S32DS::S32G3::FR_ExternalCommunication_node1_S32G399A_M7::include::Llce_Firmware_Load.h, category=SWHDR
          short-label=examples::S32DS::S32G3::FR_ExternalCommunication_node1_S32G399A_M7::Project_Settings::Startup_Code::exceptions.c, category=SWSRC
          short-label=examples::S32DS::S32G3::FR_ExternalCommunication_node1_S32G399A_M7::Project_Settings::Startup_Code::nvic.c, category=SWSRC
          short-label=examples::S32DS::S32G3::FR_ExternalCommunication_node1_S32G399A_M7::Project_Settings::Startup_Code::startup.c, category=SWSRC
          short-label=examples::S32DS::S32G3::FR_ExternalCommunication_node1_S32G399A_M7::Project_Settings::Startup_Code::system.c, category=SWSRC
          short-label=examples::S32DS::S32G3::FR_ExternalCommunication_node1_S32G399A_M7::src::Llce_Firmware_Load.c, category=SWSRC
          short-label=examples::S32DS::S32G3::FR_ExternalCommunication_node1_S32G399A_M7::src::main.c, category=SWSRC
          short-label=examples::S32DS::S32G3::FR_ExternalCommunication_node2_S32G399A_M7::include::check_example.h, category=SWHDR
          short-label=examples::S32DS::S32G3::FR_ExternalCommunication_node2_S32G399A_M7::include::Llce_Firmware_Load.h, category=SWHDR
          short-label=examples::S32DS::S32G3::FR_ExternalCommunication_node2_S32G399A_M7::Project_Settings::Startup_Code::exceptions.c, category=SWSRC
          short-label=examples::S32DS::S32G3::FR_ExternalCommunication_node2_S32G399A_M7::Project_Settings::Startup_Code::nvic.c, category=SWSRC
          short-label=examples::S32DS::S32G3::FR_ExternalCommunication_node2_S32G399A_M7::Project_Settings::Startup_Code::startup.c, category=SWSRC
          short-label=examples::S32DS::S32G3::FR_ExternalCommunication_node2_S32G399A_M7::Project_Settings::Startup_Code::system.c, category=SWSRC
          short-label=examples::S32DS::S32G3::FR_ExternalCommunication_node2_S32G399A_M7::src::Llce_Firmware_Load.c, category=SWSRC
          short-label=examples::S32DS::S32G3::FR_ExternalCommunication_node2_S32G399A_M7::src::main.c, category=SWSRC
          short-label=include::Flexray_43_LLCE_Ip.h, category=SWHDR
          short-label=include::Flexray_43_LLCE_Ip_HwAccess.h, category=SWHDR
          short-label=include::Flexray_43_LLCE_Ip_Irq.h, category=SWHDR
          short-label=include::Flexray_43_LLCE_Ip_TrustedFunctions.h, category=SWHDR
          short-label=include::Flexray_43_LLCE_Ip_Types.h, category=SWHDR
          short-label=include::Fr_43_LLCE.h, category=SWHDR
          short-label=include::Fr_43_LLCE_Ipw.h, category=SWHDR
          short-label=include::Fr_43_LLCE_Ipw_Types.h, category=SWHDR
          short-label=include::Llce_FwVersion.h, category=SWHDR
          short-label=include::Llce_InterfaceCore2Core.h, category=SWHDR
          short-label=include::Llce_InterfaceFwMgr.h, category=SWHDR
          short-label=include::Llce_RegAccess.h, category=SWHDR
          short-label=src::Flexray_43_LLCE_Ip.c, category=SWSRC
          short-label=src::Flexray_43_LLCE_Ip_HwAccess.c, category=SWSRC
          short-label=src::Flexray_43_LLCE_Ip_Irq.c, category=SWSRC
          short-label=src::Fr_43_LLCE.c, category=SWSRC
          short-label=src::Fr_43_LLCE_Ipw.c, category=SWSRC
    compiler GCC_Compiler:
      name=GCC Compiler
      options=-mcpu=cortex-m7 -mthumb -mlittle-endian -mfpu=fpv5-sp-d16 -mfloat-abi=hard -std=c99 -Os -ggdb3 -Wall -Wextra -pedantic -Wstrict-prototypes -Wundef -Wunused -Werror=implicit-function-declaration -Wsign-compare -Wdouble-promotion -fno-short-enums -funsigned-char -funsigned-bitfields -fomit-frame-pointer -fno-common -fstack-usage -fdump-ipa-all -c -DS32XX -DS32G2XX -DS32G3XX -DS32R45 -DGCC -DUSE_SW_VECTOR_MODE -DD_CACHE_ENABLE -DI_CACHE_ENABLE -DENABLE_FPU -DMCAL_ENABLE_USER_MODE_SUPPORT
      vendor=GCC Systems
      version=NXP GCC 9.2.0 20190812 (Build 1649 Revision gaf57174) (for both S32G2 and S32G3)
    compiler GHS_Compiler:
      name=Green Hills
      options=-cpu=cortexm7 -thumb -fpu=vfpv5_d16 -fsingle -C99 --ghstd=last -Osize --gnu_asm -dual_debug -G -keeptempfiles -Wimplicit-int -Wshadow -Wtrigraphs -Wundef --unsigned_chars --unsigned_fields --no_commons --no_exceptions --no_slash_comment --prototype_errors --incorrect_pragma_warnings -c -DS32XX -DS32G2XX -DS32G3XX -DS32R45 -DGHS -DUSE_SW_VECTOR_MODE -DD_CACHE_ENABLE -DI_CACHE_ENABLE -DENABLE_FPU -DMCAL_ENABLE_USER_MODE_SUPPORT
      vendor=Green Hills
      version=Green Hills Multi 7.1.6d / Compiler 2020.1.4
    generated-artifacts:
      6 x dependency on artifact:
        Flexray_43_LLCE_Ip_PBcfg_h: artifact-descriptor={short-label=generate_PB::include::Flexray_43_LLCE_Ip_PBcfg.h, category=SWHDR}, usages=EXECUTE
        Fr_43_LLCE_PBcfg_h: artifact-descriptor={short-label=generate_PB::include::Fr_43_LLCE_PBcfg.h, category=SWHDR}, usages=EXECUTE
        Flexray_43_LLCE_Ip_PBcfg_c: artifact-descriptor={short-label=generate_PB::src::Flexray_43_LLCE_Ip_PBcfg.c, category=SWSRC}, usages=EXECUTE
        Fr_43_LLCE_PBcfg_c: artifact-descriptor={short-label=generate_PB::src::Fr_43_LLCE_PBcfg.c, category=SWSRC}, usages=EXECUTE
        Flexray_43_LLCE_Ip_Cfg_h: artifact-descriptor={short-label=generate_PC::include::Flexray_43_LLCE_Ip_Cfg.h, category=SWHDR}, usages=COMPILE
        Fr_43_LLCE_Cfg_h: artifact-descriptor={short-label=generate_PC::include::Fr_43_LLCE_Cfg.h, category=SWHDR}, usages=COMPILE
    linker GCC_Linker: name=GCC Compiler, options=-Wl,-Map,filename -T linkerfile --entry=Reset_Handler -nostartfiles -mcpu=cortexm7 -mthumb -mfpu=fpv5-sp-d16 -mfloat-abi=hard -mlittle-endian -ggdb3 -lc -lm -lgcc, vendor=GCC Systems, version=NXP GCC 9.2.0 20190812 (Build 1649 Revision gaf57174) (for both S32G2 and S32G3)
    linker GHS_Linker: name=Green Hills, options=-e Reset_Handler -T linker_script_file.ld -map -keepmap -Mn -delete -ignore_debug_references -Llibrary_path -larch -lstartup -lind_sd -v -nostartfiles, vendor=Green Hills, version=Green Hills Multi 7.1.6d / Compiler 2020.1.4
    resource consumption ResourceConsumption
