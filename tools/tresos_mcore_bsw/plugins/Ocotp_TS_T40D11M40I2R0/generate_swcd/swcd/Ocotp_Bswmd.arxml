AUTOSAR XML (schema 00046)
package /AUTOSAR_Ocotp/BswModuleDescriptions
  bsw module description Ocotp: module-id=255
    provided-entrys:
      Ocotp_CalculateAndWriteCrcValue
      Ocotp_CrcValidate
      Ocotp_Deinit
      Ocotp_EccErrorInject
      Ocotp_EccGetError
      Ocotp_GetStatus
      Ocotp_Init
      Ocotp_ReadApplicationInformation
      Ocotp_ReadEFuse
      Ocotp_ReadShadowRegister
      Ocotp_SetMode
      Ocotp_WriteApplicationInformation
      Ocotp_WriteEFuse
      Ocotp_WriteShadowRegister
    bsw internal behavior InternalBehavior_0
      exclusive area OCOTP_EXCLUSIVE_AREA_{00..02}
      14 x bsw called entity:
        Ocotp_CalculateAndWriteCrcValue: can-enter-exclusive-area=OCOTP_EXCLUSIVE_AREA_02, implemented-entry=Ocotp_CalculateAndWriteCrcValue
        Ocotp_CrcValidate: implemented-entry=Ocotp_CrcValidate
        Ocotp_Deinit: implemented-entry=Ocotp_Deinit
        Ocotp_EccErrorInject: implemented-entry=Ocotp_EccErrorInject
        Ocotp_EccGetError: implemented-entry=Ocotp_EccGetError
        Ocotp_GetStatus: implemented-entry=Ocotp_GetStatus
        Ocotp_Init: implemented-entry=Ocotp_Init
        Ocotp_ReadApplicationInformation: implemented-entry=Ocotp_ReadApplicationInformation
        Ocotp_ReadEFuse: can-enter-exclusive-area=OCOTP_EXCLUSIVE_AREA_01, implemented-entry=Ocotp_ReadEFuse
        Ocotp_ReadShadowRegister: implemented-entry=Ocotp_ReadShadowRegister
        Ocotp_SetMode: implemented-entry=Ocotp_SetMode
        Ocotp_WriteApplicationInformation: implemented-entry=Ocotp_WriteApplicationInformation
        Ocotp_WriteEFuse: can-enter-exclusive-area=OCOTP_EXCLUSIVE_AREA_00, implemented-entry=Ocotp_WriteEFuse
        Ocotp_WriteShadowRegister: implemented-entry=Ocotp_WriteShadowRegister
package /AUTOSAR_Ocotp/BswModuleEntrys
  14 x bsw module entry, all with is-synchronous=true, call-type=REGULAR, execution-context=UNSPECIFIED, sw-service-impl-policy=STANDARD:
    Ocotp_CalculateAndWriteCrcValue: service-id=0x0b, is-reentrant=true
    Ocotp_CrcValidate: service-id=0x0c, is-reentrant=true
    Ocotp_Deinit: service-id=0x01, is-reentrant=false
    Ocotp_EccErrorInject: service-id=0x08, is-reentrant=false
    Ocotp_EccGetError: service-id=0x09, is-reentrant=false
    Ocotp_GetStatus: service-id=0x0d, is-reentrant=false
    Ocotp_Init: service-id=0x00, is-reentrant=false
    Ocotp_ReadApplicationInformation: service-id=0x06, is-reentrant=false
    Ocotp_ReadEFuse: service-id=0x04, is-reentrant=true
    Ocotp_ReadShadowRegister: service-id=0x05, is-reentrant=false
    Ocotp_SetMode: service-id=0x0a, is-reentrant=true
    Ocotp_WriteApplicationInformation: service-id=0x07, is-reentrant=false
    Ocotp_WriteEFuse: service-id=0x02, is-reentrant=true
    Ocotp_WriteShadowRegister: service-id=0x03, is-reentrant=false
package /Ocotp_TS_T40D11M40I2R0/Implementations
  bsw implementation BswImplementation_0: programming-language=C, sw-version=4.0.2, vendor-id=43, ar-release-version=4.4.0, behavior=InternalBehavior_0, vendor-specific-module-def=Ocotp
    code-descriptors:
      code Files
        artifact-descriptors:
          short-label=config::Ocotp.xdm, category=SWCFG
          short-label=doc::RTD_OCOTP_IM.pdf, category=SWDOC
          short-label=doc::RTD_OCOTP_UM.pdf, category=SWDOC
          short-label=examples::EBT::S32G2::Ocotp_Example_S32G274A_M7::generate::epc::BaseNXP.xdm, category=SWCFG
          short-label=examples::EBT::S32G2::Ocotp_Example_S32G274A_M7::generate::epc::EcuC.xdm, category=SWCFG
          short-label=examples::EBT::S32G2::Ocotp_Example_S32G274A_M7::generate::epc::Mcu.xdm, category=SWCFG
          short-label=examples::EBT::S32G2::Ocotp_Example_S32G274A_M7::generate::epc::Ocotp.xdm, category=SWCFG
          short-label=examples::EBT::S32G2::Ocotp_Example_S32G274A_M7::generate::epc::Port.xdm, category=SWCFG
          short-label=examples::EBT::S32G2::Ocotp_Example_S32G274A_M7::generate::epc::Resource.xdm, category=SWCFG
          short-label=examples::EBT::S32G2::Ocotp_Example_S32G274A_M7::include::check_example.h, category=SWHDR
          short-label=examples::EBT::S32G2::Ocotp_Example_S32G274A_M7::src::main.c, category=SWSRC
          short-label=examples::EBT::S32G2::Ocotp_Example_S32G274A_M7::TresosProject::Ocotp_Example_S32G274A_M7::.prefs::preferences.xdm, category=SWCFG
          short-label=examples::EBT::S32G2::Ocotp_Example_S32G274A_M7::TresosProject::Ocotp_Example_S32G274A_M7::config::BaseNXP.xdm, category=SWCFG
          short-label=examples::EBT::S32G2::Ocotp_Example_S32G274A_M7::TresosProject::Ocotp_Example_S32G274A_M7::config::EcuC.xdm, category=SWCFG
          short-label=examples::EBT::S32G2::Ocotp_Example_S32G274A_M7::TresosProject::Ocotp_Example_S32G274A_M7::config::Mcu.xdm, category=SWCFG
          short-label=examples::EBT::S32G2::Ocotp_Example_S32G274A_M7::TresosProject::Ocotp_Example_S32G274A_M7::config::Ocotp.xdm, category=SWCFG
          short-label=examples::EBT::S32G2::Ocotp_Example_S32G274A_M7::TresosProject::Ocotp_Example_S32G274A_M7::config::Port.xdm, category=SWCFG
          short-label=examples::EBT::S32G2::Ocotp_Example_S32G274A_M7::TresosProject::Ocotp_Example_S32G274A_M7::config::Resource.xdm, category=SWCFG
          short-label=examples::EBT::S32G3::Ocotp_Example_S32G399A_M7::generate::epc::BaseNXP.xdm, category=SWCFG
          short-label=examples::EBT::S32G3::Ocotp_Example_S32G399A_M7::generate::epc::EcuC.xdm, category=SWCFG
          short-label=examples::EBT::S32G3::Ocotp_Example_S32G399A_M7::generate::epc::Mcu.xdm, category=SWCFG
          short-label=examples::EBT::S32G3::Ocotp_Example_S32G399A_M7::generate::epc::Ocotp.xdm, category=SWCFG
          short-label=examples::EBT::S32G3::Ocotp_Example_S32G399A_M7::generate::epc::Port.xdm, category=SWCFG
          short-label=examples::EBT::S32G3::Ocotp_Example_S32G399A_M7::generate::epc::Resource.xdm, category=SWCFG
          short-label=examples::EBT::S32G3::Ocotp_Example_S32G399A_M7::include::check_example.h, category=SWHDR
          short-label=examples::EBT::S32G3::Ocotp_Example_S32G399A_M7::src::main.c, category=SWSRC
          short-label=examples::EBT::S32G3::Ocotp_Example_S32G399A_M7::TresosProject::Ocotp_Example_S32G399A_M7::.prefs::preferences.xdm, category=SWCFG
          short-label=examples::EBT::S32G3::Ocotp_Example_S32G399A_M7::TresosProject::Ocotp_Example_S32G399A_M7::config::BaseNXP.xdm, category=SWCFG
          short-label=examples::EBT::S32G3::Ocotp_Example_S32G399A_M7::TresosProject::Ocotp_Example_S32G399A_M7::config::EcuC.xdm, category=SWCFG
          short-label=examples::EBT::S32G3::Ocotp_Example_S32G399A_M7::TresosProject::Ocotp_Example_S32G399A_M7::config::Mcu.xdm, category=SWCFG
          short-label=examples::EBT::S32G3::Ocotp_Example_S32G399A_M7::TresosProject::Ocotp_Example_S32G399A_M7::config::Ocotp.xdm, category=SWCFG
          short-label=examples::EBT::S32G3::Ocotp_Example_S32G399A_M7::TresosProject::Ocotp_Example_S32G399A_M7::config::Port.xdm, category=SWCFG
          short-label=examples::EBT::S32G3::Ocotp_Example_S32G399A_M7::TresosProject::Ocotp_Example_S32G399A_M7::config::Resource.xdm, category=SWCFG
          short-label=examples::EBT::S32R45::Ocotp_Example_S32R45_M7::generate::epc::BaseNXP.xdm, category=SWCFG
          short-label=examples::EBT::S32R45::Ocotp_Example_S32R45_M7::generate::epc::EcuC.xdm, category=SWCFG
          short-label=examples::EBT::S32R45::Ocotp_Example_S32R45_M7::generate::epc::Mcu.xdm, category=SWCFG
          short-label=examples::EBT::S32R45::Ocotp_Example_S32R45_M7::generate::epc::Ocotp.xdm, category=SWCFG
          short-label=examples::EBT::S32R45::Ocotp_Example_S32R45_M7::generate::epc::Resource.xdm, category=SWCFG
          short-label=examples::EBT::S32R45::Ocotp_Example_S32R45_M7::include::check_example.h, category=SWHDR
          short-label=examples::EBT::S32R45::Ocotp_Example_S32R45_M7::src::main.c, category=SWSRC
          short-label=examples::EBT::S32R45::Ocotp_Example_S32R45_M7::TresosProject::Ocotp_Example_S32R45_M7::.prefs::preferences.xdm, category=SWCFG
          short-label=examples::EBT::S32R45::Ocotp_Example_S32R45_M7::TresosProject::Ocotp_Example_S32R45_M7::config::BaseNXP.xdm, category=SWCFG
          short-label=examples::EBT::S32R45::Ocotp_Example_S32R45_M7::TresosProject::Ocotp_Example_S32R45_M7::config::EcuC.xdm, category=SWCFG
          short-label=examples::EBT::S32R45::Ocotp_Example_S32R45_M7::TresosProject::Ocotp_Example_S32R45_M7::config::Mcu.xdm, category=SWCFG
          short-label=examples::EBT::S32R45::Ocotp_Example_S32R45_M7::TresosProject::Ocotp_Example_S32R45_M7::config::Ocotp.xdm, category=SWCFG
          short-label=examples::EBT::S32R45::Ocotp_Example_S32R45_M7::TresosProject::Ocotp_Example_S32R45_M7::config::Resource.xdm, category=SWCFG
          short-label=examples::S32DS::S32G2::Ocotp_Example_S32G274A_M7::include::check_example.h, category=SWHDR
          short-label=examples::S32DS::S32G2::Ocotp_Example_S32G274A_M7::Project_Settings::Startup_Code::exceptions.c, category=SWSRC
          short-label=examples::S32DS::S32G2::Ocotp_Example_S32G274A_M7::Project_Settings::Startup_Code::nvic.c, category=SWSRC
          short-label=examples::S32DS::S32G2::Ocotp_Example_S32G274A_M7::Project_Settings::Startup_Code::startup.c, category=SWSRC
          short-label=examples::S32DS::S32G2::Ocotp_Example_S32G274A_M7::Project_Settings::Startup_Code::system.c, category=SWSRC
          short-label=examples::S32DS::S32G2::Ocotp_Example_S32G274A_M7::src::main.c, category=SWSRC
          short-label=examples::S32DS::S32G2::Ocotp_Ip_Example_S32G274A_M7::include::check_example.h, category=SWHDR
          short-label=examples::S32DS::S32G2::Ocotp_Ip_Example_S32G274A_M7::Project_Settings::Startup_Code::exceptions.c, category=SWSRC
          short-label=examples::S32DS::S32G2::Ocotp_Ip_Example_S32G274A_M7::Project_Settings::Startup_Code::nvic.c, category=SWSRC
          short-label=examples::S32DS::S32G2::Ocotp_Ip_Example_S32G274A_M7::Project_Settings::Startup_Code::startup.c, category=SWSRC
          short-label=examples::S32DS::S32G2::Ocotp_Ip_Example_S32G274A_M7::Project_Settings::Startup_Code::system.c, category=SWSRC
          short-label=examples::S32DS::S32G2::Ocotp_Ip_Example_S32G274A_M7::src::main.c, category=SWSRC
          short-label=examples::S32DS::S32G3::Ocotp_Example_S32G399A_M7::include::check_example.h, category=SWHDR
          short-label=examples::S32DS::S32G3::Ocotp_Example_S32G399A_M7::Project_Settings::Startup_Code::exceptions.c, category=SWSRC
          short-label=examples::S32DS::S32G3::Ocotp_Example_S32G399A_M7::Project_Settings::Startup_Code::nvic.c, category=SWSRC
          short-label=examples::S32DS::S32G3::Ocotp_Example_S32G399A_M7::Project_Settings::Startup_Code::startup.c, category=SWSRC
          short-label=examples::S32DS::S32G3::Ocotp_Example_S32G399A_M7::Project_Settings::Startup_Code::system.c, category=SWSRC
          short-label=examples::S32DS::S32G3::Ocotp_Example_S32G399A_M7::src::main.c, category=SWSRC
          short-label=examples::S32DS::S32G3::Ocotp_Ip_Example_S32G399A_M7::include::check_example.h, category=SWHDR
          short-label=examples::S32DS::S32G3::Ocotp_Ip_Example_S32G399A_M7::Project_Settings::Startup_Code::exceptions.c, category=SWSRC
          short-label=examples::S32DS::S32G3::Ocotp_Ip_Example_S32G399A_M7::Project_Settings::Startup_Code::nvic.c, category=SWSRC
          short-label=examples::S32DS::S32G3::Ocotp_Ip_Example_S32G399A_M7::Project_Settings::Startup_Code::startup.c, category=SWSRC
          short-label=examples::S32DS::S32G3::Ocotp_Ip_Example_S32G399A_M7::Project_Settings::Startup_Code::system.c, category=SWSRC
          short-label=examples::S32DS::S32G3::Ocotp_Ip_Example_S32G399A_M7::src::main.c, category=SWSRC
          short-label=examples::S32DS::S32R45::Ocotp_Example_S32R45_M7::include::check_example.h, category=SWHDR
          short-label=examples::S32DS::S32R45::Ocotp_Example_S32R45_M7::Project_Settings::Startup_Code::exceptions.c, category=SWSRC
          short-label=examples::S32DS::S32R45::Ocotp_Example_S32R45_M7::Project_Settings::Startup_Code::nvic.c, category=SWSRC
          short-label=examples::S32DS::S32R45::Ocotp_Example_S32R45_M7::Project_Settings::Startup_Code::startup.c, category=SWSRC
          short-label=examples::S32DS::S32R45::Ocotp_Example_S32R45_M7::Project_Settings::Startup_Code::system.c, category=SWSRC
          short-label=examples::S32DS::S32R45::Ocotp_Example_S32R45_M7::src::main.c, category=SWSRC
          short-label=examples::S32DS::S32R45::Ocotp_Ip_Example_S32R45_M7::include::check_example.h, category=SWHDR
          short-label=examples::S32DS::S32R45::Ocotp_Ip_Example_S32R45_M7::Project_Settings::Startup_Code::exceptions.c, category=SWSRC
          short-label=examples::S32DS::S32R45::Ocotp_Ip_Example_S32R45_M7::Project_Settings::Startup_Code::nvic.c, category=SWSRC
          short-label=examples::S32DS::S32R45::Ocotp_Ip_Example_S32R45_M7::Project_Settings::Startup_Code::startup.c, category=SWSRC
          short-label=examples::S32DS::S32R45::Ocotp_Ip_Example_S32R45_M7::Project_Settings::Startup_Code::system.c, category=SWSRC
          short-label=examples::S32DS::S32R45::Ocotp_Ip_Example_S32R45_M7::src::main.c, category=SWSRC
          short-label=include::CDD_Ocotp.h, category=SWHDR
          short-label=include::Ocotp_Ip.h, category=SWHDR
          short-label=include::Ocotp_IPW.h, category=SWHDR
          short-label=include::Ocotp_Ip_Features.h, category=SWHDR
          short-label=include::Ocotp_Ip_Types.h, category=SWHDR
          short-label=include::Ocotp_Types.h, category=SWHDR
          short-label=src::CDD_Ocotp.c, category=SWSRC
          short-label=src::Ocotp_Ip.c, category=SWSRC
          short-label=src::Ocotp_IPW.c, category=SWSRC
    compiler DIAB_Compiler:
      name=Windriver Diab
      options=-tARMCORTEXM7MG:simple -mthumb -std=c99 -Oz -g -fstandalone-debug -Wstrict-prototypes -Wsign-compare -Wdouble-promotion -Wunknown-pragmas -Wundef -Wextra -Wall -pedantic -Werror=implicit-function-declaration -fno-common -fno-signed-char -fno-trigraphs -V -c -DS32XX -DS32G2XX -DS32G3XX -DS32R45 -DDIAB -DUSE_SW_VECTOR_MODE -DD_CACHE_ENABLE -DI_CACHE_ENABLE -DENABLE_FPU -DMCAL_ENABLE_USER_MODE_SUPPORT
      vendor=Windriver
      version=DIAB_7_0_3_0-FCS_20200409_160912
    compiler GCC_Compiler:
      name=GCC Compiler
      options=-mcpu=cortex-m7 -mthumb -mlittle-endian -mfpu=fpv5-sp-d16 -mfloat-abi=hard -std=c99 -Os -ggdb3 -Wall -Wextra -pedantic -Wstrict-prototypes -Wundef -Wunused -Werror=implicit-function-declaration -Wsign-compare -Wdouble-promotion -fno-short-enums -funsigned-char -funsigned-bitfields -fomit-frame-pointer -fno-common -fstack-usage -fdump-ipa-all -c -DS32XX -DS32G2XX -DS32G3XX -DS32R45 -DGCC -DUSE_SW_VECTOR_MODE -DD_CACHE_ENABLE -DI_CACHE_ENABLE -DENABLE_FPU -DMCAL_ENABLE_USER_MODE_SUPPORT
      vendor=GCC Systems
      version=NXP GCC 9.2.0 20190812 (Build 1649 Revision gaf57174)
    compiler GHS_Compiler:
      name=Green Hills
      options=-cpu=cortexm7 -thumb -fpu=vfpv5_d16 -fsingle -C99 --ghstd=last -Osize --gnu_asm -dual_debug -G -keeptempfiles -Wimplicit-int -Wshadow -Wtrigraphs -Wundef --unsigned_chars --unsigned_fields --no_commons --no_exceptions --no_slash_comment --prototype_errors --incorrect_pragma_warnings -c -DS32XX -DS32G2XX -DS32G3XX -DS32R45 -DGHS -DUSE_SW_VECTOR_MODE -DD_CACHE_ENABLE -DI_CACHE_ENABLE -DENABLE_FPU -DMCAL_ENABLE_USER_MODE_SUPPORT
      vendor=Green Hills
      version=Green Hills Multi 7.1.6d / Compiler 2020.1.4
    generated-artifacts:
      6 x dependency on artifact:
        Ocotp_PBcfg_h: artifact-descriptor={short-label=generate_PB::include::Ocotp_PBcfg.h, category=SWHDR}, usages=EXECUTE
        Ocotp_Ip_PBcfg_c: artifact-descriptor={short-label=generate_PB::src::Ocotp_Ip_PBcfg.c, category=SWSRC}, usages=EXECUTE
        Ocotp_PBcfg_c: artifact-descriptor={short-label=generate_PB::src::Ocotp_PBcfg.c, category=SWSRC}, usages=EXECUTE
        Ocotp_Cfg_h: artifact-descriptor={short-label=generate_PC::include::Ocotp_Cfg.h, category=SWHDR}, usages=COMPILE
        Ocotp_Ip_Cfg_h: artifact-descriptor={short-label=generate_PC::include::Ocotp_Ip_Cfg.h, category=SWHDR}, usages=COMPILE
        Ocotp_Cfg_c: artifact-descriptor={short-label=generate_PC::src::Ocotp_Cfg.c, category=SWSRC}, usages=COMPILE
    linker DIAB_Linker: name=Windriver Diab, options=-e Reset_Handler linker_script_file.dld -m30 -Xstack-usage -Xpreprocess-lecl -Llibrary_path -lc -lm, vendor=Windriver, version=DIAB_7_0_3_0-FCS_20200409_160912
    linker GCC_Linker: name=GCC Compiler, options=-Wl,-Map,filename -T linkerfile --entry=Reset_Handler -nostartfiles -mcpu=cortexm7 -mthumb -mfpu=fpv5-sp-d16 -mfloat-abi=hard -mlittle-endian -ggdb3 -lc -lm -lgcc, vendor=GCC Systems, version=NXP GCC 9.2.0 20190812 (Build 1649 Revision gaf57174)
    linker GHS_Linker: name=Green Hills, options=-e Reset_Handler -T linker_script_file.ld -map -keepmap -Mn -delete -ignore_debug_references -Llibrary_path -larch -lstartup -lind_sd -v -nostartfiles, vendor=Green Hills, version=Green Hills Multi 7.1.6d / Compiler 2020.1.4
    resource consumption ResourceConsumption
      6 x memory section:
        OCOTP_CODE: alignment=UNSPECIFIED, sw-addrmethod=CODE, symbol=CODE
        OCOTP_CONFIG_DATA_UNSPECIFIED: alignment=UNSPECIFIED, sw-addrmethod=CONFIG_DATA, symbol=CONFIG_DATA_UNSPECIFIED
        OCOTP_CONST_32: alignment=32, sw-addrmethod=CONST, symbol=CONST_32
        OCOTP_CONST_UNSPECIFIED: alignment=UNSPECIFIED, sw-addrmethod=CONST, symbol=CONST_UNSPECIFIED
        OCOTP_VAR_CLEARED_UNSPECIFIED_NO_CACHEABLE: alignment=UNSPECIFIED, sw-addrmethod=VAR_CLEARED_NO_CACHEABLE, symbol=VAR_CLEARED_UNSPECIFIED_NO_CACHEABLE
        OCOTP_VAR_INIT_UNSPECIFIED: alignment=UNSPECIFIED, sw-addrmethod=VAR_INIT, symbol=VAR_INIT_UNSPECIFIED
