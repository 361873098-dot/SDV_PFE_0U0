AUTOSAR XML (schema 00046)
package /AUTOSAR_Crc/BswModuleDescriptions
  bsw module description Crc: module-id=201
    provided-entrys:
      Crc_CalculateCRC16
      Crc_CalculateCRC16ARC
      Crc_CalculateCRC32
      Crc_CalculateCRC32P4
      Crc_CalculateCRC64
      Crc_CalculateCRC8
      Crc_CalculateCRC8H2F
      Crc_GetChannelResult
      Crc_GetVersionInfo
      Crc_Init
      Crc_SetChannelCalculate
      Crc_SetChannelConfig
    bsw internal behavior InternalBehavior_0
      12 x bsw called entity:
        Crc_CalculateCRC16: implemented-entry=Crc_CalculateCRC16
        Crc_CalculateCRC16ARC: implemented-entry=Crc_CalculateCRC16ARC
        Crc_CalculateCRC32: implemented-entry=Crc_CalculateCRC32
        Crc_CalculateCRC32P4: implemented-entry=Crc_CalculateCRC32P4
        Crc_CalculateCRC64: implemented-entry=Crc_CalculateCRC64
        Crc_CalculateCRC8: implemented-entry=Crc_CalculateCRC8
        Crc_CalculateCRC8H2F: implemented-entry=Crc_CalculateCRC8H2F
        Crc_GetChannelResult: implemented-entry=Crc_GetChannelResult
        Crc_GetVersionInfo: implemented-entry=Crc_GetVersionInfo
        Crc_Init: implemented-entry=Crc_Init
        Crc_SetChannelCalculate: implemented-entry=Crc_SetChannelCalculate
        Crc_SetChannelConfig: implemented-entry=Crc_SetChannelConfig
package /AUTOSAR_Crc/BswModuleEntrys
  12 x bsw module entry, all with is-synchronous=true, call-type=REGULAR, execution-context=UNSPECIFIED, sw-service-impl-policy=STANDARD:
    Crc_CalculateCRC16: service-id=0x02, is-reentrant=true
    Crc_CalculateCRC16ARC: service-id=0x08, is-reentrant=true
    Crc_CalculateCRC32: service-id=0x03, is-reentrant=true
    Crc_CalculateCRC32P4: service-id=0x06, is-reentrant=true
    Crc_CalculateCRC64: service-id=0x07, is-reentrant=true
    Crc_CalculateCRC8: service-id=0x01, is-reentrant=true
    Crc_CalculateCRC8H2F: service-id=0x05, is-reentrant=true
    Crc_GetChannelResult: service-id=0x0c, is-reentrant=true
    Crc_GetVersionInfo: service-id=0x04, is-reentrant=true
    Crc_Init: service-id=0x09, is-reentrant=false
    Crc_SetChannelCalculate: service-id=0x0b, is-reentrant=true
    Crc_SetChannelConfig: service-id=0x0a, is-reentrant=true
package /Crc_TS_T40D11M40I2R0/Implementations
  bsw implementation BswImplementation_0: programming-language=C, sw-version=4.0.2, vendor-id=43, ar-release-version=4.4.0, behavior=InternalBehavior_0, vendor-specific-module-def=Crc
    code-descriptors:
      code Files
        artifact-descriptors:
          short-label=config::Crc.xdm, category=SWCFG
          short-label=doc::RTD_CRC_IM.pdf, category=SWDOC
          short-label=doc::RTD_CRC_UM.pdf, category=SWDOC
          short-label=examples::EBT::S32G2::Crc_Example_S32G274A_M7::generate::epc::BaseNXP.xdm, category=SWCFG
          short-label=examples::EBT::S32G2::Crc_Example_S32G274A_M7::generate::epc::Crc.xdm, category=SWCFG
          short-label=examples::EBT::S32G2::Crc_Example_S32G274A_M7::generate::epc::Mcl.xdm, category=SWCFG
          short-label=examples::EBT::S32G2::Crc_Example_S32G274A_M7::generate::epc::Mcu.xdm, category=SWCFG
          short-label=examples::EBT::S32G2::Crc_Example_S32G274A_M7::generate::epc::Resource.xdm, category=SWCFG
          short-label=examples::EBT::S32G2::Crc_Example_S32G274A_M7::include::check_example.h, category=SWHDR
          short-label=examples::EBT::S32G2::Crc_Example_S32G274A_M7::src::main.c, category=SWSRC
          short-label=examples::EBT::S32G2::Crc_Example_S32G274A_M7::TresosProject::Crc_Example_S32G274A_M7::.prefs::preferences.xdm, category=SWCFG
          short-label=examples::EBT::S32G2::Crc_Example_S32G274A_M7::TresosProject::Crc_Example_S32G274A_M7::config::BaseNXP.xdm, category=SWCFG
          short-label=examples::EBT::S32G2::Crc_Example_S32G274A_M7::TresosProject::Crc_Example_S32G274A_M7::config::Crc.xdm, category=SWCFG
          short-label=examples::EBT::S32G2::Crc_Example_S32G274A_M7::TresosProject::Crc_Example_S32G274A_M7::config::EcuC.xdm, category=SWCFG
          short-label=examples::EBT::S32G2::Crc_Example_S32G274A_M7::TresosProject::Crc_Example_S32G274A_M7::config::Mcl.xdm, category=SWCFG
          short-label=examples::EBT::S32G2::Crc_Example_S32G274A_M7::TresosProject::Crc_Example_S32G274A_M7::config::Mcu.xdm, category=SWCFG
          short-label=examples::EBT::S32G2::Crc_Example_S32G274A_M7::TresosProject::Crc_Example_S32G274A_M7::config::Resource.xdm, category=SWCFG
          short-label=examples::EBT::S32G3::Crc_Example_S32G399A_M7::generate::epc::BaseNXP.xdm, category=SWCFG
          short-label=examples::EBT::S32G3::Crc_Example_S32G399A_M7::generate::epc::Crc.xdm, category=SWCFG
          short-label=examples::EBT::S32G3::Crc_Example_S32G399A_M7::generate::epc::Mcl.xdm, category=SWCFG
          short-label=examples::EBT::S32G3::Crc_Example_S32G399A_M7::generate::epc::Mcu.xdm, category=SWCFG
          short-label=examples::EBT::S32G3::Crc_Example_S32G399A_M7::generate::epc::Resource.xdm, category=SWCFG
          short-label=examples::EBT::S32G3::Crc_Example_S32G399A_M7::include::check_example.h, category=SWHDR
          short-label=examples::EBT::S32G3::Crc_Example_S32G399A_M7::src::main.c, category=SWSRC
          short-label=examples::EBT::S32G3::Crc_Example_S32G399A_M7::TresosProject::Crc_Example_S32G399A_M7::.prefs::preferences.xdm, category=SWCFG
          short-label=examples::EBT::S32G3::Crc_Example_S32G399A_M7::TresosProject::Crc_Example_S32G399A_M7::config::BaseNXP.xdm, category=SWCFG
          short-label=examples::EBT::S32G3::Crc_Example_S32G399A_M7::TresosProject::Crc_Example_S32G399A_M7::config::Crc.xdm, category=SWCFG
          short-label=examples::EBT::S32G3::Crc_Example_S32G399A_M7::TresosProject::Crc_Example_S32G399A_M7::config::EcuC.xdm, category=SWCFG
          short-label=examples::EBT::S32G3::Crc_Example_S32G399A_M7::TresosProject::Crc_Example_S32G399A_M7::config::Mcl.xdm, category=SWCFG
          short-label=examples::EBT::S32G3::Crc_Example_S32G399A_M7::TresosProject::Crc_Example_S32G399A_M7::config::Mcu.xdm, category=SWCFG
          short-label=examples::EBT::S32G3::Crc_Example_S32G399A_M7::TresosProject::Crc_Example_S32G399A_M7::config::Resource.xdm, category=SWCFG
          short-label=examples::EBT::S32R45::Crc_Example_S32R45_M7::generate::epc::BaseNXP.xdm, category=SWCFG
          short-label=examples::EBT::S32R45::Crc_Example_S32R45_M7::generate::epc::Crc.xdm, category=SWCFG
          short-label=examples::EBT::S32R45::Crc_Example_S32R45_M7::generate::epc::Mcl.xdm, category=SWCFG
          short-label=examples::EBT::S32R45::Crc_Example_S32R45_M7::generate::epc::Mcu.xdm, category=SWCFG
          short-label=examples::EBT::S32R45::Crc_Example_S32R45_M7::generate::epc::Resource.xdm, category=SWCFG
          short-label=examples::EBT::S32R45::Crc_Example_S32R45_M7::include::check_example.h, category=SWHDR
          short-label=examples::EBT::S32R45::Crc_Example_S32R45_M7::src::main.c, category=SWSRC
          short-label=examples::EBT::S32R45::Crc_Example_S32R45_M7::TresosProject::Crc_Example_S32R45_M7::.prefs::preferences.xdm, category=SWCFG
          short-label=examples::EBT::S32R45::Crc_Example_S32R45_M7::TresosProject::Crc_Example_S32R45_M7::config::BaseNXP.xdm, category=SWCFG
          short-label=examples::EBT::S32R45::Crc_Example_S32R45_M7::TresosProject::Crc_Example_S32R45_M7::config::Crc.xdm, category=SWCFG
          short-label=examples::EBT::S32R45::Crc_Example_S32R45_M7::TresosProject::Crc_Example_S32R45_M7::config::EcuC.xdm, category=SWCFG
          short-label=examples::EBT::S32R45::Crc_Example_S32R45_M7::TresosProject::Crc_Example_S32R45_M7::config::Mcl.xdm, category=SWCFG
          short-label=examples::EBT::S32R45::Crc_Example_S32R45_M7::TresosProject::Crc_Example_S32R45_M7::config::Mcu.xdm, category=SWCFG
          short-label=examples::EBT::S32R45::Crc_Example_S32R45_M7::TresosProject::Crc_Example_S32R45_M7::config::Resource.xdm, category=SWCFG
          short-label=examples::S32DS::S32G2::Crc_Example_S32G274A_M7::include::check_example.h, category=SWHDR
          short-label=examples::S32DS::S32G2::Crc_Example_S32G274A_M7::Project_Settings::Startup_Code::exceptions.c, category=SWSRC
          short-label=examples::S32DS::S32G2::Crc_Example_S32G274A_M7::Project_Settings::Startup_Code::nvic.c, category=SWSRC
          short-label=examples::S32DS::S32G2::Crc_Example_S32G274A_M7::Project_Settings::Startup_Code::startup.c, category=SWSRC
          short-label=examples::S32DS::S32G2::Crc_Example_S32G274A_M7::Project_Settings::Startup_Code::system.c, category=SWSRC
          short-label=examples::S32DS::S32G2::Crc_Example_S32G274A_M7::src::main.c, category=SWSRC
          short-label=examples::S32DS::S32G2::Crc_Ip_Example_S32G274A_M7::include::check_example.h, category=SWHDR
          short-label=examples::S32DS::S32G2::Crc_Ip_Example_S32G274A_M7::Project_Settings::Startup_Code::exceptions.c, category=SWSRC
          short-label=examples::S32DS::S32G2::Crc_Ip_Example_S32G274A_M7::Project_Settings::Startup_Code::nvic.c, category=SWSRC
          short-label=examples::S32DS::S32G2::Crc_Ip_Example_S32G274A_M7::Project_Settings::Startup_Code::startup.c, category=SWSRC
          short-label=examples::S32DS::S32G2::Crc_Ip_Example_S32G274A_M7::Project_Settings::Startup_Code::system.c, category=SWSRC
          short-label=examples::S32DS::S32G2::Crc_Ip_Example_S32G274A_M7::src::main.c, category=SWSRC
          short-label=examples::S32DS::S32G3::Crc_Example_S32G399A_M7::include::check_example.h, category=SWHDR
          short-label=examples::S32DS::S32G3::Crc_Example_S32G399A_M7::Project_Settings::Startup_Code::exceptions.c, category=SWSRC
          short-label=examples::S32DS::S32G3::Crc_Example_S32G399A_M7::Project_Settings::Startup_Code::nvic.c, category=SWSRC
          short-label=examples::S32DS::S32G3::Crc_Example_S32G399A_M7::Project_Settings::Startup_Code::startup.c, category=SWSRC
          short-label=examples::S32DS::S32G3::Crc_Example_S32G399A_M7::Project_Settings::Startup_Code::system.c, category=SWSRC
          short-label=examples::S32DS::S32G3::Crc_Example_S32G399A_M7::src::main.c, category=SWSRC
          short-label=examples::S32DS::S32G3::Crc_Ip_Example_S32G399A_M7::include::check_example.h, category=SWHDR
          short-label=examples::S32DS::S32G3::Crc_Ip_Example_S32G399A_M7::Project_Settings::Startup_Code::exceptions.c, category=SWSRC
          short-label=examples::S32DS::S32G3::Crc_Ip_Example_S32G399A_M7::Project_Settings::Startup_Code::nvic.c, category=SWSRC
          short-label=examples::S32DS::S32G3::Crc_Ip_Example_S32G399A_M7::Project_Settings::Startup_Code::startup.c, category=SWSRC
          short-label=examples::S32DS::S32G3::Crc_Ip_Example_S32G399A_M7::Project_Settings::Startup_Code::system.c, category=SWSRC
          short-label=examples::S32DS::S32G3::Crc_Ip_Example_S32G399A_M7::src::main.c, category=SWSRC
          short-label=examples::S32DS::S32R45::Crc_Example_S32R45_M7::include::check_example.h, category=SWHDR
          short-label=examples::S32DS::S32R45::Crc_Example_S32R45_M7::Project_Settings::Startup_Code::exceptions.c, category=SWSRC
          short-label=examples::S32DS::S32R45::Crc_Example_S32R45_M7::Project_Settings::Startup_Code::nvic.c, category=SWSRC
          short-label=examples::S32DS::S32R45::Crc_Example_S32R45_M7::Project_Settings::Startup_Code::startup.c, category=SWSRC
          short-label=examples::S32DS::S32R45::Crc_Example_S32R45_M7::Project_Settings::Startup_Code::system.c, category=SWSRC
          short-label=examples::S32DS::S32R45::Crc_Example_S32R45_M7::src::main.c, category=SWSRC
          short-label=examples::S32DS::S32R45::Crc_Ip_Example_S32R45_M7::include::check_example.h, category=SWHDR
          short-label=examples::S32DS::S32R45::Crc_Ip_Example_S32R45_M7::Project_Settings::Startup_Code::exceptions.c, category=SWSRC
          short-label=examples::S32DS::S32R45::Crc_Ip_Example_S32R45_M7::Project_Settings::Startup_Code::nvic.c, category=SWSRC
          short-label=examples::S32DS::S32R45::Crc_Ip_Example_S32R45_M7::Project_Settings::Startup_Code::startup.c, category=SWSRC
          short-label=examples::S32DS::S32R45::Crc_Ip_Example_S32R45_M7::Project_Settings::Startup_Code::system.c, category=SWSRC
          short-label=examples::S32DS::S32R45::Crc_Ip_Example_S32R45_M7::src::main.c, category=SWSRC
          short-label=include::CDD_Crc.h, category=SWHDR
          short-label=include::Crc.h, category=SWHDR
          short-label=include::Crc_Ip.h, category=SWHDR
          short-label=include::Crc_Ipw.h, category=SWHDR
          short-label=include::Crc_Ip_Devassert.h, category=SWHDR
          short-label=include::Crc_Ip_Hardware.h, category=SWHDR
          short-label=include::Crc_Ip_Hw_Access.h, category=SWHDR
          short-label=include::Crc_Ip_Lib.h, category=SWHDR
          short-label=include::Crc_Ip_Lookup_Tables.h, category=SWHDR
          short-label=include::Crc_Ip_Software.h, category=SWHDR
          short-label=include::Crc_Ip_State.h, category=SWHDR
          short-label=include::Crc_Ip_TrustedFunctions.h, category=SWHDR
          short-label=include::Crc_Ip_Types.h, category=SWHDR
          short-label=include::Crc_Types.h, category=SWHDR
          short-label=src::CDD_Crc.c, category=SWSRC
          short-label=src::Crc_Ip.c, category=SWSRC
          short-label=src::Crc_Ip_Hardware.c, category=SWSRC
          short-label=src::Crc_Ip_Lookup_Tables.c, category=SWSRC
          short-label=src::Crc_Ip_Software.c, category=SWSRC
    compiler DIAB_Compiler:
      name=Windriver Diab
      options=-tARMCORTEXM7MG:simple -mthumb -std=c99 -Oz -g -fstandalone-debug -Wstrict-prototypes -Wsign-compare -Wdouble-promotion -Wunknown-pragmas -Wundef -Wextra -Wall -pedantic -Werror=implicit-function-declaration -fno-common -fno-signed-char -fno-trigraphs -V -c -DS32XX -DS32G2XX -DS32G3XX -DS32R45 -DDIAB -DUSE_SW_VECTOR_MODE -DD_CACHE_ENABLE -DI_CACHE_ENABLE -DENABLE_FPU -DMCAL_ENABLE_USER_MODE_SUPPORT
      vendor=Windriver
      version=DIAB_7_0_3_0-FCS_20200409_160912
    compiler GCC_Compiler:
      name=GCC Compiler
      options=-mcpu=cortex-m7 -mthumb -mlittle-endian -mfpu=fpv5-sp-d16 -mfloat-abi=hard -std=c99 -Os -ggdb3 -Wall -Wextra -pedantic -Wstrict-prototypes -Wundef -Wunused -Werror=implicit-function-declaration -Wsign-compare -Wdouble-promotion -fno-short-enums -funsigned-char -funsigned-bitfields -fomit-frame-pointer -fno-common -fstack-usage -fdump-ipa-all -c -DS32XX -DS32G2XX -DS32G3XX -DS32R45 -DGCC -DUSE_SW_VECTOR_MODE -DD_CACHE_ENABLE -DI_CACHE_ENABLE -DENABLE_FPU -DMCAL_ENABLE_USER_MODE_SUPPORT
      vendor=GCC Systems
      version=NXP GCC 9.2.0 20190812 (Build 1649 Revision gaf57174)
    compiler GHS_Compiler:
      name=Green Hills
      options=-cpu=cortexm7 -thumb -fpu=vfpv5_d16 -fsingle -C99 --ghstd=last -Osize --gnu_asm -dual_debug -G -keeptempfiles -Wimplicit-int -Wshadow -Wtrigraphs -Wundef --unsigned_chars --unsigned_fields --no_commons --no_exceptions --no_slash_comment --prototype_errors --incorrect_pragma_warnings -c -DS32XX -DS32G2XX -DS32G3XX -DS32R45 -DGHS -DUSE_SW_VECTOR_MODE -DD_CACHE_ENABLE -DI_CACHE_ENABLE -DENABLE_FPU -DMCAL_ENABLE_USER_MODE_SUPPORT
      vendor=Green Hills
      version=Green Hills Multi 7.1.6d / Compiler 2020.1.4
    generated-artifacts:
      5 x dependency on artifact, all with usages=COMPILE:
        Crc_Cfg_h: artifact-descriptor={short-label=generate_PC::include::Crc_Cfg.h, category=SWHDR}
        Crc_Ip_Cfg_h: artifact-descriptor={short-label=generate_PC::include::Crc_Ip_Cfg.h, category=SWHDR}
        Crc_Ip_CfgDefines_h: artifact-descriptor={short-label=generate_PC::include::Crc_Ip_CfgDefines.h, category=SWHDR}
        Crc_Cfg_c: artifact-descriptor={short-label=generate_PC::src::Crc_Cfg.c, category=SWSRC}
        Crc_Ip_Cfg_c: artifact-descriptor={short-label=generate_PC::src::Crc_Ip_Cfg.c, category=SWSRC}
    linker DIAB_Linker: name=Windriver Diab, options=-e Reset_Handler linker_script_file.dld -m30 -Xstack-usage -Xpreprocess-lecl -Llibrary_path -lc -lm, vendor=Windriver, version=DIAB_7_0_3_0-FCS_20200409_160912
    linker GCC_Linker: name=GCC Compiler, options=-Wl,-Map,filename -T linkerfile --entry=Reset_Handler -nostartfiles -mcpu=cortexm7 -mthumb -mfpu=fpv5-sp-d16 -mfloat-abi=hard -mlittle-endian -ggdb3 -lc -lm -lgcc, vendor=GCC Systems, version=NXP GCC 9.2.0 20190812 (Build 1649 Revision gaf57174)
    linker GHS_Linker: name=Green Hills, options=-e Reset_Handler -T linker_script_file.ld -map -keepmap -Mn -delete -ignore_debug_references -Llibrary_path -larch -lstartup -lind_sd -v -nostartfiles, vendor=Green Hills, version=Green Hills Multi 7.1.6d / Compiler 2020.1.4
    resource consumption ResourceConsumption
      10 x memory section:
        CRC_CODE: alignment=UNSPECIFIED, sw-addrmethod=CODE, symbol=CODE
        CRC_CONFIG_DATA_UNSPECIFIED: alignment=UNSPECIFIED, sw-addrmethod=CONFIG_DATA, symbol=CONFIG_DATA_UNSPECIFIED
        CRC_CONST_16: alignment=16, sw-addrmethod=CONST, symbol=CONST_16
        CRC_CONST_32: alignment=32, sw-addrmethod=CONST, symbol=CONST_32
        CRC_CONST_8: alignment=8, sw-addrmethod=CONST, symbol=CONST_8
        CRC_CONST_UNSPECIFIED: alignment=UNSPECIFIED, sw-addrmethod=CONST, symbol=CONST_UNSPECIFIED
        CRC_VAR_CLEARED_BOOLEAN: alignment=BOOLEAN, sw-addrmethod=VAR_CLEARED, symbol=VAR_CLEARED_BOOLEAN
        CRC_VAR_CLEARED_UNSPECIFIED: alignment=UNSPECIFIED, sw-addrmethod=VAR_CLEARED, symbol=VAR_CLEARED_UNSPECIFIED
        CRC_VAR_CLEARED_UNSPECIFIED_NO_CACHEABLE: alignment=UNSPECIFIED, sw-addrmethod=VAR_CLEARED_NO_CACHEABLE, symbol=VAR_CLEARED_UNSPECIFIED_NO_CACHEABLE
        CRC_VAR_INIT_UNSPECIFIED: alignment=UNSPECIFIED, sw-addrmethod=VAR_INIT, symbol=VAR_INIT_UNSPECIFIED
