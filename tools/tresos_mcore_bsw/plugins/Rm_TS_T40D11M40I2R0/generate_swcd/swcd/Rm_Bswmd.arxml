AUTOSAR XML (schema 00046)
package /AUTOSAR_Rm/BswModuleDescriptions
  bsw module description Rm: module-id=255
    provided-entrys:
      Rm_GetVersionInfo
      Rm_Init
      Rm_Mpu_M7_EnableRegion
      Rm_Mpu_M7_GetErrorDetails
      Rm_Mpu_M7_SetAccessRight
      Rm_Mpu_M7_SetRegionConfig
      Rm_SemaphoreGetStatus
      Rm_SemaphoreLockGate
      Rm_SemaphoreResetAllGates
      Rm_SemaphoreResetGate
      Rm_SemaphoreUnlockGate
      Rm_XrdcGetDomainID
      Rm_XrdcGetDomainIDErrorStatus
      Rm_XrdcSetProcessID
    bsw internal behavior InternalBehavior_0
      exclusive area RM_EXCLUSIVE_AREA_00
      14 x bsw called entity:
        Rm_GetVersionInfo: implemented-entry=Rm_GetVersionInfo
        Rm_Init: implemented-entry=Rm_Init
        Rm_Mpu_M7_EnableRegion: implemented-entry=Rm_Mpu_M7_EnableRegion
        Rm_Mpu_M7_GetErrorDetails: implemented-entry=Rm_Mpu_M7_GetErrorDetails
        Rm_Mpu_M7_SetAccessRight: implemented-entry=Rm_Mpu_M7_SetAccessRight
        Rm_Mpu_M7_SetRegionConfig: implemented-entry=Rm_Mpu_M7_SetRegionConfig
        Rm_SemaphoreGetStatus: implemented-entry=Rm_SemaphoreGetStatus
        Rm_SemaphoreLockGate: implemented-entry=Rm_SemaphoreLockGate
        Rm_SemaphoreResetAllGates: implemented-entry=Rm_SemaphoreResetAllGates
        Rm_SemaphoreResetGate: implemented-entry=Rm_SemaphoreResetGate
        Rm_SemaphoreUnlockGate: implemented-entry=Rm_SemaphoreUnlockGate
        Rm_XrdcGetDomainID: implemented-entry=Rm_XrdcGetDomainID
        Rm_XrdcGetDomainIDErrorStatus: implemented-entry=Rm_XrdcGetDomainIDErrorStatus
        Rm_XrdcSetProcessID: can-enter-exclusive-area=RM_EXCLUSIVE_AREA_00, implemented-entry=Rm_XrdcSetProcessID
package /AUTOSAR_Rm/BswModuleEntrys
  14 x bsw module entry, all with is-synchronous=true, call-type=REGULAR, execution-context=UNSPECIFIED, sw-service-impl-policy=STANDARD:
    Rm_GetVersionInfo: service-id=0x01, is-reentrant=true
    Rm_Init: service-id=0x00, is-reentrant=false
    Rm_Mpu_M7_EnableRegion: service-id=0x0a, is-reentrant=false
    Rm_Mpu_M7_GetErrorDetails: service-id=0x0c, is-reentrant=false
    Rm_Mpu_M7_SetAccessRight: service-id=0x0b, is-reentrant=false
    Rm_Mpu_M7_SetRegionConfig: service-id=0x09, is-reentrant=false
    Rm_SemaphoreGetStatus: service-id=0x08, is-reentrant=false
    Rm_SemaphoreLockGate: service-id=0x04, is-reentrant=false
    Rm_SemaphoreResetAllGates: service-id=0x07, is-reentrant=false
    Rm_SemaphoreResetGate: service-id=0x06, is-reentrant=false
    Rm_SemaphoreUnlockGate: service-id=0x05, is-reentrant=false
    Rm_XrdcGetDomainID: service-id=0x03, is-reentrant=false
    Rm_XrdcGetDomainIDErrorStatus: service-id=0x12, is-reentrant=false
    Rm_XrdcSetProcessID: service-id=0x02, is-reentrant=true
package /Rm_TS_T40D11M40I2R0/Implementations
  bsw implementation BswImplementation_0: programming-language=C, sw-version=4.0.2, vendor-id=43, ar-release-version=4.4.0, behavior=InternalBehavior_0, vendor-specific-module-def=Rm
    code-descriptors:
      code Files
        artifact-descriptors:
          short-label=config::Rm.xdm, category=SWCFG
          short-label=doc::RTD_RM_IM.pdf, category=SWDOC
          short-label=doc::RTD_RM_UM.pdf, category=SWDOC
          short-label=examples::EBT::S32G2::Rm_Example_S32G274A_M7::generate::epc::BaseNXP.xdm, category=SWCFG
          short-label=examples::EBT::S32G2::Rm_Example_S32G274A_M7::generate::epc::EcuC.xdm, category=SWCFG
          short-label=examples::EBT::S32G2::Rm_Example_S32G274A_M7::generate::epc::Resource.xdm, category=SWCFG
          short-label=examples::EBT::S32G2::Rm_Example_S32G274A_M7::generate::epc::Rm.xdm, category=SWCFG
          short-label=examples::EBT::S32G2::Rm_Example_S32G274A_M7::include::check_example.h, category=SWHDR
          short-label=examples::EBT::S32G2::Rm_Example_S32G274A_M7::include::Derivative_Cfg.h, category=SWHDR
          short-label=examples::EBT::S32G2::Rm_Example_S32G274A_M7::src::main.c, category=SWSRC
          short-label=examples::EBT::S32G2::Rm_Example_S32G274A_M7::src::sys_init.c, category=SWSRC
          short-label=examples::EBT::S32G2::Rm_Example_S32G274A_M7::TresosProject::Rm_Example_S32G274A_M7::.prefs::preferences.xdm, category=SWCFG
          short-label=examples::EBT::S32G2::Rm_Example_S32G274A_M7::TresosProject::Rm_Example_S32G274A_M7::config::BaseNXP.xdm, category=SWCFG
          short-label=examples::EBT::S32G2::Rm_Example_S32G274A_M7::TresosProject::Rm_Example_S32G274A_M7::config::EcuC.xdm, category=SWCFG
          short-label=examples::EBT::S32G2::Rm_Example_S32G274A_M7::TresosProject::Rm_Example_S32G274A_M7::config::Resource.xdm, category=SWCFG
          short-label=examples::EBT::S32G2::Rm_Example_S32G274A_M7::TresosProject::Rm_Example_S32G274A_M7::config::Rm.xdm, category=SWCFG
          short-label=examples::EBT::S32G2::Rm_Mpu_M7_Example_S32G274A_M7::generate::epc::BaseNXP.xdm, category=SWCFG
          short-label=examples::EBT::S32G2::Rm_Mpu_M7_Example_S32G274A_M7::generate::epc::Resource.xdm, category=SWCFG
          short-label=examples::EBT::S32G2::Rm_Mpu_M7_Example_S32G274A_M7::generate::epc::Rm.xdm, category=SWCFG
          short-label=examples::EBT::S32G2::Rm_Mpu_M7_Example_S32G274A_M7::include::check_example.h, category=SWHDR
          short-label=examples::EBT::S32G2::Rm_Mpu_M7_Example_S32G274A_M7::include::Derivative_Cfg.h, category=SWHDR
          short-label=examples::EBT::S32G2::Rm_Mpu_M7_Example_S32G274A_M7::src::main.c, category=SWSRC
          short-label=examples::EBT::S32G2::Rm_Mpu_M7_Example_S32G274A_M7::TresosProject::Rm_Mpu_M7_Example_S32G274A_M7::.prefs::preferences.xdm, category=SWCFG
          short-label=examples::EBT::S32G2::Rm_Mpu_M7_Example_S32G274A_M7::TresosProject::Rm_Mpu_M7_Example_S32G274A_M7::config::BaseNXP.xdm, category=SWCFG
          short-label=examples::EBT::S32G2::Rm_Mpu_M7_Example_S32G274A_M7::TresosProject::Rm_Mpu_M7_Example_S32G274A_M7::config::EcuC.xdm, category=SWCFG
          short-label=examples::EBT::S32G2::Rm_Mpu_M7_Example_S32G274A_M7::TresosProject::Rm_Mpu_M7_Example_S32G274A_M7::config::Resource.xdm, category=SWCFG
          short-label=examples::EBT::S32G2::Rm_Mpu_M7_Example_S32G274A_M7::TresosProject::Rm_Mpu_M7_Example_S32G274A_M7::config::Rm.xdm, category=SWCFG
          short-label=examples::EBT::S32G2::Rm_Mscm_Example_S32G274A_M7::generate::epc::BaseNXP.xdm, category=SWCFG
          short-label=examples::EBT::S32G2::Rm_Mscm_Example_S32G274A_M7::generate::epc::Platform.xdm, category=SWCFG
          short-label=examples::EBT::S32G2::Rm_Mscm_Example_S32G274A_M7::generate::epc::Resource.xdm, category=SWCFG
          short-label=examples::EBT::S32G2::Rm_Mscm_Example_S32G274A_M7::generate::epc::Rm.xdm, category=SWCFG
          short-label=examples::EBT::S32G2::Rm_Mscm_Example_S32G274A_M7::include::check_example.h, category=SWHDR
          short-label=examples::EBT::S32G2::Rm_Mscm_Example_S32G274A_M7::include::Derivative_Cfg.h, category=SWHDR
          short-label=examples::EBT::S32G2::Rm_Mscm_Example_S32G274A_M7::include::Test_PIT_Timer.h, category=SWHDR
          short-label=examples::EBT::S32G2::Rm_Mscm_Example_S32G274A_M7::src::main.c, category=SWSRC
          short-label=examples::EBT::S32G2::Rm_Mscm_Example_S32G274A_M7::src::sys_init.c, category=SWSRC
          short-label=examples::EBT::S32G2::Rm_Mscm_Example_S32G274A_M7::src::Test_PIT_Timer.c, category=SWSRC
          short-label=examples::EBT::S32G2::Rm_Mscm_Example_S32G274A_M7::TresosProject::Rm_Mscm_Example_S32G274A_M7::.prefs::preferences.xdm, category=SWCFG
          short-label=examples::EBT::S32G2::Rm_Mscm_Example_S32G274A_M7::TresosProject::Rm_Mscm_Example_S32G274A_M7::config::BaseNXP.xdm, category=SWCFG
          short-label=examples::EBT::S32G2::Rm_Mscm_Example_S32G274A_M7::TresosProject::Rm_Mscm_Example_S32G274A_M7::config::EcuC.xdm, category=SWCFG
          short-label=examples::EBT::S32G2::Rm_Mscm_Example_S32G274A_M7::TresosProject::Rm_Mscm_Example_S32G274A_M7::config::Platform.xdm, category=SWCFG
          short-label=examples::EBT::S32G2::Rm_Mscm_Example_S32G274A_M7::TresosProject::Rm_Mscm_Example_S32G274A_M7::config::Resource.xdm, category=SWCFG
          short-label=examples::EBT::S32G2::Rm_Mscm_Example_S32G274A_M7::TresosProject::Rm_Mscm_Example_S32G274A_M7::config::Rm.xdm, category=SWCFG
          short-label=examples::EBT::S32G2::Rm_Semaphore_Example_S32G274A_M7::generate::epc::BaseNXP.xdm, category=SWCFG
          short-label=examples::EBT::S32G2::Rm_Semaphore_Example_S32G274A_M7::generate::epc::EcuC.xdm, category=SWCFG
          short-label=examples::EBT::S32G2::Rm_Semaphore_Example_S32G274A_M7::generate::epc::Mcl.xdm, category=SWCFG
          short-label=examples::EBT::S32G2::Rm_Semaphore_Example_S32G274A_M7::generate::epc::Resource.xdm, category=SWCFG
          short-label=examples::EBT::S32G2::Rm_Semaphore_Example_S32G274A_M7::generate::epc::Rm.xdm, category=SWCFG
          short-label=examples::EBT::S32G2::Rm_Semaphore_Example_S32G274A_M7::include::check_example.h, category=SWHDR
          short-label=examples::EBT::S32G2::Rm_Semaphore_Example_S32G274A_M7::src::main.c, category=SWSRC
          short-label=examples::EBT::S32G2::Rm_Semaphore_Example_S32G274A_M7::src::sys_init.c, category=SWSRC
          short-label=examples::EBT::S32G2::Rm_Semaphore_Example_S32G274A_M7::TresosProject::Rm_Semaphore_Example_S32G274A_M7::.prefs::preferences.xdm, category=SWCFG
          short-label=examples::EBT::S32G2::Rm_Semaphore_Example_S32G274A_M7::TresosProject::Rm_Semaphore_Example_S32G274A_M7::config::BaseNXP.xdm, category=SWCFG
          short-label=examples::EBT::S32G2::Rm_Semaphore_Example_S32G274A_M7::TresosProject::Rm_Semaphore_Example_S32G274A_M7::config::EcuC.xdm, category=SWCFG
          short-label=examples::EBT::S32G2::Rm_Semaphore_Example_S32G274A_M7::TresosProject::Rm_Semaphore_Example_S32G274A_M7::config::Mcl.xdm, category=SWCFG
          short-label=examples::EBT::S32G2::Rm_Semaphore_Example_S32G274A_M7::TresosProject::Rm_Semaphore_Example_S32G274A_M7::config::Resource.xdm, category=SWCFG
          short-label=examples::EBT::S32G2::Rm_Semaphore_Example_S32G274A_M7::TresosProject::Rm_Semaphore_Example_S32G274A_M7::config::Rm.xdm, category=SWCFG
          short-label=examples::EBT::S32G3::Rm_Example_S32G399A_M7::generate::epc::BaseNXP.xdm, category=SWCFG
          short-label=examples::EBT::S32G3::Rm_Example_S32G399A_M7::generate::epc::EcuC.xdm, category=SWCFG
          short-label=examples::EBT::S32G3::Rm_Example_S32G399A_M7::generate::epc::Resource.xdm, category=SWCFG
          short-label=examples::EBT::S32G3::Rm_Example_S32G399A_M7::generate::epc::Rm.xdm, category=SWCFG
          short-label=examples::EBT::S32G3::Rm_Example_S32G399A_M7::include::check_example.h, category=SWHDR
          short-label=examples::EBT::S32G3::Rm_Example_S32G399A_M7::include::Derivative_Cfg.h, category=SWHDR
          short-label=examples::EBT::S32G3::Rm_Example_S32G399A_M7::src::main.c, category=SWSRC
          short-label=examples::EBT::S32G3::Rm_Example_S32G399A_M7::src::sys_init.c, category=SWSRC
          short-label=examples::EBT::S32G3::Rm_Example_S32G399A_M7::TresosProject::Rm_Example_S32G399A_M7::.prefs::preferences.xdm, category=SWCFG
          short-label=examples::EBT::S32G3::Rm_Example_S32G399A_M7::TresosProject::Rm_Example_S32G399A_M7::config::BaseNXP.xdm, category=SWCFG
          short-label=examples::EBT::S32G3::Rm_Example_S32G399A_M7::TresosProject::Rm_Example_S32G399A_M7::config::EcuC.xdm, category=SWCFG
          short-label=examples::EBT::S32G3::Rm_Example_S32G399A_M7::TresosProject::Rm_Example_S32G399A_M7::config::Resource.xdm, category=SWCFG
          short-label=examples::EBT::S32G3::Rm_Example_S32G399A_M7::TresosProject::Rm_Example_S32G399A_M7::config::Rm.xdm, category=SWCFG
          short-label=examples::EBT::S32G3::Rm_Mpu_M7_Example_S32G399A_M7::generate::epc::BaseNXP.xdm, category=SWCFG
          short-label=examples::EBT::S32G3::Rm_Mpu_M7_Example_S32G399A_M7::generate::epc::Resource.xdm, category=SWCFG
          short-label=examples::EBT::S32G3::Rm_Mpu_M7_Example_S32G399A_M7::generate::epc::Rm.xdm, category=SWCFG
          short-label=examples::EBT::S32G3::Rm_Mpu_M7_Example_S32G399A_M7::include::check_example.h, category=SWHDR
          short-label=examples::EBT::S32G3::Rm_Mpu_M7_Example_S32G399A_M7::include::Derivative_Cfg.h, category=SWHDR
          short-label=examples::EBT::S32G3::Rm_Mpu_M7_Example_S32G399A_M7::src::main.c, category=SWSRC
          short-label=examples::EBT::S32G3::Rm_Mpu_M7_Example_S32G399A_M7::TresosProject::Rm_Mpu_M7_Example_S32G399A_M7::.prefs::preferences.xdm, category=SWCFG
          short-label=examples::EBT::S32G3::Rm_Mpu_M7_Example_S32G399A_M7::TresosProject::Rm_Mpu_M7_Example_S32G399A_M7::config::BaseNXP.xdm, category=SWCFG
          short-label=examples::EBT::S32G3::Rm_Mpu_M7_Example_S32G399A_M7::TresosProject::Rm_Mpu_M7_Example_S32G399A_M7::config::EcuC.xdm, category=SWCFG
          short-label=examples::EBT::S32G3::Rm_Mpu_M7_Example_S32G399A_M7::TresosProject::Rm_Mpu_M7_Example_S32G399A_M7::config::Resource.xdm, category=SWCFG
          short-label=examples::EBT::S32G3::Rm_Mpu_M7_Example_S32G399A_M7::TresosProject::Rm_Mpu_M7_Example_S32G399A_M7::config::Rm.xdm, category=SWCFG
          short-label=examples::EBT::S32G3::Rm_Mscm_Example_S32G399A_M7::generate::epc::BaseNXP.xdm, category=SWCFG
          short-label=examples::EBT::S32G3::Rm_Mscm_Example_S32G399A_M7::generate::epc::Platform.xdm, category=SWCFG
          short-label=examples::EBT::S32G3::Rm_Mscm_Example_S32G399A_M7::generate::epc::Resource.xdm, category=SWCFG
          short-label=examples::EBT::S32G3::Rm_Mscm_Example_S32G399A_M7::generate::epc::Rm.xdm, category=SWCFG
          short-label=examples::EBT::S32G3::Rm_Mscm_Example_S32G399A_M7::include::check_example.h, category=SWHDR
          short-label=examples::EBT::S32G3::Rm_Mscm_Example_S32G399A_M7::include::Derivative_Cfg.h, category=SWHDR
          short-label=examples::EBT::S32G3::Rm_Mscm_Example_S32G399A_M7::include::Test_PIT_Timer.h, category=SWHDR
          short-label=examples::EBT::S32G3::Rm_Mscm_Example_S32G399A_M7::src::main.c, category=SWSRC
          short-label=examples::EBT::S32G3::Rm_Mscm_Example_S32G399A_M7::src::sys_init.c, category=SWSRC
          short-label=examples::EBT::S32G3::Rm_Mscm_Example_S32G399A_M7::src::Test_PIT_Timer.c, category=SWSRC
          short-label=examples::EBT::S32G3::Rm_Mscm_Example_S32G399A_M7::TresosProject::Rm_Mscm_Example_S32G399A_M7::.prefs::preferences.xdm, category=SWCFG
          short-label=examples::EBT::S32G3::Rm_Mscm_Example_S32G399A_M7::TresosProject::Rm_Mscm_Example_S32G399A_M7::config::BaseNXP.xdm, category=SWCFG
          short-label=examples::EBT::S32G3::Rm_Mscm_Example_S32G399A_M7::TresosProject::Rm_Mscm_Example_S32G399A_M7::config::EcuC.xdm, category=SWCFG
          short-label=examples::EBT::S32G3::Rm_Mscm_Example_S32G399A_M7::TresosProject::Rm_Mscm_Example_S32G399A_M7::config::Platform.xdm, category=SWCFG
          short-label=examples::EBT::S32G3::Rm_Mscm_Example_S32G399A_M7::TresosProject::Rm_Mscm_Example_S32G399A_M7::config::Resource.xdm, category=SWCFG
          short-label=examples::EBT::S32G3::Rm_Mscm_Example_S32G399A_M7::TresosProject::Rm_Mscm_Example_S32G399A_M7::config::Rm.xdm, category=SWCFG
          short-label=examples::EBT::S32G3::Rm_Semaphore_Example_S32G399A_M7::generate::epc::BaseNXP.xdm, category=SWCFG
          short-label=examples::EBT::S32G3::Rm_Semaphore_Example_S32G399A_M7::generate::epc::EcuC.xdm, category=SWCFG
          short-label=examples::EBT::S32G3::Rm_Semaphore_Example_S32G399A_M7::generate::epc::Mcl.xdm, category=SWCFG
          short-label=examples::EBT::S32G3::Rm_Semaphore_Example_S32G399A_M7::generate::epc::Resource.xdm, category=SWCFG
          short-label=examples::EBT::S32G3::Rm_Semaphore_Example_S32G399A_M7::generate::epc::Rm.xdm, category=SWCFG
          short-label=examples::EBT::S32G3::Rm_Semaphore_Example_S32G399A_M7::include::check_example.h, category=SWHDR
          short-label=examples::EBT::S32G3::Rm_Semaphore_Example_S32G399A_M7::src::main.c, category=SWSRC
          short-label=examples::EBT::S32G3::Rm_Semaphore_Example_S32G399A_M7::src::sys_init.c, category=SWSRC
          short-label=examples::EBT::S32G3::Rm_Semaphore_Example_S32G399A_M7::TresosProject::Rm_Semaphore_Example_S32G399A_M7::.prefs::preferences.xdm, category=SWCFG
          short-label=examples::EBT::S32G3::Rm_Semaphore_Example_S32G399A_M7::TresosProject::Rm_Semaphore_Example_S32G399A_M7::config::BaseNXP.xdm, category=SWCFG
          short-label=examples::EBT::S32G3::Rm_Semaphore_Example_S32G399A_M7::TresosProject::Rm_Semaphore_Example_S32G399A_M7::config::EcuC.xdm, category=SWCFG
          short-label=examples::EBT::S32G3::Rm_Semaphore_Example_S32G399A_M7::TresosProject::Rm_Semaphore_Example_S32G399A_M7::config::Mcl.xdm, category=SWCFG
          short-label=examples::EBT::S32G3::Rm_Semaphore_Example_S32G399A_M7::TresosProject::Rm_Semaphore_Example_S32G399A_M7::config::Resource.xdm, category=SWCFG
          short-label=examples::EBT::S32G3::Rm_Semaphore_Example_S32G399A_M7::TresosProject::Rm_Semaphore_Example_S32G399A_M7::config::Rm.xdm, category=SWCFG
          short-label=examples::EBT::S32R45::Rm_Example_S32R45_M7::generate::epc::BaseNXP.xdm, category=SWCFG
          short-label=examples::EBT::S32R45::Rm_Example_S32R45_M7::generate::epc::EcuC.xdm, category=SWCFG
          short-label=examples::EBT::S32R45::Rm_Example_S32R45_M7::generate::epc::Resource.xdm, category=SWCFG
          short-label=examples::EBT::S32R45::Rm_Example_S32R45_M7::generate::epc::Rm.xdm, category=SWCFG
          short-label=examples::EBT::S32R45::Rm_Example_S32R45_M7::include::check_example.h, category=SWHDR
          short-label=examples::EBT::S32R45::Rm_Example_S32R45_M7::include::Derivative_Cfg.h, category=SWHDR
          short-label=examples::EBT::S32R45::Rm_Example_S32R45_M7::src::main.c, category=SWSRC
          short-label=examples::EBT::S32R45::Rm_Example_S32R45_M7::src::sys_init.c, category=SWSRC
          short-label=examples::EBT::S32R45::Rm_Example_S32R45_M7::TresosProject::Rm_Example_S32R45_M7::.prefs::preferences.xdm, category=SWCFG
          short-label=examples::EBT::S32R45::Rm_Example_S32R45_M7::TresosProject::Rm_Example_S32R45_M7::config::BaseNXP.xdm, category=SWCFG
          short-label=examples::EBT::S32R45::Rm_Example_S32R45_M7::TresosProject::Rm_Example_S32R45_M7::config::EcuC.xdm, category=SWCFG
          short-label=examples::EBT::S32R45::Rm_Example_S32R45_M7::TresosProject::Rm_Example_S32R45_M7::config::Resource.xdm, category=SWCFG
          short-label=examples::EBT::S32R45::Rm_Example_S32R45_M7::TresosProject::Rm_Example_S32R45_M7::config::Rm.xdm, category=SWCFG
          short-label=examples::EBT::S32R45::Rm_Mpu_M7_Example_S32R45_M7::generate::epc::BaseNXP.xdm, category=SWCFG
          short-label=examples::EBT::S32R45::Rm_Mpu_M7_Example_S32R45_M7::generate::epc::Resource.xdm, category=SWCFG
          short-label=examples::EBT::S32R45::Rm_Mpu_M7_Example_S32R45_M7::generate::epc::Rm.xdm, category=SWCFG
          short-label=examples::EBT::S32R45::Rm_Mpu_M7_Example_S32R45_M7::include::check_example.h, category=SWHDR
          short-label=examples::EBT::S32R45::Rm_Mpu_M7_Example_S32R45_M7::include::Derivative_Cfg.h, category=SWHDR
          short-label=examples::EBT::S32R45::Rm_Mpu_M7_Example_S32R45_M7::src::main.c, category=SWSRC
          short-label=examples::EBT::S32R45::Rm_Mpu_M7_Example_S32R45_M7::TresosProject::Rm_Mpu_M7_Example_S32R45_M7::.prefs::preferences.xdm, category=SWCFG
          short-label=examples::EBT::S32R45::Rm_Mpu_M7_Example_S32R45_M7::TresosProject::Rm_Mpu_M7_Example_S32R45_M7::config::BaseNXP.xdm, category=SWCFG
          short-label=examples::EBT::S32R45::Rm_Mpu_M7_Example_S32R45_M7::TresosProject::Rm_Mpu_M7_Example_S32R45_M7::config::EcuC.xdm, category=SWCFG
          short-label=examples::EBT::S32R45::Rm_Mpu_M7_Example_S32R45_M7::TresosProject::Rm_Mpu_M7_Example_S32R45_M7::config::Resource.xdm, category=SWCFG
          short-label=examples::EBT::S32R45::Rm_Mpu_M7_Example_S32R45_M7::TresosProject::Rm_Mpu_M7_Example_S32R45_M7::config::Rm.xdm, category=SWCFG
          short-label=examples::EBT::S32R45::Rm_Mscm_Example_S32R45_M7::generate::epc::BaseNXP.xdm, category=SWCFG
          short-label=examples::EBT::S32R45::Rm_Mscm_Example_S32R45_M7::generate::epc::Platform.xdm, category=SWCFG
          short-label=examples::EBT::S32R45::Rm_Mscm_Example_S32R45_M7::generate::epc::Resource.xdm, category=SWCFG
          short-label=examples::EBT::S32R45::Rm_Mscm_Example_S32R45_M7::generate::epc::Rm.xdm, category=SWCFG
          short-label=examples::EBT::S32R45::Rm_Mscm_Example_S32R45_M7::include::check_example.h, category=SWHDR
          short-label=examples::EBT::S32R45::Rm_Mscm_Example_S32R45_M7::include::Derivative_Cfg.h, category=SWHDR
          short-label=examples::EBT::S32R45::Rm_Mscm_Example_S32R45_M7::include::Test_PIT_Timer.h, category=SWHDR
          short-label=examples::EBT::S32R45::Rm_Mscm_Example_S32R45_M7::src::main.c, category=SWSRC
          short-label=examples::EBT::S32R45::Rm_Mscm_Example_S32R45_M7::src::sys_init.c, category=SWSRC
          short-label=examples::EBT::S32R45::Rm_Mscm_Example_S32R45_M7::src::Test_PIT_Timer.c, category=SWSRC
          short-label=examples::EBT::S32R45::Rm_Mscm_Example_S32R45_M7::TresosProject::Rm_Mscm_Example_S32R45_M7::.prefs::preferences.xdm, category=SWCFG
          short-label=examples::EBT::S32R45::Rm_Mscm_Example_S32R45_M7::TresosProject::Rm_Mscm_Example_S32R45_M7::config::BaseNXP.xdm, category=SWCFG
          short-label=examples::EBT::S32R45::Rm_Mscm_Example_S32R45_M7::TresosProject::Rm_Mscm_Example_S32R45_M7::config::EcuC.xdm, category=SWCFG
          short-label=examples::EBT::S32R45::Rm_Mscm_Example_S32R45_M7::TresosProject::Rm_Mscm_Example_S32R45_M7::config::Platform.xdm, category=SWCFG
          short-label=examples::EBT::S32R45::Rm_Mscm_Example_S32R45_M7::TresosProject::Rm_Mscm_Example_S32R45_M7::config::Resource.xdm, category=SWCFG
          short-label=examples::EBT::S32R45::Rm_Mscm_Example_S32R45_M7::TresosProject::Rm_Mscm_Example_S32R45_M7::config::Rm.xdm, category=SWCFG
          short-label=examples::EBT::S32R45::Rm_Semaphore_Example_S32R45_M7::generate::epc::BaseNXP.xdm, category=SWCFG
          short-label=examples::EBT::S32R45::Rm_Semaphore_Example_S32R45_M7::generate::epc::EcuC.xdm, category=SWCFG
          short-label=examples::EBT::S32R45::Rm_Semaphore_Example_S32R45_M7::generate::epc::Mcl.xdm, category=SWCFG
          short-label=examples::EBT::S32R45::Rm_Semaphore_Example_S32R45_M7::generate::epc::Resource.xdm, category=SWCFG
          short-label=examples::EBT::S32R45::Rm_Semaphore_Example_S32R45_M7::generate::epc::Rm.xdm, category=SWCFG
          short-label=examples::EBT::S32R45::Rm_Semaphore_Example_S32R45_M7::include::check_example.h, category=SWHDR
          short-label=examples::EBT::S32R45::Rm_Semaphore_Example_S32R45_M7::src::main.c, category=SWSRC
          short-label=examples::EBT::S32R45::Rm_Semaphore_Example_S32R45_M7::src::sys_init.c, category=SWSRC
          short-label=examples::EBT::S32R45::Rm_Semaphore_Example_S32R45_M7::TresosProject::Rm_Semaphore_Example_S32R45_M7::.prefs::preferences.xdm, category=SWCFG
          short-label=examples::EBT::S32R45::Rm_Semaphore_Example_S32R45_M7::TresosProject::Rm_Semaphore_Example_S32R45_M7::config::BaseNXP.xdm, category=SWCFG
          short-label=examples::EBT::S32R45::Rm_Semaphore_Example_S32R45_M7::TresosProject::Rm_Semaphore_Example_S32R45_M7::config::EcuC.xdm, category=SWCFG
          short-label=examples::EBT::S32R45::Rm_Semaphore_Example_S32R45_M7::TresosProject::Rm_Semaphore_Example_S32R45_M7::config::Mcl.xdm, category=SWCFG
          short-label=examples::EBT::S32R45::Rm_Semaphore_Example_S32R45_M7::TresosProject::Rm_Semaphore_Example_S32R45_M7::config::Resource.xdm, category=SWCFG
          short-label=examples::EBT::S32R45::Rm_Semaphore_Example_S32R45_M7::TresosProject::Rm_Semaphore_Example_S32R45_M7::config::Rm.xdm, category=SWCFG
          short-label=examples::S32DS::S32G2::Mpu_M7_Ip_Example_S32G274A_M7::include::check_example.h, category=SWHDR
          short-label=examples::S32DS::S32G2::Mpu_M7_Ip_Example_S32G274A_M7::include::Derivative_Cfg.h, category=SWHDR
          short-label=examples::S32DS::S32G2::Mpu_M7_Ip_Example_S32G274A_M7::Project_Settings::Startup_Code::exceptions.c, category=SWSRC
          short-label=examples::S32DS::S32G2::Mpu_M7_Ip_Example_S32G274A_M7::Project_Settings::Startup_Code::nvic.c, category=SWSRC
          short-label=examples::S32DS::S32G2::Mpu_M7_Ip_Example_S32G274A_M7::Project_Settings::Startup_Code::startup.c, category=SWSRC
          short-label=examples::S32DS::S32G2::Mpu_M7_Ip_Example_S32G274A_M7::Project_Settings::Startup_Code::system.c, category=SWSRC
          short-label=examples::S32DS::S32G2::Mpu_M7_Ip_Example_S32G274A_M7::src::main.c, category=SWSRC
          short-label=examples::S32DS::S32G2::Mscm_Ip_Example_S32G274A_M7::include::check_example.h, category=SWHDR
          short-label=examples::S32DS::S32G2::Mscm_Ip_Example_S32G274A_M7::include::Test_PIT_Timer.h, category=SWHDR
          short-label=examples::S32DS::S32G2::Mscm_Ip_Example_S32G274A_M7::Project_Settings::Startup_Code::exceptions.c, category=SWSRC
          short-label=examples::S32DS::S32G2::Mscm_Ip_Example_S32G274A_M7::Project_Settings::Startup_Code::nvic.c, category=SWSRC
          short-label=examples::S32DS::S32G2::Mscm_Ip_Example_S32G274A_M7::Project_Settings::Startup_Code::startup.c, category=SWSRC
          short-label=examples::S32DS::S32G2::Mscm_Ip_Example_S32G274A_M7::Project_Settings::Startup_Code::system.c, category=SWSRC
          short-label=examples::S32DS::S32G2::Mscm_Ip_Example_S32G274A_M7::src::main.c, category=SWSRC
          short-label=examples::S32DS::S32G2::Mscm_Ip_Example_S32G274A_M7::src::sys_init.c, category=SWSRC
          short-label=examples::S32DS::S32G2::Mscm_Ip_Example_S32G274A_M7::src::Test_PIT_Timer.c, category=SWSRC
          short-label=examples::S32DS::S32G2::Rm_Example_S32G274A_M7::include::check_example.h, category=SWHDR
          short-label=examples::S32DS::S32G2::Rm_Example_S32G274A_M7::include::Derivative_Cfg.h, category=SWHDR
          short-label=examples::S32DS::S32G2::Rm_Example_S32G274A_M7::Project_Settings::Startup_Code::exceptions.c, category=SWSRC
          short-label=examples::S32DS::S32G2::Rm_Example_S32G274A_M7::Project_Settings::Startup_Code::nvic.c, category=SWSRC
          short-label=examples::S32DS::S32G2::Rm_Example_S32G274A_M7::Project_Settings::Startup_Code::startup.c, category=SWSRC
          short-label=examples::S32DS::S32G2::Rm_Example_S32G274A_M7::Project_Settings::Startup_Code::system.c, category=SWSRC
          short-label=examples::S32DS::S32G2::Rm_Example_S32G274A_M7::src::main.c, category=SWSRC
          short-label=examples::S32DS::S32G2::Rm_Example_S32G274A_M7::src::sys_init.c, category=SWSRC
          short-label=examples::S32DS::S32G2::Rm_Mpu_M7_Example_S32G274A_M7::include::check_example.h, category=SWHDR
          short-label=examples::S32DS::S32G2::Rm_Mpu_M7_Example_S32G274A_M7::include::Derivative_Cfg.h, category=SWHDR
          short-label=examples::S32DS::S32G2::Rm_Mpu_M7_Example_S32G274A_M7::Project_Settings::Startup_Code::exceptions.c, category=SWSRC
          short-label=examples::S32DS::S32G2::Rm_Mpu_M7_Example_S32G274A_M7::Project_Settings::Startup_Code::nvic.c, category=SWSRC
          short-label=examples::S32DS::S32G2::Rm_Mpu_M7_Example_S32G274A_M7::Project_Settings::Startup_Code::startup.c, category=SWSRC
          short-label=examples::S32DS::S32G2::Rm_Mpu_M7_Example_S32G274A_M7::Project_Settings::Startup_Code::system.c, category=SWSRC
          short-label=examples::S32DS::S32G2::Rm_Mpu_M7_Example_S32G274A_M7::src::main.c, category=SWSRC
          short-label=examples::S32DS::S32G2::Rm_Mscm_Example_S32G274A_M7::include::check_example.h, category=SWHDR
          short-label=examples::S32DS::S32G2::Rm_Mscm_Example_S32G274A_M7::include::Derivative_Cfg.h, category=SWHDR
          short-label=examples::S32DS::S32G2::Rm_Mscm_Example_S32G274A_M7::include::Test_PIT_Timer.h, category=SWHDR
          short-label=examples::S32DS::S32G2::Rm_Mscm_Example_S32G274A_M7::Project_Settings::Startup_Code::exceptions.c, category=SWSRC
          short-label=examples::S32DS::S32G2::Rm_Mscm_Example_S32G274A_M7::Project_Settings::Startup_Code::nvic.c, category=SWSRC
          short-label=examples::S32DS::S32G2::Rm_Mscm_Example_S32G274A_M7::Project_Settings::Startup_Code::startup.c, category=SWSRC
          short-label=examples::S32DS::S32G2::Rm_Mscm_Example_S32G274A_M7::Project_Settings::Startup_Code::system.c, category=SWSRC
          short-label=examples::S32DS::S32G2::Rm_Mscm_Example_S32G274A_M7::src::main.c, category=SWSRC
          short-label=examples::S32DS::S32G2::Rm_Mscm_Example_S32G274A_M7::src::sys_init.c, category=SWSRC
          short-label=examples::S32DS::S32G2::Rm_Mscm_Example_S32G274A_M7::src::Test_PIT_Timer.c, category=SWSRC
          short-label=examples::S32DS::S32G2::Rm_Semaphore_Example_S32G274A_M7::include::check_example.h, category=SWHDR
          short-label=examples::S32DS::S32G2::Rm_Semaphore_Example_S32G274A_M7::Project_Settings::Startup_Code::exceptions.c, category=SWSRC
          short-label=examples::S32DS::S32G2::Rm_Semaphore_Example_S32G274A_M7::Project_Settings::Startup_Code::nvic.c, category=SWSRC
          short-label=examples::S32DS::S32G2::Rm_Semaphore_Example_S32G274A_M7::Project_Settings::Startup_Code::startup.c, category=SWSRC
          short-label=examples::S32DS::S32G2::Rm_Semaphore_Example_S32G274A_M7::Project_Settings::Startup_Code::system.c, category=SWSRC
          short-label=examples::S32DS::S32G2::Rm_Semaphore_Example_S32G274A_M7::src::main.c, category=SWSRC
          short-label=examples::S32DS::S32G2::Rm_Semaphore_Example_S32G274A_M7::src::sys_init.c, category=SWSRC
          short-label=examples::S32DS::S32G2::Semaphore_Ip_Example_S32G274A_M7::include::check_example.h, category=SWHDR
          short-label=examples::S32DS::S32G2::Semaphore_Ip_Example_S32G274A_M7::Project_Settings::Startup_Code::exceptions.c, category=SWSRC
          short-label=examples::S32DS::S32G2::Semaphore_Ip_Example_S32G274A_M7::Project_Settings::Startup_Code::nvic.c, category=SWSRC
          short-label=examples::S32DS::S32G2::Semaphore_Ip_Example_S32G274A_M7::Project_Settings::Startup_Code::startup.c, category=SWSRC
          short-label=examples::S32DS::S32G2::Semaphore_Ip_Example_S32G274A_M7::Project_Settings::Startup_Code::system.c, category=SWSRC
          short-label=examples::S32DS::S32G2::Semaphore_Ip_Example_S32G274A_M7::src::main.c, category=SWSRC
          short-label=examples::S32DS::S32G2::Semaphore_Ip_Example_S32G274A_M7::src::sys_init.c, category=SWSRC
          short-label=examples::S32DS::S32G2::Xrdc_Ip_Example_S32G274A_M7::include::check_example.h, category=SWHDR
          short-label=examples::S32DS::S32G2::Xrdc_Ip_Example_S32G274A_M7::Project_Settings::Startup_Code::exceptions.c, category=SWSRC
          short-label=examples::S32DS::S32G2::Xrdc_Ip_Example_S32G274A_M7::Project_Settings::Startup_Code::nvic.c, category=SWSRC
          short-label=examples::S32DS::S32G2::Xrdc_Ip_Example_S32G274A_M7::Project_Settings::Startup_Code::startup.c, category=SWSRC
          short-label=examples::S32DS::S32G2::Xrdc_Ip_Example_S32G274A_M7::Project_Settings::Startup_Code::system.c, category=SWSRC
          short-label=examples::S32DS::S32G2::Xrdc_Ip_Example_S32G274A_M7::src::main.c, category=SWSRC
          short-label=examples::S32DS::S32G2::Xrdc_Ip_Example_S32G274A_M7::src::sys_init.c, category=SWSRC
          short-label=examples::S32DS::S32G3::Mpu_M7_Ip_Example_S32G399A_M7::include::check_example.h, category=SWHDR
          short-label=examples::S32DS::S32G3::Mpu_M7_Ip_Example_S32G399A_M7::include::Derivative_Cfg.h, category=SWHDR
          short-label=examples::S32DS::S32G3::Mpu_M7_Ip_Example_S32G399A_M7::Project_Settings::Startup_Code::exceptions.c, category=SWSRC
          short-label=examples::S32DS::S32G3::Mpu_M7_Ip_Example_S32G399A_M7::Project_Settings::Startup_Code::nvic.c, category=SWSRC
          short-label=examples::S32DS::S32G3::Mpu_M7_Ip_Example_S32G399A_M7::Project_Settings::Startup_Code::startup.c, category=SWSRC
          short-label=examples::S32DS::S32G3::Mpu_M7_Ip_Example_S32G399A_M7::Project_Settings::Startup_Code::system.c, category=SWSRC
          short-label=examples::S32DS::S32G3::Mpu_M7_Ip_Example_S32G399A_M7::src::main.c, category=SWSRC
          short-label=examples::S32DS::S32G3::Mscm_Ip_Example_S32G399A_M7::include::check_example.h, category=SWHDR
          short-label=examples::S32DS::S32G3::Mscm_Ip_Example_S32G399A_M7::include::Test_PIT_Timer.h, category=SWHDR
          short-label=examples::S32DS::S32G3::Mscm_Ip_Example_S32G399A_M7::Project_Settings::Startup_Code::exceptions.c, category=SWSRC
          short-label=examples::S32DS::S32G3::Mscm_Ip_Example_S32G399A_M7::Project_Settings::Startup_Code::nvic.c, category=SWSRC
          short-label=examples::S32DS::S32G3::Mscm_Ip_Example_S32G399A_M7::Project_Settings::Startup_Code::startup.c, category=SWSRC
          short-label=examples::S32DS::S32G3::Mscm_Ip_Example_S32G399A_M7::Project_Settings::Startup_Code::system.c, category=SWSRC
          short-label=examples::S32DS::S32G3::Mscm_Ip_Example_S32G399A_M7::src::main.c, category=SWSRC
          short-label=examples::S32DS::S32G3::Mscm_Ip_Example_S32G399A_M7::src::sys_init.c, category=SWSRC
          short-label=examples::S32DS::S32G3::Mscm_Ip_Example_S32G399A_M7::src::Test_PIT_Timer.c, category=SWSRC
          short-label=examples::S32DS::S32G3::Rm_Example_S32G399A_M7::include::check_example.h, category=SWHDR
          short-label=examples::S32DS::S32G3::Rm_Example_S32G399A_M7::include::Derivative_Cfg.h, category=SWHDR
          short-label=examples::S32DS::S32G3::Rm_Example_S32G399A_M7::Project_Settings::Startup_Code::exceptions.c, category=SWSRC
          short-label=examples::S32DS::S32G3::Rm_Example_S32G399A_M7::Project_Settings::Startup_Code::nvic.c, category=SWSRC
          short-label=examples::S32DS::S32G3::Rm_Example_S32G399A_M7::Project_Settings::Startup_Code::startup.c, category=SWSRC
          short-label=examples::S32DS::S32G3::Rm_Example_S32G399A_M7::Project_Settings::Startup_Code::system.c, category=SWSRC
          short-label=examples::S32DS::S32G3::Rm_Example_S32G399A_M7::src::main.c, category=SWSRC
          short-label=examples::S32DS::S32G3::Rm_Example_S32G399A_M7::src::sys_init.c, category=SWSRC
          short-label=examples::S32DS::S32G3::Rm_Mpu_M7_Example_S32G399A_M7::include::check_example.h, category=SWHDR
          short-label=examples::S32DS::S32G3::Rm_Mpu_M7_Example_S32G399A_M7::include::Derivative_Cfg.h, category=SWHDR
          short-label=examples::S32DS::S32G3::Rm_Mpu_M7_Example_S32G399A_M7::Project_Settings::Startup_Code::exceptions.c, category=SWSRC
          short-label=examples::S32DS::S32G3::Rm_Mpu_M7_Example_S32G399A_M7::Project_Settings::Startup_Code::nvic.c, category=SWSRC
          short-label=examples::S32DS::S32G3::Rm_Mpu_M7_Example_S32G399A_M7::Project_Settings::Startup_Code::startup.c, category=SWSRC
          short-label=examples::S32DS::S32G3::Rm_Mpu_M7_Example_S32G399A_M7::Project_Settings::Startup_Code::system.c, category=SWSRC
          short-label=examples::S32DS::S32G3::Rm_Mpu_M7_Example_S32G399A_M7::src::main.c, category=SWSRC
          short-label=examples::S32DS::S32G3::Rm_Mscm_Example_S32G399A_M7::include::check_example.h, category=SWHDR
          short-label=examples::S32DS::S32G3::Rm_Mscm_Example_S32G399A_M7::include::Derivative_Cfg.h, category=SWHDR
          short-label=examples::S32DS::S32G3::Rm_Mscm_Example_S32G399A_M7::include::Test_PIT_Timer.h, category=SWHDR
          short-label=examples::S32DS::S32G3::Rm_Mscm_Example_S32G399A_M7::Project_Settings::Startup_Code::exceptions.c, category=SWSRC
          short-label=examples::S32DS::S32G3::Rm_Mscm_Example_S32G399A_M7::Project_Settings::Startup_Code::nvic.c, category=SWSRC
          short-label=examples::S32DS::S32G3::Rm_Mscm_Example_S32G399A_M7::Project_Settings::Startup_Code::startup.c, category=SWSRC
          short-label=examples::S32DS::S32G3::Rm_Mscm_Example_S32G399A_M7::Project_Settings::Startup_Code::system.c, category=SWSRC
          short-label=examples::S32DS::S32G3::Rm_Mscm_Example_S32G399A_M7::src::main.c, category=SWSRC
          short-label=examples::S32DS::S32G3::Rm_Mscm_Example_S32G399A_M7::src::sys_init.c, category=SWSRC
          short-label=examples::S32DS::S32G3::Rm_Mscm_Example_S32G399A_M7::src::Test_PIT_Timer.c, category=SWSRC
          short-label=examples::S32DS::S32G3::Rm_Semaphore_Example_S32G399A_M7::include::check_example.h, category=SWHDR
          short-label=examples::S32DS::S32G3::Rm_Semaphore_Example_S32G399A_M7::Project_Settings::Startup_Code::exceptions.c, category=SWSRC
          short-label=examples::S32DS::S32G3::Rm_Semaphore_Example_S32G399A_M7::Project_Settings::Startup_Code::nvic.c, category=SWSRC
          short-label=examples::S32DS::S32G3::Rm_Semaphore_Example_S32G399A_M7::Project_Settings::Startup_Code::startup.c, category=SWSRC
          short-label=examples::S32DS::S32G3::Rm_Semaphore_Example_S32G399A_M7::Project_Settings::Startup_Code::system.c, category=SWSRC
          short-label=examples::S32DS::S32G3::Rm_Semaphore_Example_S32G399A_M7::src::main.c, category=SWSRC
          short-label=examples::S32DS::S32G3::Rm_Semaphore_Example_S32G399A_M7::src::sys_init.c, category=SWSRC
          short-label=examples::S32DS::S32G3::Semaphore_Ip_Example_S32G399A_M7::include::check_example.h, category=SWHDR
          short-label=examples::S32DS::S32G3::Semaphore_Ip_Example_S32G399A_M7::Project_Settings::Startup_Code::exceptions.c, category=SWSRC
          short-label=examples::S32DS::S32G3::Semaphore_Ip_Example_S32G399A_M7::Project_Settings::Startup_Code::nvic.c, category=SWSRC
          short-label=examples::S32DS::S32G3::Semaphore_Ip_Example_S32G399A_M7::Project_Settings::Startup_Code::startup.c, category=SWSRC
          short-label=examples::S32DS::S32G3::Semaphore_Ip_Example_S32G399A_M7::Project_Settings::Startup_Code::system.c, category=SWSRC
          short-label=examples::S32DS::S32G3::Semaphore_Ip_Example_S32G399A_M7::src::main.c, category=SWSRC
          short-label=examples::S32DS::S32G3::Semaphore_Ip_Example_S32G399A_M7::src::sys_init.c, category=SWSRC
          short-label=examples::S32DS::S32G3::Xrdc_Ip_Example_S32G399A_M7::include::check_example.h, category=SWHDR
          short-label=examples::S32DS::S32G3::Xrdc_Ip_Example_S32G399A_M7::Project_Settings::Startup_Code::exceptions.c, category=SWSRC
          short-label=examples::S32DS::S32G3::Xrdc_Ip_Example_S32G399A_M7::Project_Settings::Startup_Code::nvic.c, category=SWSRC
          short-label=examples::S32DS::S32G3::Xrdc_Ip_Example_S32G399A_M7::Project_Settings::Startup_Code::startup.c, category=SWSRC
          short-label=examples::S32DS::S32G3::Xrdc_Ip_Example_S32G399A_M7::Project_Settings::Startup_Code::system.c, category=SWSRC
          short-label=examples::S32DS::S32G3::Xrdc_Ip_Example_S32G399A_M7::src::main.c, category=SWSRC
          short-label=examples::S32DS::S32G3::Xrdc_Ip_Example_S32G399A_M7::src::sys_init.c, category=SWSRC
          short-label=examples::S32DS::S32R45::Mpu_M7_Ip_Example_S32R45_M7::include::check_example.h, category=SWHDR
          short-label=examples::S32DS::S32R45::Mpu_M7_Ip_Example_S32R45_M7::include::Derivative_Cfg.h, category=SWHDR
          short-label=examples::S32DS::S32R45::Mpu_M7_Ip_Example_S32R45_M7::Project_Settings::Startup_Code::exceptions.c, category=SWSRC
          short-label=examples::S32DS::S32R45::Mpu_M7_Ip_Example_S32R45_M7::Project_Settings::Startup_Code::nvic.c, category=SWSRC
          short-label=examples::S32DS::S32R45::Mpu_M7_Ip_Example_S32R45_M7::Project_Settings::Startup_Code::startup.c, category=SWSRC
          short-label=examples::S32DS::S32R45::Mpu_M7_Ip_Example_S32R45_M7::Project_Settings::Startup_Code::system.c, category=SWSRC
          short-label=examples::S32DS::S32R45::Mpu_M7_Ip_Example_S32R45_M7::src::main.c, category=SWSRC
          short-label=examples::S32DS::S32R45::Mscm_Ip_Example_S32R45_M7::include::check_example.h, category=SWHDR
          short-label=examples::S32DS::S32R45::Mscm_Ip_Example_S32R45_M7::include::Test_PIT_Timer.h, category=SWHDR
          short-label=examples::S32DS::S32R45::Mscm_Ip_Example_S32R45_M7::Project_Settings::Startup_Code::exceptions.c, category=SWSRC
          short-label=examples::S32DS::S32R45::Mscm_Ip_Example_S32R45_M7::Project_Settings::Startup_Code::nvic.c, category=SWSRC
          short-label=examples::S32DS::S32R45::Mscm_Ip_Example_S32R45_M7::Project_Settings::Startup_Code::startup.c, category=SWSRC
          short-label=examples::S32DS::S32R45::Mscm_Ip_Example_S32R45_M7::Project_Settings::Startup_Code::system.c, category=SWSRC
          short-label=examples::S32DS::S32R45::Mscm_Ip_Example_S32R45_M7::src::main.c, category=SWSRC
          short-label=examples::S32DS::S32R45::Mscm_Ip_Example_S32R45_M7::src::sys_init.c, category=SWSRC
          short-label=examples::S32DS::S32R45::Mscm_Ip_Example_S32R45_M7::src::Test_PIT_Timer.c, category=SWSRC
          short-label=examples::S32DS::S32R45::Rm_Example_S32R45_M7::include::check_example.h, category=SWHDR
          short-label=examples::S32DS::S32R45::Rm_Example_S32R45_M7::include::Derivative_Cfg.h, category=SWHDR
          short-label=examples::S32DS::S32R45::Rm_Example_S32R45_M7::Project_Settings::Startup_Code::exceptions.c, category=SWSRC
          short-label=examples::S32DS::S32R45::Rm_Example_S32R45_M7::Project_Settings::Startup_Code::nvic.c, category=SWSRC
          short-label=examples::S32DS::S32R45::Rm_Example_S32R45_M7::Project_Settings::Startup_Code::startup.c, category=SWSRC
          short-label=examples::S32DS::S32R45::Rm_Example_S32R45_M7::Project_Settings::Startup_Code::system.c, category=SWSRC
          short-label=examples::S32DS::S32R45::Rm_Example_S32R45_M7::src::main.c, category=SWSRC
          short-label=examples::S32DS::S32R45::Rm_Example_S32R45_M7::src::sys_init.c, category=SWSRC
          short-label=examples::S32DS::S32R45::Rm_Mpu_M7_Example_S32R45_M7::include::check_example.h, category=SWHDR
          short-label=examples::S32DS::S32R45::Rm_Mpu_M7_Example_S32R45_M7::include::Derivative_Cfg.h, category=SWHDR
          short-label=examples::S32DS::S32R45::Rm_Mpu_M7_Example_S32R45_M7::Project_Settings::Startup_Code::exceptions.c, category=SWSRC
          short-label=examples::S32DS::S32R45::Rm_Mpu_M7_Example_S32R45_M7::Project_Settings::Startup_Code::nvic.c, category=SWSRC
          short-label=examples::S32DS::S32R45::Rm_Mpu_M7_Example_S32R45_M7::Project_Settings::Startup_Code::startup.c, category=SWSRC
          short-label=examples::S32DS::S32R45::Rm_Mpu_M7_Example_S32R45_M7::Project_Settings::Startup_Code::system.c, category=SWSRC
          short-label=examples::S32DS::S32R45::Rm_Mpu_M7_Example_S32R45_M7::src::main.c, category=SWSRC
          short-label=examples::S32DS::S32R45::Rm_Mscm_Example_S32R45_M7::include::check_example.h, category=SWHDR
          short-label=examples::S32DS::S32R45::Rm_Mscm_Example_S32R45_M7::include::Derivative_Cfg.h, category=SWHDR
          short-label=examples::S32DS::S32R45::Rm_Mscm_Example_S32R45_M7::include::Test_PIT_Timer.h, category=SWHDR
          short-label=examples::S32DS::S32R45::Rm_Mscm_Example_S32R45_M7::Project_Settings::Startup_Code::exceptions.c, category=SWSRC
          short-label=examples::S32DS::S32R45::Rm_Mscm_Example_S32R45_M7::Project_Settings::Startup_Code::nvic.c, category=SWSRC
          short-label=examples::S32DS::S32R45::Rm_Mscm_Example_S32R45_M7::Project_Settings::Startup_Code::startup.c, category=SWSRC
          short-label=examples::S32DS::S32R45::Rm_Mscm_Example_S32R45_M7::Project_Settings::Startup_Code::system.c, category=SWSRC
          short-label=examples::S32DS::S32R45::Rm_Mscm_Example_S32R45_M7::src::main.c, category=SWSRC
          short-label=examples::S32DS::S32R45::Rm_Mscm_Example_S32R45_M7::src::sys_init.c, category=SWSRC
          short-label=examples::S32DS::S32R45::Rm_Mscm_Example_S32R45_M7::src::Test_PIT_Timer.c, category=SWSRC
          short-label=examples::S32DS::S32R45::Rm_Semaphore_Example_S32R45_M7::include::check_example.h, category=SWHDR
          short-label=examples::S32DS::S32R45::Rm_Semaphore_Example_S32R45_M7::Project_Settings::Startup_Code::exceptions.c, category=SWSRC
          short-label=examples::S32DS::S32R45::Rm_Semaphore_Example_S32R45_M7::Project_Settings::Startup_Code::nvic.c, category=SWSRC
          short-label=examples::S32DS::S32R45::Rm_Semaphore_Example_S32R45_M7::Project_Settings::Startup_Code::startup.c, category=SWSRC
          short-label=examples::S32DS::S32R45::Rm_Semaphore_Example_S32R45_M7::Project_Settings::Startup_Code::system.c, category=SWSRC
          short-label=examples::S32DS::S32R45::Rm_Semaphore_Example_S32R45_M7::src::main.c, category=SWSRC
          short-label=examples::S32DS::S32R45::Rm_Semaphore_Example_S32R45_M7::src::sys_init.c, category=SWSRC
          short-label=examples::S32DS::S32R45::Semaphore_Ip_Example_S32R45_M7::include::check_example.h, category=SWHDR
          short-label=examples::S32DS::S32R45::Semaphore_Ip_Example_S32R45_M7::Project_Settings::Startup_Code::exceptions.c, category=SWSRC
          short-label=examples::S32DS::S32R45::Semaphore_Ip_Example_S32R45_M7::Project_Settings::Startup_Code::nvic.c, category=SWSRC
          short-label=examples::S32DS::S32R45::Semaphore_Ip_Example_S32R45_M7::Project_Settings::Startup_Code::startup.c, category=SWSRC
          short-label=examples::S32DS::S32R45::Semaphore_Ip_Example_S32R45_M7::Project_Settings::Startup_Code::system.c, category=SWSRC
          short-label=examples::S32DS::S32R45::Semaphore_Ip_Example_S32R45_M7::src::main.c, category=SWSRC
          short-label=examples::S32DS::S32R45::Semaphore_Ip_Example_S32R45_M7::src::sys_init.c, category=SWSRC
          short-label=examples::S32DS::S32R45::Xrdc_Ip_Example_S32R45_M7::include::check_example.h, category=SWHDR
          short-label=examples::S32DS::S32R45::Xrdc_Ip_Example_S32R45_M7::Project_Settings::Startup_Code::exceptions.c, category=SWSRC
          short-label=examples::S32DS::S32R45::Xrdc_Ip_Example_S32R45_M7::Project_Settings::Startup_Code::nvic.c, category=SWSRC
          short-label=examples::S32DS::S32R45::Xrdc_Ip_Example_S32R45_M7::Project_Settings::Startup_Code::startup.c, category=SWSRC
          short-label=examples::S32DS::S32R45::Xrdc_Ip_Example_S32R45_M7::Project_Settings::Startup_Code::system.c, category=SWSRC
          short-label=examples::S32DS::S32R45::Xrdc_Ip_Example_S32R45_M7::src::main.c, category=SWSRC
          short-label=examples::S32DS::S32R45::Xrdc_Ip_Example_S32R45_M7::src::sys_init.c, category=SWSRC
          short-label=include::CDD_Rm.h, category=SWHDR
          short-label=include::CDD_Rm_Ipw.h, category=SWHDR
          short-label=include::Mpu_M7_Ip.h, category=SWHDR
          short-label=include::Mpu_M7_Ip_DeviceRegisters.h, category=SWHDR
          short-label=include::Mpu_M7_Ip_TrustedFunctions.h, category=SWHDR
          short-label=include::Mpu_M7_Ip_Types.h, category=SWHDR
          short-label=include::Mscm_Ip.h, category=SWHDR
          short-label=include::Mscm_Ip_TrustedFunctions.h, category=SWHDR
          short-label=include::Mscm_Ip_Types.h, category=SWHDR
          short-label=include::Sema42_Ip.h, category=SWHDR
          short-label=include::Sema42_Ip_DeviceRegisters.h, category=SWHDR
          short-label=include::Sema42_Ip_TrustedFunctions.h, category=SWHDR
          short-label=include::Sema42_Ip_Types.h, category=SWHDR
          short-label=include::Xrdc_Ip.h, category=SWHDR
          short-label=include::Xrdc_Ip_Device_Registers.h, category=SWHDR
          short-label=include::Xrdc_Ip_TrustedFunctions.h, category=SWHDR
          short-label=include::Xrdc_Ip_Types.h, category=SWHDR
          short-label=src::CDD_Rm.c, category=SWSRC
          short-label=src::CDD_Rm_Ipw.c, category=SWSRC
          short-label=src::Mpu_M7_Ip.c, category=SWSRC
          short-label=src::Mscm_Ip.c, category=SWSRC
          short-label=src::Sema42_Ip.c, category=SWSRC
          short-label=src::Xrdc_Ip.c, category=SWSRC
    compiler DIAB_Compiler:
      name=Windriver Diab
      options=-tARMCORTEXM7MG:simple -mthumb -std=c99 -Oz -g -fstandalone-debug -Wstrict-prototypes -Wsign-compare -Wdouble-promotion -Wunknown-pragmas -Wundef -Wextra -Wall -pedantic -Werror=implicit-function-declaration -fno-common -fno-signed-char -fno-trigraphs -V -c -DS32XX -DS32G2XX -DS32G3XX -DS32R45 -DDIAB -DUSE_SW_VECTOR_MODE -DD_CACHE_ENABLE -DI_CACHE_ENABLE -DENABLE_FPU -DMCAL_ENABLE_USER_MODE_SUPPORT
      vendor=Windriver
      version=DIAB_7_0_3_0-FCS_20200409_160912
    compiler GCC_Compiler:
      name=GCC Compiler
      options=-mcpu=cortex-m7 -mthumb -mlittle-endian -mfpu=fpv5-sp-d16 -mfloat-abi=hard -std=c99 -Os -ggdb3 -Wall -Wextra -pedantic -Wstrict-prototypes -Wundef -Wunused -Werror=implicit-function-declaration -Wsign-compare -Wdouble-promotion -fno-short-enums -funsigned-char -funsigned-bitfields -fomit-frame-pointer -fno-common -fstack-usage -fdump-ipa-all -c -DS32XX -DS32G2XX -DS32G3XX -DS32R45 -DGCC -DUSE_SW_VECTOR_MODE -DD_CACHE_ENABLE -DI_CACHE_ENABLE -DENABLE_FPU -DMCAL_ENABLE_USER_MODE_SUPPORT
      vendor=GCC Systems
      version=NXP GCC 9.2.0 20190812 (Build 1649 Revision gaf57174)
    compiler GHS_Compiler:
      name=Green Hills
      options=-cpu=cortexm7 -thumb -fpu=vfpv5_d16 -fsingle -C99 --ghstd=last -Osize --gnu_asm -dual_debug -G -keeptempfiles -Wimplicit-int -Wshadow -Wtrigraphs -Wundef --unsigned_chars --unsigned_fields --no_commons --no_exceptions --no_slash_comment --prototype_errors --incorrect_pragma_warnings -c -DS32XX -DS32G2XX -DS32G3XX -DS32R45 -DGHS -DUSE_SW_VECTOR_MODE -DD_CACHE_ENABLE -DI_CACHE_ENABLE -DENABLE_FPU -DMCAL_ENABLE_USER_MODE_SUPPORT
      vendor=Green Hills
      version=Green Hills Multi 7.1.6d / Compiler 2020.1.4
    generated-artifacts:
      21 x dependency on artifact:
        CDD_Rm_Ipw_PBcfg_h: artifact-descriptor={short-label=generate_PB::include::CDD_Rm_Ipw_PBcfg.h, category=SWHDR}, usages=EXECUTE
        CDD_Rm_PBcfg_h: artifact-descriptor={short-label=generate_PB::include::CDD_Rm_PBcfg.h, category=SWHDR}, usages=EXECUTE
        Mscm_Ip_PBcfg_h: artifact-descriptor={short-label=generate_PB::include::Mscm_Ip_PBcfg.h, category=SWHDR}, usages=EXECUTE
        Xrdc_Ip_PBcfg_h: artifact-descriptor={short-label=generate_PB::include::Xrdc_Ip_PBcfg.h, category=SWHDR}, usages=EXECUTE
        CDD_Rm_Ipw_PBcfg_c: artifact-descriptor={short-label=generate_PB::src::CDD_Rm_Ipw_PBcfg.c, category=SWSRC}, usages=EXECUTE
        CDD_Rm_PBcfg_c: artifact-descriptor={short-label=generate_PB::src::CDD_Rm_PBcfg.c, category=SWSRC}, usages=EXECUTE
        Mscm_Ip_PBcfg_c: artifact-descriptor={short-label=generate_PB::src::Mscm_Ip_PBcfg.c, category=SWSRC}, usages=EXECUTE
        Xrdc_Ip_PBcfg_c: artifact-descriptor={short-label=generate_PB::src::Xrdc_Ip_PBcfg.c, category=SWSRC}, usages=EXECUTE
        CDD_Rm_Cfg_h: artifact-descriptor={short-label=generate_PC::include::CDD_Rm_Cfg.h, category=SWHDR}, usages=COMPILE
        CDD_Rm_Ipw_Cfg_h: artifact-descriptor={short-label=generate_PC::include::CDD_Rm_Ipw_Cfg.h, category=SWHDR}, usages=COMPILE
        Mpu_M7_Ip_Cfg_h: artifact-descriptor={short-label=generate_PC::include::Mpu_M7_Ip_Cfg.h, category=SWHDR}, usages=COMPILE
        Mpu_M7_Ip_Cfg_Defines_h: artifact-descriptor={short-label=generate_PC::include::Mpu_M7_Ip_Cfg_Defines.h, category=SWHDR}, usages=COMPILE
        Mscm_Ip_Cfg_h: artifact-descriptor={short-label=generate_PC::include::Mscm_Ip_Cfg.h, category=SWHDR}, usages=COMPILE
        Mscm_Ip_Cfg_Defines_h: artifact-descriptor={short-label=generate_PC::include::Mscm_Ip_Cfg_Defines.h, category=SWHDR}, usages=COMPILE
        Sema42_Ip_Cfg_Defines_h: artifact-descriptor={short-label=generate_PC::include::Sema42_Ip_Cfg_Defines.h, category=SWHDR}, usages=COMPILE
        Xrdc_Ip_Cfg_h: artifact-descriptor={short-label=generate_PC::include::Xrdc_Ip_Cfg.h, category=SWHDR}, usages=COMPILE
        Xrdc_Ip_Cfg_Defines_h: artifact-descriptor={short-label=generate_PC::include::Xrdc_Ip_Cfg_Defines.h, category=SWHDR}, usages=COMPILE
        CDD_Rm_Cfg_c: artifact-descriptor={short-label=generate_PC::src::CDD_Rm_Cfg.c, category=SWSRC}, usages=COMPILE
        Mpu_M7_Ip_Cfg_c: artifact-descriptor={short-label=generate_PC::src::Mpu_M7_Ip_Cfg.c, category=SWSRC}, usages=COMPILE
        Xrdc_Ip_Cfg_c: artifact-descriptor={short-label=generate_PC::src::Xrdc_Ip_Cfg.c, category=SWSRC}, usages=COMPILE
        report_html: artifact-descriptor={short-label=generate_Report::report.html, category=SWHDR}, usages=COMPILE
    linker DIAB_Linker: name=Windriver Diab, options=-e Reset_Handler linker_script_file.dld -m30 -Xstack-usage -Xpreprocess-lecl -Llibrary_path -lc -lm, vendor=Windriver, version=DIAB_7_0_3_0-FCS_20200409_160912
    linker GCC_Linker: name=GCC Compiler, options=-Wl,-Map,filename -T linkerfile --entry=Reset_Handler -nostartfiles -mcpu=cortexm7 -mthumb -mfpu=fpv5-sp-d16 -mfloat-abi=hard -mlittle-endian -ggdb3 -lc -lm -lgcc, vendor=GCC Systems, version=NXP GCC 9.2.0 20190812 (Build 1649 Revision gaf57174)
    linker GHS_Linker: name=Green Hills, options=-e Reset_Handler -T linker_script_file.ld -map -keepmap -Mn -delete -ignore_debug_references -Llibrary_path -larch -lstartup -lind_sd -v -nostartfiles, vendor=Green Hills, version=Green Hills Multi 7.1.6d / Compiler 2020.1.4
    resource consumption ResourceConsumption
      6 x memory section:
        RM_CODE: alignment=UNSPECIFIED, sw-addrmethod=CODE, symbol=CODE
        RM_CONFIG_DATA_UNSPECIFIED: alignment=UNSPECIFIED, sw-addrmethod=CONFIG_DATA, symbol=CONFIG_DATA_UNSPECIFIED
        RM_CONST_16: alignment=16, sw-addrmethod=CONST, symbol=CONST_16
        RM_CONST_32: alignment=32, sw-addrmethod=CONST, symbol=CONST_32
        RM_CONST_8: alignment=8, sw-addrmethod=CONST, symbol=CONST_8
        RM_VAR_CLEARED_UNSPECIFIED: alignment=UNSPECIFIED, sw-addrmethod=VAR_CLEARED, symbol=VAR_CLEARED_UNSPECIFIED
