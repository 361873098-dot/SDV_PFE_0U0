AUTOSAR XML (schema 00046)
package /AUTOSAR_I2c/BswModuleDescriptions
  bsw module description I2c: module-id=255
    provided-entrys:
      I2c_AsyncTransmit
      I2c_DeInit
      I2c_GetStatus
      I2c_GetVersionInfo
      I2c_Init
      I2c_PrepareSlaveBuffer
      I2c_StartListening
      I2c_SyncTransmit
      I2c_Ip_IRQHandler{0..4}
    bsw internal behavior InternalBehavior_0
      exclusive area I2C_EXCLUSIVE_AREA_00
      exclusive area I2C_EXCLUSIVE_AREA_01
      8 x bsw called entity:
        I2c_AsyncTransmit: can-enter-exclusive-area=I2C_EXCLUSIVE_AREA_01, implemented-entry=I2c_AsyncTransmit
        I2c_DeInit: implemented-entry=I2c_DeInit
        I2c_GetStatus: implemented-entry=I2c_GetStatus
        I2c_GetVersionInfo: implemented-entry=I2c_GetVersionInfo
        I2c_Init: implemented-entry=I2c_Init
        I2c_PrepareSlaveBuffer: implemented-entry=I2c_PrepareSlaveBuffer
        I2c_StartListening: implemented-entry=I2c_StartListening
        I2c_SyncTransmit: can-enter-exclusive-area=I2C_EXCLUSIVE_AREA_00, implemented-entry=I2c_SyncTransmit
      5 x bsw interrupt entity, all with interrupt-category=CAT-2, interrupt-source=Hardware:
        I2c_Ip_IRQHandler{0..4}: implemented-entry=I2c_Ip_IRQHandler{0..4}
package /AUTOSAR_I2c/BswModuleEntrys
  13 x bsw module entry, all with sw-service-impl-policy=STANDARD:
    I2c_AsyncTransmit: service-id=0x03, is-reentrant=true, is-synchronous=true, call-type=REGULAR, execution-context=UNSPECIFIED
    I2c_DeInit: service-id=0x01, is-reentrant=false, is-synchronous=true, call-type=REGULAR, execution-context=UNSPECIFIED
    I2c_GetStatus: service-id=0x04, is-reentrant=true, is-synchronous=true, call-type=REGULAR, execution-context=UNSPECIFIED
    I2c_GetVersionInfo: service-id=0x0a, is-reentrant=true, is-synchronous=false, call-type=REGULAR, execution-context=UNSPECIFIED
    I2c_Init: service-id=0x00, is-reentrant=false, is-synchronous=true, call-type=REGULAR, execution-context=UNSPECIFIED
    I2c_PrepareSlaveBuffer: service-id=0x05, is-reentrant=true, is-synchronous=true, call-type=REGULAR, execution-context=UNSPECIFIED
    I2c_StartListening: service-id=0x06, is-reentrant=true, is-synchronous=true, call-type=REGULAR, execution-context=UNSPECIFIED
    I2c_SyncTransmit: service-id=0x02, is-reentrant=true, is-synchronous=true, call-type=REGULAR, execution-context=UNSPECIFIED
    I2c_Ip_IRQHandler{0..4}: service-id=0, is-reentrant=false, is-synchronous=true, call-type=INTERRUPT, execution-context=INTERRUPT-CAT-2
package /I2c_TS_T40D11M40I2R0/Implementations
  bsw implementation BswImplementation_0: programming-language=C, sw-version=4.0.2, vendor-id=43, ar-release-version=4.4.0, behavior=InternalBehavior_0, vendor-specific-module-def=I2c
    code-descriptors:
      code Files
        artifact-descriptors:
          short-label=config::I2c.xdm, category=SWCFG
          short-label=doc::RTD_I2C_IM.pdf, category=SWDOC
          short-label=doc::RTD_I2C_UM.pdf, category=SWDOC
          short-label=examples::EBT::S32G2::I2c_Example_S32G274A_M7::generate::epc::BaseNXP.xdm, category=SWCFG
          short-label=examples::EBT::S32G2::I2c_Example_S32G274A_M7::generate::epc::Dem.xdm, category=SWCFG
          short-label=examples::EBT::S32G2::I2c_Example_S32G274A_M7::generate::epc::EcuC.xdm, category=SWCFG
          short-label=examples::EBT::S32G2::I2c_Example_S32G274A_M7::generate::epc::I2c.xdm, category=SWCFG
          short-label=examples::EBT::S32G2::I2c_Example_S32G274A_M7::generate::epc::Mcu.xdm, category=SWCFG
          short-label=examples::EBT::S32G2::I2c_Example_S32G274A_M7::generate::epc::Platform.xdm, category=SWCFG
          short-label=examples::EBT::S32G2::I2c_Example_S32G274A_M7::generate::epc::Port.xdm, category=SWCFG
          short-label=examples::EBT::S32G2::I2c_Example_S32G274A_M7::generate::epc::Resource.xdm, category=SWCFG
          short-label=examples::EBT::S32G2::I2c_Example_S32G274A_M7::include::check_example.h, category=SWHDR
          short-label=examples::EBT::S32G2::I2c_Example_S32G274A_M7::src::main.c, category=SWSRC
          short-label=examples::EBT::S32G2::I2c_Example_S32G274A_M7::TresosProject::I2c_Example_S32G274A_M7::.prefs::preferences.xdm, category=SWCFG
          short-label=examples::EBT::S32G2::I2c_Example_S32G274A_M7::TresosProject::I2c_Example_S32G274A_M7::config::BaseNXP.xdm, category=SWCFG
          short-label=examples::EBT::S32G2::I2c_Example_S32G274A_M7::TresosProject::I2c_Example_S32G274A_M7::config::Dem.xdm, category=SWCFG
          short-label=examples::EBT::S32G2::I2c_Example_S32G274A_M7::TresosProject::I2c_Example_S32G274A_M7::config::EcuC.xdm, category=SWCFG
          short-label=examples::EBT::S32G2::I2c_Example_S32G274A_M7::TresosProject::I2c_Example_S32G274A_M7::config::I2c.xdm, category=SWCFG
          short-label=examples::EBT::S32G2::I2c_Example_S32G274A_M7::TresosProject::I2c_Example_S32G274A_M7::config::Mcu.xdm, category=SWCFG
          short-label=examples::EBT::S32G2::I2c_Example_S32G274A_M7::TresosProject::I2c_Example_S32G274A_M7::config::Platform.xdm, category=SWCFG
          short-label=examples::EBT::S32G2::I2c_Example_S32G274A_M7::TresosProject::I2c_Example_S32G274A_M7::config::Port.xdm, category=SWCFG
          short-label=examples::EBT::S32G2::I2c_Example_S32G274A_M7::TresosProject::I2c_Example_S32G274A_M7::config::Resource.xdm, category=SWCFG
          short-label=examples::EBT::S32G3::I2c_Example_S32G399A_M7::generate::epc::BaseNXP.xdm, category=SWCFG
          short-label=examples::EBT::S32G3::I2c_Example_S32G399A_M7::generate::epc::Dem.xdm, category=SWCFG
          short-label=examples::EBT::S32G3::I2c_Example_S32G399A_M7::generate::epc::EcuC.xdm, category=SWCFG
          short-label=examples::EBT::S32G3::I2c_Example_S32G399A_M7::generate::epc::I2c.xdm, category=SWCFG
          short-label=examples::EBT::S32G3::I2c_Example_S32G399A_M7::generate::epc::Mcu.xdm, category=SWCFG
          short-label=examples::EBT::S32G3::I2c_Example_S32G399A_M7::generate::epc::Os.xdm, category=SWCFG
          short-label=examples::EBT::S32G3::I2c_Example_S32G399A_M7::generate::epc::Platform.xdm, category=SWCFG
          short-label=examples::EBT::S32G3::I2c_Example_S32G399A_M7::generate::epc::Port.xdm, category=SWCFG
          short-label=examples::EBT::S32G3::I2c_Example_S32G399A_M7::generate::epc::Resource.xdm, category=SWCFG
          short-label=examples::EBT::S32G3::I2c_Example_S32G399A_M7::include::check_example.h, category=SWHDR
          short-label=examples::EBT::S32G3::I2c_Example_S32G399A_M7::src::main.c, category=SWSRC
          short-label=examples::EBT::S32G3::I2c_Example_S32G399A_M7::TresosProject::I2c_Example_S32G399A_M7::.prefs::preferences.xdm, category=SWCFG
          short-label=examples::EBT::S32G3::I2c_Example_S32G399A_M7::TresosProject::I2c_Example_S32G399A_M7::config::BaseNXP.xdm, category=SWCFG
          short-label=examples::EBT::S32G3::I2c_Example_S32G399A_M7::TresosProject::I2c_Example_S32G399A_M7::config::Dem.xdm, category=SWCFG
          short-label=examples::EBT::S32G3::I2c_Example_S32G399A_M7::TresosProject::I2c_Example_S32G399A_M7::config::EcuC.xdm, category=SWCFG
          short-label=examples::EBT::S32G3::I2c_Example_S32G399A_M7::TresosProject::I2c_Example_S32G399A_M7::config::I2c.xdm, category=SWCFG
          short-label=examples::EBT::S32G3::I2c_Example_S32G399A_M7::TresosProject::I2c_Example_S32G399A_M7::config::Mcu.xdm, category=SWCFG
          short-label=examples::EBT::S32G3::I2c_Example_S32G399A_M7::TresosProject::I2c_Example_S32G399A_M7::config::Os.xdm, category=SWCFG
          short-label=examples::EBT::S32G3::I2c_Example_S32G399A_M7::TresosProject::I2c_Example_S32G399A_M7::config::Platform.xdm, category=SWCFG
          short-label=examples::EBT::S32G3::I2c_Example_S32G399A_M7::TresosProject::I2c_Example_S32G399A_M7::config::Port.xdm, category=SWCFG
          short-label=examples::EBT::S32G3::I2c_Example_S32G399A_M7::TresosProject::I2c_Example_S32G399A_M7::config::Resource.xdm, category=SWCFG
          short-label=examples::EBT::S32R45::I2c_Example_S32R45_M7::generate::epc::BaseNXP.xdm, category=SWCFG
          short-label=examples::EBT::S32R45::I2c_Example_S32R45_M7::generate::epc::Dem.xdm, category=SWCFG
          short-label=examples::EBT::S32R45::I2c_Example_S32R45_M7::generate::epc::EcuC.xdm, category=SWCFG
          short-label=examples::EBT::S32R45::I2c_Example_S32R45_M7::generate::epc::I2c.xdm, category=SWCFG
          short-label=examples::EBT::S32R45::I2c_Example_S32R45_M7::generate::epc::Mcu.xdm, category=SWCFG
          short-label=examples::EBT::S32R45::I2c_Example_S32R45_M7::generate::epc::Os.xdm, category=SWCFG
          short-label=examples::EBT::S32R45::I2c_Example_S32R45_M7::generate::epc::Platform.xdm, category=SWCFG
          short-label=examples::EBT::S32R45::I2c_Example_S32R45_M7::generate::epc::Port.xdm, category=SWCFG
          short-label=examples::EBT::S32R45::I2c_Example_S32R45_M7::generate::epc::Resource.xdm, category=SWCFG
          short-label=examples::EBT::S32R45::I2c_Example_S32R45_M7::include::check_example.h, category=SWHDR
          short-label=examples::EBT::S32R45::I2c_Example_S32R45_M7::src::main.c, category=SWSRC
          short-label=examples::EBT::S32R45::I2c_Example_S32R45_M7::TresosProject::I2c_Example_S32R45_M7::.prefs::preferences.xdm, category=SWCFG
          short-label=examples::EBT::S32R45::I2c_Example_S32R45_M7::TresosProject::I2c_Example_S32R45_M7::config::BaseNXP.xdm, category=SWCFG
          short-label=examples::EBT::S32R45::I2c_Example_S32R45_M7::TresosProject::I2c_Example_S32R45_M7::config::Dem.xdm, category=SWCFG
          short-label=examples::EBT::S32R45::I2c_Example_S32R45_M7::TresosProject::I2c_Example_S32R45_M7::config::EcuC.xdm, category=SWCFG
          short-label=examples::EBT::S32R45::I2c_Example_S32R45_M7::TresosProject::I2c_Example_S32R45_M7::config::I2c.xdm, category=SWCFG
          short-label=examples::EBT::S32R45::I2c_Example_S32R45_M7::TresosProject::I2c_Example_S32R45_M7::config::Mcu.xdm, category=SWCFG
          short-label=examples::EBT::S32R45::I2c_Example_S32R45_M7::TresosProject::I2c_Example_S32R45_M7::config::Os.xdm, category=SWCFG
          short-label=examples::EBT::S32R45::I2c_Example_S32R45_M7::TresosProject::I2c_Example_S32R45_M7::config::Platform.xdm, category=SWCFG
          short-label=examples::EBT::S32R45::I2c_Example_S32R45_M7::TresosProject::I2c_Example_S32R45_M7::config::Port.xdm, category=SWCFG
          short-label=examples::EBT::S32R45::I2c_Example_S32R45_M7::TresosProject::I2c_Example_S32R45_M7::config::Resource.xdm, category=SWCFG
          short-label=examples::S32DS::S32G2::I2c_Example_Ip_S32G274A_M7::include::check_example.h, category=SWHDR
          short-label=examples::S32DS::S32G2::I2c_Example_Ip_S32G274A_M7::Project_Settings::Startup_Code::exceptions.c, category=SWSRC
          short-label=examples::S32DS::S32G2::I2c_Example_Ip_S32G274A_M7::Project_Settings::Startup_Code::nvic.c, category=SWSRC
          short-label=examples::S32DS::S32G2::I2c_Example_Ip_S32G274A_M7::Project_Settings::Startup_Code::startup.c, category=SWSRC
          short-label=examples::S32DS::S32G2::I2c_Example_Ip_S32G274A_M7::Project_Settings::Startup_Code::system.c, category=SWSRC
          short-label=examples::S32DS::S32G2::I2c_Example_Ip_S32G274A_M7::src::main.c, category=SWSRC
          short-label=examples::S32DS::S32G2::I2c_Example_S32G274A_M7::include::check_example.h, category=SWHDR
          short-label=examples::S32DS::S32G2::I2c_Example_S32G274A_M7::Project_Settings::Startup_Code::exceptions.c, category=SWSRC
          short-label=examples::S32DS::S32G2::I2c_Example_S32G274A_M7::Project_Settings::Startup_Code::nvic.c, category=SWSRC
          short-label=examples::S32DS::S32G2::I2c_Example_S32G274A_M7::Project_Settings::Startup_Code::startup.c, category=SWSRC
          short-label=examples::S32DS::S32G2::I2c_Example_S32G274A_M7::Project_Settings::Startup_Code::system.c, category=SWSRC
          short-label=examples::S32DS::S32G2::I2c_Example_S32G274A_M7::src::main.c, category=SWSRC
          short-label=examples::S32DS::S32G3::I2c_Example_Ip_S32G399A_M7::include::check_example.h, category=SWHDR
          short-label=examples::S32DS::S32G3::I2c_Example_Ip_S32G399A_M7::Project_Settings::Startup_Code::exceptions.c, category=SWSRC
          short-label=examples::S32DS::S32G3::I2c_Example_Ip_S32G399A_M7::Project_Settings::Startup_Code::nvic.c, category=SWSRC
          short-label=examples::S32DS::S32G3::I2c_Example_Ip_S32G399A_M7::Project_Settings::Startup_Code::startup.c, category=SWSRC
          short-label=examples::S32DS::S32G3::I2c_Example_Ip_S32G399A_M7::Project_Settings::Startup_Code::system.c, category=SWSRC
          short-label=examples::S32DS::S32G3::I2c_Example_Ip_S32G399A_M7::src::main.c, category=SWSRC
          short-label=examples::S32DS::S32G3::I2c_Example_S32G399A_M7::include::check_example.h, category=SWHDR
          short-label=examples::S32DS::S32G3::I2c_Example_S32G399A_M7::Project_Settings::Startup_Code::exceptions.c, category=SWSRC
          short-label=examples::S32DS::S32G3::I2c_Example_S32G399A_M7::Project_Settings::Startup_Code::nvic.c, category=SWSRC
          short-label=examples::S32DS::S32G3::I2c_Example_S32G399A_M7::Project_Settings::Startup_Code::startup.c, category=SWSRC
          short-label=examples::S32DS::S32G3::I2c_Example_S32G399A_M7::Project_Settings::Startup_Code::system.c, category=SWSRC
          short-label=examples::S32DS::S32G3::I2c_Example_S32G399A_M7::src::main.c, category=SWSRC
          short-label=examples::S32DS::S32R45::I2c_Example_Ip_S32R45_M7::include::check_example.h, category=SWHDR
          short-label=examples::S32DS::S32R45::I2c_Example_Ip_S32R45_M7::Project_Settings::Startup_Code::exceptions.c, category=SWSRC
          short-label=examples::S32DS::S32R45::I2c_Example_Ip_S32R45_M7::Project_Settings::Startup_Code::nvic.c, category=SWSRC
          short-label=examples::S32DS::S32R45::I2c_Example_Ip_S32R45_M7::Project_Settings::Startup_Code::startup.c, category=SWSRC
          short-label=examples::S32DS::S32R45::I2c_Example_Ip_S32R45_M7::Project_Settings::Startup_Code::system.c, category=SWSRC
          short-label=examples::S32DS::S32R45::I2c_Example_Ip_S32R45_M7::src::main.c, category=SWSRC
          short-label=examples::S32DS::S32R45::I2c_Example_S32R45_M7::include::check_example.h, category=SWHDR
          short-label=examples::S32DS::S32R45::I2c_Example_S32R45_M7::Project_Settings::Startup_Code::exceptions.c, category=SWSRC
          short-label=examples::S32DS::S32R45::I2c_Example_S32R45_M7::Project_Settings::Startup_Code::nvic.c, category=SWSRC
          short-label=examples::S32DS::S32R45::I2c_Example_S32R45_M7::Project_Settings::Startup_Code::startup.c, category=SWSRC
          short-label=examples::S32DS::S32R45::I2c_Example_S32R45_M7::Project_Settings::Startup_Code::system.c, category=SWSRC
          short-label=examples::S32DS::S32R45::I2c_Example_S32R45_M7::src::main.c, category=SWSRC
          short-label=include::CDD_I2c.h, category=SWHDR
          short-label=include::I2c_Ip.h, category=SWHDR
          short-label=include::I2c_Ipw.h, category=SWHDR
          short-label=include::I2c_Ipw_Types.h, category=SWHDR
          short-label=include::I2c_Ip_Callbacks.h, category=SWHDR
          short-label=include::I2c_Ip_HwAccess.h, category=SWHDR
          short-label=include::I2c_Ip_Irq.h, category=SWHDR
          short-label=include::I2c_Ip_TrustedFunctions.h, category=SWHDR
          short-label=include::I2c_Ip_TrustedMacros.h, category=SWHDR
          short-label=include::I2c_Ip_Types.h, category=SWHDR
          short-label=include::I2c_Types.h, category=SWHDR
          short-label=src::CDD_I2c.c, category=SWSRC
          short-label=src::I2c_Ip.c, category=SWSRC
          short-label=src::I2c_Ipw.c, category=SWSRC
          short-label=src::I2c_Ip_Irq.c, category=SWSRC
    compiler DIAB_Compiler:
      name=Windriver Diab
      options=-tARMCORTEXM7MG:simple -mthumb -std=c99 -Oz -g -fstandalone-debug -Wstrict-prototypes -Wsign-compare -Wdouble-promotion -Wunknown-pragmas -Wundef -Wextra -Wall -pedantic -Werror=implicit-function-declaration -fno-common -fno-signed-char -fno-trigraphs -V -c -DS32XX -DS32G2XX -DS32G3XX -DS32R45 -DDIAB -DUSE_SW_VECTOR_MODE -DD_CACHE_ENABLE -DI_CACHE_ENABLE -DENABLE_FPU -DMCAL_ENABLE_USER_MODE_SUPPORT
      vendor=Windriver
      version=DIAB_7_0_3_0-FCS_20200409_160912
    compiler GCC_Compiler:
      name=GCC Compiler
      options=-mcpu=cortex-m7 -mthumb -mlittle-endian -mfpu=fpv5-sp-d16 -mfloat-abi=hard -std=c99 -Os -ggdb3 -Wall -Wextra -pedantic -Wstrict-prototypes -Wundef -Wunused -Werror=implicit-function-declaration -Wsign-compare -Wdouble-promotion -fno-short-enums -funsigned-char -funsigned-bitfields -fomit-frame-pointer -fno-common -fstack-usage -fdump-ipa-all -c -DS32XX -DS32G2XX -DS32G3XX -DS32R45 -DGCC -DUSE_SW_VECTOR_MODE -DD_CACHE_ENABLE -DI_CACHE_ENABLE -DENABLE_FPU -DMCAL_ENABLE_USER_MODE_SUPPORT
      vendor=GCC Systems
      version=NXP GCC 9.2.0 20190812 (Build 1649 Revision gaf57174)
    compiler GHS_Compiler:
      name=Green Hills
      options=-cpu=cortexm7 -thumb -fpu=vfpv5_d16 -fsingle -C99 --ghstd=last -Osize --gnu_asm -dual_debug -G -keeptempfiles -Wimplicit-int -Wshadow -Wtrigraphs -Wundef --unsigned_chars --unsigned_fields --no_commons --no_exceptions --no_slash_comment --prototype_errors --incorrect_pragma_warnings -c -DS32XX -DS32G2XX -DS32G3XX -DS32R45 -DGHS -DUSE_SW_VECTOR_MODE -DD_CACHE_ENABLE -DI_CACHE_ENABLE -DENABLE_FPU -DMCAL_ENABLE_USER_MODE_SUPPORT
      vendor=Green Hills
      version=Green Hills Multi 7.1.6d / Compiler 2020.1.4
    generated-artifacts:
      11 x dependency on artifact:
        CDD_I2c_PBcfg_h: artifact-descriptor={short-label=generate_PB::include::CDD_I2c_PBcfg.h, category=SWHDR}, usages=EXECUTE
        I2c_Ipw_PBcfg_h: artifact-descriptor={short-label=generate_PB::include::I2c_Ipw_PBcfg.h, category=SWHDR}, usages=EXECUTE
        I2c_Ip_PBcfg_h: artifact-descriptor={short-label=generate_PB::include::I2c_Ip_PBcfg.h, category=SWHDR}, usages=EXECUTE
        CDD_I2c_PBcfg_c: artifact-descriptor={short-label=generate_PB::src::CDD_I2c_PBcfg.c, category=SWSRC}, usages=EXECUTE
        I2c_Ipw_PBcfg_c: artifact-descriptor={short-label=generate_PB::src::I2c_Ipw_PBcfg.c, category=SWSRC}, usages=EXECUTE
        I2c_Ip_PBcfg_c: artifact-descriptor={short-label=generate_PB::src::I2c_Ip_PBcfg.c, category=SWSRC}, usages=EXECUTE
        CDD_I2c_Cfg_h: artifact-descriptor={short-label=generate_PC::include::CDD_I2c_Cfg.h, category=SWHDR}, usages=COMPILE
        CDD_I2c_CfgDefines_h: artifact-descriptor={short-label=generate_PC::include::CDD_I2c_CfgDefines.h, category=SWHDR}, usages=COMPILE
        I2c_Ip_Cfg_h: artifact-descriptor={short-label=generate_PC::include::I2c_Ip_Cfg.h, category=SWHDR}, usages=COMPILE
        I2c_Ip_CfgDefines_h: artifact-descriptor={short-label=generate_PC::include::I2c_Ip_CfgDefines.h, category=SWHDR}, usages=COMPILE
        CDD_I2c_Cfg_c: artifact-descriptor={short-label=generate_PC::src::CDD_I2c_Cfg.c, category=SWSRC}, usages=COMPILE
    linker DIAB_Linker: name=Windriver Diab, options=-e Reset_Handler linker_script_file.dld -m30 -Xstack-usage -Xpreprocess-lecl -Llibrary_path -lc -lm, vendor=Windriver, version=DIAB_7_0_3_0-FCS_20200409_160912
    linker GCC_Linker: name=GCC Compiler, options=-Wl,-Map,filename -T linkerfile --entry=Reset_Handler -nostartfiles -mcpu=cortexm7 -mthumb -mfpu=fpv5-sp-d16 -mfloat-abi=hard -mlittle-endian -ggdb3 -lc -lm -lgcc, vendor=GCC Systems, version=NXP GCC 9.2.0 20190812 (Build 1649 Revision gaf57174)
    linker GHS_Linker: name=Green Hills, options=-e Reset_Handler -T linker_script_file.ld -map -keepmap -Mn -delete -ignore_debug_references -Llibrary_path -larch -lstartup -lind_sd -v -nostartfiles, vendor=Green Hills, version=Green Hills Multi 7.1.6d / Compiler 2020.1.4
    resource consumption ResourceConsumption
      8 x memory section:
        I2C_CODE: alignment=UNSPECIFIED, sw-addrmethod=CODE, symbol=CODE
        I2C_CONFIG_DATA_UNSPECIFIED: alignment=UNSPECIFIED, sw-addrmethod=CONFIG_DATA, symbol=CONFIG_DATA_UNSPECIFIED
        I2C_CONST_UNSPECIFIED: alignment=UNSPECIFIED, sw-addrmethod=CONST, symbol=CONST_UNSPECIFIED
        I2C_VAR_CLEARED_UNSPECIFIED: alignment=UNSPECIFIED, sw-addrmethod=VAR_CLEARED, symbol=VAR_CLEARED_UNSPECIFIED
        I2C_VAR_CLEARED_UNSPECIFIED_NO_CACHEABLE: alignment=UNSPECIFIED, sw-addrmethod=VAR_CLEARED_NO_CACHEABLE, symbol=VAR_CLEARED_UNSPECIFIED_NO_CACHEABLE
        I2C_VAR_INIT_8: alignment=8, sw-addrmethod=VAR_INIT, symbol=VAR_INIT_8
        I2C_VAR_INIT_8_NO_CACHEABLE: alignment=8, sw-addrmethod=VAR_INIT_NO_CACHEABLE, symbol=VAR_INIT_8_NO_CACHEABLE
        I2C_VAR_INIT_UNSPECIFIED: alignment=UNSPECIFIED, sw-addrmethod=VAR_INIT, symbol=VAR_INIT_UNSPECIFIED
