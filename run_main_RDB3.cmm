;  Copyright 2019-2023 NXP
;
;  NXP Confidential and Proprietary. This software is owned or controlled by NXP and may only
;  be used strictly in accordance with the applicable license terms. By
;  expressly accepting such terms or by downloading, installing, activating
;  and/or otherwise using the software, you are agreeing that you have read,
;  and that you agree to comply with and are bound by, such license terms. If
;  you do not agree to be bound by the applicable license terms, then you may
;  not retain, install, activate or otherwise use the software.
;
;  This file contains sample code only. It is not part of the production code deliverables.
;
;  Script for programming of S32Gxx.
;
;  $Author: Alexandra Amarandei $

;========================================================================

DO D:/NewPrj_EB/HPC_PRJ_S32G_M7_MCAL_1.4.0/Hpc_m7_prj/common_debug.cmm "G3" "D:/NewPrj_EB/HPC_PRJ_S32G_M7_MCAL_1.4.0/Hpc_m7_prj/output_RDB3/hpc_m7.elf"
