AUTOSAR XML (schema 00046)
package /AUTOSAR_Icu/BswModuleDescriptions
  bsw module description Icu: module-id=122
    provided-entrys:
      Ftm_Icu_Ip_DeInit
      Ftm_Icu_Ip_DisableEdgeCount
      Ftm_Icu_Ip_DisableInterrupt
      Ftm_Icu_Ip_EnableEdgeCount
      Ftm_Icu_Ip_EnableInterrupt
      Ftm_Icu_Ip_GetCaptureRegisterValue
      Ftm_Icu_Ip_GetDutyCycleValues
      Ftm_Icu_Ip_GetEdgeNumbers
      Ftm_Icu_Ip_GetInputLevel
      Ftm_Icu_Ip_GetStartAddress
      Ftm_Icu_Ip_GetTimeElapsed
      Ftm_Icu_Ip_GetTimestampIndex
      Ftm_Icu_Ip_Init
      Ftm_Icu_Ip_ResetEdgeCount
      Ftm_Icu_Ip_SetActivationCondition
      Ftm_Icu_Ip_StartSignalMeasurement
      Ftm_Icu_Ip_StartTimestamp
      Ftm_Icu_Ip_StopSignalMeasurement
      Ftm_Icu_Ip_StopTimestamp
      Icu_CheckWakeup
      Icu_DeInit
      Icu_DisableEdgeCount
      Icu_DisableEdgeDetection
      Icu_DisableNotification
      Icu_DisableWakeup
      Icu_EnableEdgeCount
      Icu_EnableEdgeDetection
      Icu_EnableNotification
      Icu_EnableWakeup
      Icu_GetCaptureRegisterValue
      Icu_GetDutyCycleValues
      Icu_GetEdgeNumbers
      Icu_GetInputLevel
      Icu_GetInputState
      Icu_GetTimeElapsed
      Icu_GetTimestampIndex
      Icu_GetVersionInfo
      Icu_Init
      Icu_ResetEdgeCount
      Icu_SetActivationCondition
      Icu_SetClockMode
      Icu_SetMode
      Icu_StartSignalMeasurement
      Icu_StartTimestamp
      Icu_StopSignalMeasurement
      Icu_StopTimestamp
      Siul2_Icu_Ip_DisableInterrupt
      Siul2_Icu_Ip_EnableInterrupt
      Siul2_Icu_Ip_GetInputState
      Siul2_Icu_Ip_SetActivationCondition
      Siul2_Icu_Ip_SetClockMode
      Wkpu_Ip_DeinitNMI
      Wkpu_Ip_DisableInterrupt
      Wkpu_Ip_EnableInterrupt
      Wkpu_Ip_InitNMI
      FTM_0_CH_0_CH_1_ISR
      FTM_0_CH_2_CH_3_ISR
      FTM_0_CH_4_CH_5_ISR
      FTM_0_CH_6_CH_7_ISR
      FTM_0_ISR
      FTM_0_OVF_ISR
      FTM_1_CH_0_CH_1_ISR
      FTM_1_CH_2_CH_3_ISR
      FTM_1_CH_4_CH_5_ISR
      FTM_1_CH_6_CH_7_ISR
      FTM_1_ISR
      FTM_1_OVF_ISR
      FTM_2_CH_0_CH_1_ISR
      FTM_2_CH_2_CH_3_ISR
      FTM_2_CH_4_CH_5_ISR
      FTM_2_CH_6_CH_7_ISR
      FTM_2_OVF_ISR
      FTM_3_CH_0_CH_1_ISR
      FTM_3_CH_2_CH_3_ISR
      FTM_3_CH_4_CH_5_ISR
      FTM_3_CH_6_CH_7_ISR
      FTM_3_OVF_ISR
      FTM_4_CH_0_CH_1_ISR
      FTM_4_CH_2_CH_3_ISR
      FTM_4_CH_4_CH_5_ISR
      FTM_4_CH_6_CH_7_ISR
      FTM_4_OVF_ISR
      FTM_5_CH_0_CH_1_ISR
      FTM_5_CH_2_CH_3_ISR
      FTM_5_CH_4_CH_5_ISR
      FTM_5_CH_6_CH_7_ISR
      FTM_5_OVF_ISR
      FTM_6_CH_0_CH_1_ISR
      FTM_6_CH_2_CH_3_ISR
      FTM_6_CH_4_CH_5_ISR
      FTM_6_CH_6_CH_7_ISR
      FTM_6_OVF_ISR
      FTM_7_CH_0_CH_1_ISR
      FTM_7_CH_2_CH_3_ISR
      FTM_7_CH_4_CH_5_ISR
      FTM_7_CH_6_CH_7_ISR
      FTM_7_OVF_ISR
      SIUL2_0_ICU_EIRQ_SINGLE_INT_HANDLER
      SIUL2_1_ICU_EIRQ_SINGLE_INT_HANDLER
      SIUL2_4_ICU_EIRQ_SINGLE_INT_HANDLER
      SIUL2_5_ICU_EIRQ_SINGLE_INT_HANDLER
      SIUL2_EXT_IRQ_0_7_ISR
      SIUL2_EXT_IRQ_16_23_ISR
      SIUL2_EXT_IRQ_24_31_ISR
      SIUL2_EXT_IRQ_8_15_ISR
      WKPU_EXT_IRQ_0_7_ISR
      WKPU_EXT_IRQ_16_23_ISR
      WKPU_EXT_IRQ_24_31_ISR
      WKPU_EXT_IRQ_8_15_ISR
      WKPU_EXT_IRQ_SINGLE_ISR
    bsw internal behavior InternalBehavior_0
      25 x exclusive area:
        ICU_EXCLUSIVE_AREA_{00..03}
        ICU_EXCLUSIVE_AREA_08
        ICU_EXCLUSIVE_AREA_09
        ICU_EXCLUSIVE_AREA_{15..30}
        ICU_EXCLUSIVE_AREA_33
        ICU_EXCLUSIVE_AREA_57
        ICU_EXCLUSIVE_AREA_58
      55 x bsw called entity:
        Ftm_Icu_Ip_DeInit: can-enter-exclusive-area=[ICU_EXCLUSIVE_AREA_17, ICU_EXCLUSIVE_AREA_18], implemented-entry=Ftm_Icu_Ip_DeInit
        Ftm_Icu_Ip_DisableEdgeCount: can-enter-exclusive-area=[ICU_EXCLUSIVE_AREA_16, ICU_EXCLUSIVE_AREA_27], implemented-entry=Ftm_Icu_Ip_DisableEdgeCount
        Ftm_Icu_Ip_DisableInterrupt: can-enter-exclusive-area=ICU_EXCLUSIVE_AREA_25, implemented-entry=Ftm_Icu_Ip_DisableInterrupt
        Ftm_Icu_Ip_EnableEdgeCount: can-enter-exclusive-area=ICU_EXCLUSIVE_AREA_15, implemented-entry=Ftm_Icu_Ip_EnableEdgeCount
        Ftm_Icu_Ip_EnableInterrupt: implemented-entry=Ftm_Icu_Ip_EnableInterrupt
        Ftm_Icu_Ip_GetCaptureRegisterValue: implemented-entry=Ftm_Icu_Ip_GetCaptureRegisterValue
        Ftm_Icu_Ip_GetDutyCycleValues: implemented-entry=Ftm_Icu_Ip_GetDutyCycleValues
        Ftm_Icu_Ip_GetEdgeNumbers: implemented-entry=Ftm_Icu_Ip_GetEdgeNumbers
        Ftm_Icu_Ip_GetInputLevel: implemented-entry=Ftm_Icu_Ip_GetInputLevel
        Ftm_Icu_Ip_GetStartAddress: implemented-entry=Ftm_Icu_Ip_GetStartAddress
        Ftm_Icu_Ip_GetTimeElapsed: implemented-entry=Ftm_Icu_Ip_GetTimeElapsed
        Ftm_Icu_Ip_GetTimestampIndex: implemented-entry=Ftm_Icu_Ip_GetTimestampIndex
        Ftm_Icu_Ip_Init: can-enter-exclusive-area=ICU_EXCLUSIVE_AREA_17, implemented-entry=Ftm_Icu_Ip_Init
        Ftm_Icu_Ip_ResetEdgeCount: implemented-entry=Ftm_Icu_Ip_ResetEdgeCount
        Ftm_Icu_Ip_SetActivationCondition: can-enter-exclusive-area=ICU_EXCLUSIVE_AREA_19, implemented-entry=Ftm_Icu_Ip_SetActivationCondition
        Ftm_Icu_Ip_StartSignalMeasurement: can-enter-exclusive-area=[ICU_EXCLUSIVE_AREA_15, ICU_EXCLUSIVE_AREA_28], implemented-entry=Ftm_Icu_Ip_StartSignalMeasurement
        Ftm_Icu_Ip_StartTimestamp: can-enter-exclusive-area=ICU_EXCLUSIVE_AREA_15, implemented-entry=Ftm_Icu_Ip_StartTimestamp
        Ftm_Icu_Ip_StopSignalMeasurement: can-enter-exclusive-area=[ICU_EXCLUSIVE_AREA_16, ICU_EXCLUSIVE_AREA_30], implemented-entry=Ftm_Icu_Ip_StopSignalMeasurement
        Ftm_Icu_Ip_StopTimestamp: can-enter-exclusive-area=[ICU_EXCLUSIVE_AREA_16, ICU_EXCLUSIVE_AREA_26], implemented-entry=Ftm_Icu_Ip_StopTimestamp
        Icu_CheckWakeup: can-enter-exclusive-area=ICU_EXCLUSIVE_AREA_01, implemented-entry=Icu_CheckWakeup
        Icu_DeInit: can-enter-exclusive-area=[ICU_EXCLUSIVE_AREA_17, ICU_EXCLUSIVE_AREA_18], implemented-entry=Icu_DeInit
        Icu_DisableEdgeCount: can-enter-exclusive-area=[ICU_EXCLUSIVE_AREA_01, ICU_EXCLUSIVE_AREA_16, ICU_EXCLUSIVE_AREA_27], implemented-entry=Icu_DisableEdgeCount
        Icu_DisableEdgeDetection: can-enter-exclusive-area=[ICU_EXCLUSIVE_AREA_01, ICU_EXCLUSIVE_AREA_24, ICU_EXCLUSIVE_AREA_58], implemented-entry=Icu_DisableEdgeDetection
        Icu_DisableNotification: can-enter-exclusive-area=ICU_EXCLUSIVE_AREA_01, implemented-entry=Icu_DisableNotification
        Icu_DisableWakeup: can-enter-exclusive-area=ICU_EXCLUSIVE_AREA_01, implemented-entry=Icu_DisableWakeup
        Icu_EnableEdgeCount: can-enter-exclusive-area=[ICU_EXCLUSIVE_AREA_00, ICU_EXCLUSIVE_AREA_01, ICU_EXCLUSIVE_AREA_15, ICU_EXCLUSIVE_AREA_19, ICU_EXCLUSIVE_AREA_26], implemented-entry=Icu_EnableEdgeCount
        Icu_EnableEdgeDetection: can-enter-exclusive-area=[ICU_EXCLUSIVE_AREA_00, ICU_EXCLUSIVE_AREA_15, ICU_EXCLUSIVE_AREA_19, ICU_EXCLUSIVE_AREA_23, ICU_EXCLUSIVE_AREA_57], implemented-entry=Icu_EnableEdgeDetection
        Icu_EnableNotification: can-enter-exclusive-area=ICU_EXCLUSIVE_AREA_00, implemented-entry=Icu_EnableNotification
        Icu_EnableWakeup: can-enter-exclusive-area=ICU_EXCLUSIVE_AREA_00, implemented-entry=Icu_EnableWakeup
        Icu_GetCaptureRegisterValue: implemented-entry=Icu_GetCaptureRegisterValue
        Icu_GetDutyCycleValues: implemented-entry=Icu_GetDutyCycleValues
        Icu_GetEdgeNumbers: implemented-entry=Icu_GetEdgeNumbers
        Icu_GetInputLevel: implemented-entry=Icu_GetInputLevel
        Icu_GetInputState: can-enter-exclusive-area=[ICU_EXCLUSIVE_AREA_01, ICU_EXCLUSIVE_AREA_29], implemented-entry=Icu_GetInputState
        Icu_GetTimeElapsed: can-enter-exclusive-area=ICU_EXCLUSIVE_AREA_01, implemented-entry=Icu_GetTimeElapsed
        Icu_GetTimestampIndex: implemented-entry=Icu_GetTimestampIndex
        Icu_GetVersionInfo: implemented-entry=Icu_GetVersionInfo
        Icu_Init: can-enter-exclusive-area=[ICU_EXCLUSIVE_AREA_17, ICU_EXCLUSIVE_AREA_19], implemented-entry=Icu_Init
        Icu_ResetEdgeCount: can-enter-exclusive-area=ICU_EXCLUSIVE_AREA_01, implemented-entry=Icu_ResetEdgeCount
        Icu_SetActivationCondition: can-enter-exclusive-area=ICU_EXCLUSIVE_AREA_01, implemented-entry=Icu_SetActivationCondition
        Icu_SetClockMode: implemented-entry=Icu_SetClockMode
        Icu_SetMode: can-enter-exclusive-area=[ICU_EXCLUSIVE_AREA_21, ICU_EXCLUSIVE_AREA_22], implemented-entry=Icu_SetMode
        Icu_StartSignalMeasurement: can-enter-exclusive-area=[ICU_EXCLUSIVE_AREA_00, ICU_EXCLUSIVE_AREA_01, ICU_EXCLUSIVE_AREA_08, ICU_EXCLUSIVE_AREA_15, ICU_EXCLUSIVE_AREA_19, ICU_EXCLUSIVE_AREA_28], implemented-entry=Icu_StartSignalMeasurement
        Icu_StartTimestamp: can-enter-exclusive-area=[ICU_EXCLUSIVE_AREA_00, ICU_EXCLUSIVE_AREA_01, ICU_EXCLUSIVE_AREA_02, ICU_EXCLUSIVE_AREA_19, ICU_EXCLUSIVE_AREA_25], implemented-entry=Icu_StartTimestamp
        Icu_StopSignalMeasurement: can-enter-exclusive-area=[ICU_EXCLUSIVE_AREA_01, ICU_EXCLUSIVE_AREA_16, ICU_EXCLUSIVE_AREA_30], implemented-entry=Icu_StopSignalMeasurement
        Icu_StopTimestamp: can-enter-exclusive-area=[ICU_EXCLUSIVE_AREA_01, ICU_EXCLUSIVE_AREA_16, ICU_EXCLUSIVE_AREA_26], implemented-entry=Icu_StopTimestamp
        Siul2_Icu_Ip_DisableInterrupt: implemented-entry=Siul2_Icu_Ip_DisableInterrupt
        Siul2_Icu_Ip_EnableInterrupt: implemented-entry=Siul2_Icu_Ip_EnableInterrupt
        Siul2_Icu_Ip_GetInputState: implemented-entry=Siul2_Icu_Ip_GetInputState
        Siul2_Icu_Ip_SetActivationCondition: implemented-entry=Siul2_Icu_Ip_SetActivationCondition
        Siul2_Icu_Ip_SetClockMode: implemented-entry=Siul2_Icu_Ip_SetClockMode
        Wkpu_Ip_DeinitNMI: implemented-entry=Wkpu_Ip_DeinitNMI
        Wkpu_Ip_DisableInterrupt: can-enter-exclusive-area=ICU_EXCLUSIVE_AREA_58, implemented-entry=Wkpu_Ip_DisableInterrupt
        Wkpu_Ip_EnableInterrupt: can-enter-exclusive-area=ICU_EXCLUSIVE_AREA_57, implemented-entry=Wkpu_Ip_EnableInterrupt
        Wkpu_Ip_InitNMI: implemented-entry=Wkpu_Ip_InitNMI
      55 x bsw interrupt entity, all with interrupt-category=CAT-2, interrupt-source=Hardware:
        FTM_0_CH_0_CH_1_ISR: implemented-entry=FTM_0_CH_0_CH_1_ISR
        FTM_0_CH_2_CH_3_ISR: implemented-entry=FTM_0_CH_2_CH_3_ISR
        FTM_0_CH_4_CH_5_ISR: implemented-entry=FTM_0_CH_4_CH_5_ISR
        FTM_0_CH_6_CH_7_ISR: implemented-entry=FTM_0_CH_6_CH_7_ISR
        FTM_0_ISR: can-enter-exclusive-area=[ICU_EXCLUSIVE_AREA_00, ICU_EXCLUSIVE_AREA_03, ICU_EXCLUSIVE_AREA_09, ICU_EXCLUSIVE_AREA_20, ICU_EXCLUSIVE_AREA_33], implemented-entry=FTM_0_ISR
        FTM_0_OVF_ISR: implemented-entry=FTM_0_OVF_ISR
        FTM_1_CH_0_CH_1_ISR: implemented-entry=FTM_1_CH_0_CH_1_ISR
        FTM_1_CH_2_CH_3_ISR: implemented-entry=FTM_1_CH_2_CH_3_ISR
        FTM_1_CH_4_CH_5_ISR: implemented-entry=FTM_1_CH_4_CH_5_ISR
        FTM_1_CH_6_CH_7_ISR: implemented-entry=FTM_1_CH_6_CH_7_ISR
        FTM_1_ISR: can-enter-exclusive-area=[ICU_EXCLUSIVE_AREA_00, ICU_EXCLUSIVE_AREA_03, ICU_EXCLUSIVE_AREA_09, ICU_EXCLUSIVE_AREA_20, ICU_EXCLUSIVE_AREA_33], implemented-entry=FTM_1_ISR
        FTM_1_OVF_ISR: implemented-entry=FTM_1_OVF_ISR
        FTM_2_CH_0_CH_1_ISR: implemented-entry=FTM_2_CH_0_CH_1_ISR
        FTM_2_CH_2_CH_3_ISR: implemented-entry=FTM_2_CH_2_CH_3_ISR
        FTM_2_CH_4_CH_5_ISR: implemented-entry=FTM_2_CH_4_CH_5_ISR
        FTM_2_CH_6_CH_7_ISR: implemented-entry=FTM_2_CH_6_CH_7_ISR
        FTM_2_OVF_ISR: implemented-entry=FTM_2_OVF_ISR
        FTM_3_CH_0_CH_1_ISR: implemented-entry=FTM_3_CH_0_CH_1_ISR
        FTM_3_CH_2_CH_3_ISR: implemented-entry=FTM_3_CH_2_CH_3_ISR
        FTM_3_CH_4_CH_5_ISR: implemented-entry=FTM_3_CH_4_CH_5_ISR
        FTM_3_CH_6_CH_7_ISR: implemented-entry=FTM_3_CH_6_CH_7_ISR
        FTM_3_OVF_ISR: implemented-entry=FTM_3_OVF_ISR
        FTM_4_CH_0_CH_1_ISR: implemented-entry=FTM_4_CH_0_CH_1_ISR
        FTM_4_CH_2_CH_3_ISR: implemented-entry=FTM_4_CH_2_CH_3_ISR
        FTM_4_CH_4_CH_5_ISR: implemented-entry=FTM_4_CH_4_CH_5_ISR
        FTM_4_CH_6_CH_7_ISR: implemented-entry=FTM_4_CH_6_CH_7_ISR
        FTM_4_OVF_ISR: implemented-entry=FTM_4_OVF_ISR
        FTM_5_CH_0_CH_1_ISR: implemented-entry=FTM_5_CH_0_CH_1_ISR
        FTM_5_CH_2_CH_3_ISR: implemented-entry=FTM_5_CH_2_CH_3_ISR
        FTM_5_CH_4_CH_5_ISR: implemented-entry=FTM_5_CH_4_CH_5_ISR
        FTM_5_CH_6_CH_7_ISR: implemented-entry=FTM_5_CH_6_CH_7_ISR
        FTM_5_OVF_ISR: implemented-entry=FTM_5_OVF_ISR
        FTM_6_CH_0_CH_1_ISR: implemented-entry=FTM_6_CH_0_CH_1_ISR
        FTM_6_CH_2_CH_3_ISR: implemented-entry=FTM_6_CH_2_CH_3_ISR
        FTM_6_CH_4_CH_5_ISR: implemented-entry=FTM_6_CH_4_CH_5_ISR
        FTM_6_CH_6_CH_7_ISR: implemented-entry=FTM_6_CH_6_CH_7_ISR
        FTM_6_OVF_ISR: implemented-entry=FTM_6_OVF_ISR
        FTM_7_CH_0_CH_1_ISR: implemented-entry=FTM_7_CH_0_CH_1_ISR
        FTM_7_CH_2_CH_3_ISR: implemented-entry=FTM_7_CH_2_CH_3_ISR
        FTM_7_CH_4_CH_5_ISR: implemented-entry=FTM_7_CH_4_CH_5_ISR
        FTM_7_CH_6_CH_7_ISR: implemented-entry=FTM_7_CH_6_CH_7_ISR
        FTM_7_OVF_ISR: implemented-entry=FTM_7_OVF_ISR
        SIUL2_0_ICU_EIRQ_SINGLE_INT_HANDLER: implemented-entry=SIUL2_0_ICU_EIRQ_SINGLE_INT_HANDLER
        SIUL2_1_ICU_EIRQ_SINGLE_INT_HANDLER: implemented-entry=SIUL2_1_ICU_EIRQ_SINGLE_INT_HANDLER
        SIUL2_4_ICU_EIRQ_SINGLE_INT_HANDLER: implemented-entry=SIUL2_4_ICU_EIRQ_SINGLE_INT_HANDLER
        SIUL2_5_ICU_EIRQ_SINGLE_INT_HANDLER: implemented-entry=SIUL2_5_ICU_EIRQ_SINGLE_INT_HANDLER
        SIUL2_EXT_IRQ_0_7_ISR: implemented-entry=SIUL2_EXT_IRQ_0_7_ISR
        SIUL2_EXT_IRQ_16_23_ISR: implemented-entry=SIUL2_EXT_IRQ_16_23_ISR
        SIUL2_EXT_IRQ_24_31_ISR: implemented-entry=SIUL2_EXT_IRQ_24_31_ISR
        SIUL2_EXT_IRQ_8_15_ISR: implemented-entry=SIUL2_EXT_IRQ_8_15_ISR
        WKPU_EXT_IRQ_0_7_ISR: implemented-entry=WKPU_EXT_IRQ_0_7_ISR
        WKPU_EXT_IRQ_16_23_ISR: implemented-entry=WKPU_EXT_IRQ_16_23_ISR
        WKPU_EXT_IRQ_24_31_ISR: implemented-entry=WKPU_EXT_IRQ_24_31_ISR
        WKPU_EXT_IRQ_8_15_ISR: implemented-entry=WKPU_EXT_IRQ_8_15_ISR
        WKPU_EXT_IRQ_SINGLE_ISR: implemented-entry=WKPU_EXT_IRQ_SINGLE_ISR
package /AUTOSAR_Icu/BswModuleEntrys
  110 x bsw module entry, all with sw-service-impl-policy=STANDARD:
    Ftm_Icu_Ip_DeInit: service-id=0x94, is-reentrant=true, is-synchronous=true, call-type=REGULAR, execution-context=UNSPECIFIED
    Ftm_Icu_Ip_DisableEdgeCount: service-id=0x8b, is-reentrant=true, is-synchronous=true, call-type=REGULAR, execution-context=UNSPECIFIED
    Ftm_Icu_Ip_DisableInterrupt: service-id=0x82, is-reentrant=true, is-synchronous=true, call-type=REGULAR, execution-context=UNSPECIFIED
    Ftm_Icu_Ip_EnableEdgeCount: service-id=0x8a, is-reentrant=true, is-synchronous=true, call-type=REGULAR, execution-context=UNSPECIFIED
    Ftm_Icu_Ip_EnableInterrupt: service-id=0x81, is-reentrant=true, is-synchronous=true, call-type=REGULAR, execution-context=UNSPECIFIED
    Ftm_Icu_Ip_GetCaptureRegisterValue: service-id=0x8c, is-reentrant=true, is-synchronous=true, call-type=REGULAR, execution-context=UNSPECIFIED
    Ftm_Icu_Ip_GetDutyCycleValues: service-id=0x92, is-reentrant=true, is-synchronous=true, call-type=REGULAR, execution-context=UNSPECIFIED
    Ftm_Icu_Ip_GetEdgeNumbers: service-id=0x90, is-reentrant=true, is-synchronous=true, call-type=REGULAR, execution-context=UNSPECIFIED
    Ftm_Icu_Ip_GetInputLevel: service-id=0x8d, is-reentrant=true, is-synchronous=true, call-type=REGULAR, execution-context=UNSPECIFIED
    Ftm_Icu_Ip_GetStartAddress: service-id=0x8f, is-reentrant=true, is-synchronous=true, call-type=REGULAR, execution-context=UNSPECIFIED
    Ftm_Icu_Ip_GetTimeElapsed: service-id=0x91, is-reentrant=true, is-synchronous=true, call-type=REGULAR, execution-context=UNSPECIFIED
    Ftm_Icu_Ip_GetTimestampIndex: service-id=0x8e, is-reentrant=true, is-synchronous=true, call-type=REGULAR, execution-context=UNSPECIFIED
    Ftm_Icu_Ip_Init: service-id=0x93, is-reentrant=true, is-synchronous=true, call-type=REGULAR, execution-context=UNSPECIFIED
    Ftm_Icu_Ip_ResetEdgeCount: service-id=0x87, is-reentrant=true, is-synchronous=true, call-type=REGULAR, execution-context=UNSPECIFIED
    Ftm_Icu_Ip_SetActivationCondition: service-id=0x80, is-reentrant=true, is-synchronous=true, call-type=REGULAR, execution-context=UNSPECIFIED
    Ftm_Icu_Ip_StartSignalMeasurement: service-id=0x85, is-reentrant=true, is-synchronous=true, call-type=REGULAR, execution-context=UNSPECIFIED
    Ftm_Icu_Ip_StartTimestamp: service-id=0x83, is-reentrant=true, is-synchronous=true, call-type=REGULAR, execution-context=UNSPECIFIED
    Ftm_Icu_Ip_StopSignalMeasurement: service-id=0x86, is-reentrant=true, is-synchronous=true, call-type=REGULAR, execution-context=UNSPECIFIED
    Ftm_Icu_Ip_StopTimestamp: service-id=0x84, is-reentrant=true, is-synchronous=true, call-type=REGULAR, execution-context=UNSPECIFIED
    Icu_CheckWakeup: service-id=0x15, is-reentrant=false, is-synchronous=true, call-type=REGULAR, execution-context=UNSPECIFIED
    Icu_DeInit: service-id=0x01, is-reentrant=false, is-synchronous=true, call-type=REGULAR, execution-context=UNSPECIFIED
    Icu_DisableEdgeCount: service-id=0x0e, is-reentrant=false, is-synchronous=true, call-type=REGULAR, execution-context=UNSPECIFIED
    Icu_DisableEdgeDetection: service-id=0x17, is-reentrant=false, is-synchronous=true, call-type=REGULAR, execution-context=UNSPECIFIED
    Icu_DisableNotification: service-id=0x06, is-reentrant=false, is-synchronous=true, call-type=REGULAR, execution-context=UNSPECIFIED
    Icu_DisableWakeup: service-id=0x03, is-reentrant=false, is-synchronous=true, call-type=REGULAR, execution-context=UNSPECIFIED
    Icu_EnableEdgeCount: service-id=0x0d, is-reentrant=false, is-synchronous=true, call-type=REGULAR, execution-context=UNSPECIFIED
    Icu_EnableEdgeDetection: service-id=0x16, is-reentrant=false, is-synchronous=true, call-type=REGULAR, execution-context=UNSPECIFIED
    Icu_EnableNotification: service-id=0x07, is-reentrant=false, is-synchronous=true, call-type=REGULAR, execution-context=UNSPECIFIED
    Icu_EnableWakeup: service-id=0x04, is-reentrant=false, is-synchronous=true, call-type=REGULAR, execution-context=UNSPECIFIED
    Icu_GetCaptureRegisterValue: service-id=0x19, is-reentrant=true, is-synchronous=true, call-type=REGULAR, execution-context=UNSPECIFIED
    Icu_GetDutyCycleValues: service-id=0x11, is-reentrant=false, is-synchronous=true, call-type=REGULAR, execution-context=UNSPECIFIED
    Icu_GetEdgeNumbers: service-id=0x0f, is-reentrant=false, is-synchronous=true, call-type=REGULAR, execution-context=UNSPECIFIED
    Icu_GetInputLevel: service-id=0x7c, is-reentrant=true, is-synchronous=true, call-type=REGULAR, execution-context=UNSPECIFIED
    Icu_GetInputState: service-id=0x08, is-reentrant=false, is-synchronous=true, call-type=REGULAR, execution-context=UNSPECIFIED
    Icu_GetTimeElapsed: service-id=0x10, is-reentrant=false, is-synchronous=true, call-type=REGULAR, execution-context=UNSPECIFIED
    Icu_GetTimestampIndex: service-id=0x0b, is-reentrant=false, is-synchronous=true, call-type=REGULAR, execution-context=UNSPECIFIED
    Icu_GetVersionInfo: service-id=0x12, is-reentrant=true, is-synchronous=true, call-type=REGULAR, execution-context=UNSPECIFIED
    Icu_Init: service-id=0x00, is-reentrant=false, is-synchronous=true, call-type=REGULAR, execution-context=UNSPECIFIED
    Icu_ResetEdgeCount: service-id=0x0c, is-reentrant=false, is-synchronous=true, call-type=REGULAR, execution-context=UNSPECIFIED
    Icu_SetActivationCondition: service-id=0x05, is-reentrant=false, is-synchronous=true, call-type=REGULAR, execution-context=UNSPECIFIED
    Icu_SetClockMode: service-id=0x7b, is-reentrant=false, is-synchronous=true, call-type=REGULAR, execution-context=UNSPECIFIED
    Icu_SetMode: service-id=0x02, is-reentrant=false, is-synchronous=true, call-type=REGULAR, execution-context=UNSPECIFIED
    Icu_StartSignalMeasurement: service-id=0x13, is-reentrant=false, is-synchronous=false, call-type=REGULAR, execution-context=UNSPECIFIED
    Icu_StartTimestamp: service-id=0x09, is-reentrant=false, is-synchronous=false, call-type=REGULAR, execution-context=UNSPECIFIED
    Icu_StopSignalMeasurement: service-id=0x14, is-reentrant=false, is-synchronous=true, call-type=REGULAR, execution-context=UNSPECIFIED
    Icu_StopTimestamp: service-id=0x0a, is-reentrant=false, is-synchronous=true, call-type=REGULAR, execution-context=UNSPECIFIED
    Siul2_Icu_Ip_DisableInterrupt: service-id=0x99, is-reentrant=true, is-synchronous=true, call-type=REGULAR, execution-context=UNSPECIFIED
    Siul2_Icu_Ip_EnableInterrupt: service-id=0x98, is-reentrant=true, is-synchronous=true, call-type=REGULAR, execution-context=UNSPECIFIED
    Siul2_Icu_Ip_GetInputState: service-id=0x95, is-reentrant=true, is-synchronous=true, call-type=REGULAR, execution-context=UNSPECIFIED
    Siul2_Icu_Ip_SetActivationCondition: service-id=0x97, is-reentrant=true, is-synchronous=true, call-type=REGULAR, execution-context=UNSPECIFIED
    Siul2_Icu_Ip_SetClockMode: service-id=0x96, is-reentrant=true, is-synchronous=true, call-type=REGULAR, execution-context=UNSPECIFIED
    Wkpu_Ip_DeinitNMI: service-id=0x9b, is-reentrant=true, is-synchronous=true, call-type=REGULAR, execution-context=UNSPECIFIED
    Wkpu_Ip_DisableInterrupt: service-id=0x9d, is-reentrant=true, is-synchronous=true, call-type=REGULAR, execution-context=UNSPECIFIED
    Wkpu_Ip_EnableInterrupt: service-id=0x9c, is-reentrant=true, is-synchronous=true, call-type=REGULAR, execution-context=UNSPECIFIED
    Wkpu_Ip_InitNMI: service-id=0x9a, is-reentrant=true, is-synchronous=true, call-type=REGULAR, execution-context=UNSPECIFIED
    FTM_0_CH_0_CH_1_ISR: service-id=0, is-reentrant=false, is-synchronous=true, call-type=INTERRUPT, execution-context=INTERRUPT-CAT-2
    FTM_0_CH_2_CH_3_ISR: service-id=0, is-reentrant=false, is-synchronous=true, call-type=INTERRUPT, execution-context=INTERRUPT-CAT-2
    FTM_0_CH_4_CH_5_ISR: service-id=0, is-reentrant=false, is-synchronous=true, call-type=INTERRUPT, execution-context=INTERRUPT-CAT-2
    FTM_0_CH_6_CH_7_ISR: service-id=0, is-reentrant=false, is-synchronous=true, call-type=INTERRUPT, execution-context=INTERRUPT-CAT-2
    FTM_0_ISR: service-id=0, is-reentrant=false, is-synchronous=true, call-type=INTERRUPT, execution-context=INTERRUPT-CAT-2
    FTM_0_OVF_ISR: service-id=0, is-reentrant=false, is-synchronous=true, call-type=INTERRUPT, execution-context=INTERRUPT-CAT-2
    FTM_1_CH_0_CH_1_ISR: service-id=0, is-reentrant=false, is-synchronous=true, call-type=INTERRUPT, execution-context=INTERRUPT-CAT-2
    FTM_1_CH_2_CH_3_ISR: service-id=0, is-reentrant=false, is-synchronous=true, call-type=INTERRUPT, execution-context=INTERRUPT-CAT-2
    FTM_1_CH_4_CH_5_ISR: service-id=0, is-reentrant=false, is-synchronous=true, call-type=INTERRUPT, execution-context=INTERRUPT-CAT-2
    FTM_1_CH_6_CH_7_ISR: service-id=0, is-reentrant=false, is-synchronous=true, call-type=INTERRUPT, execution-context=INTERRUPT-CAT-2
    FTM_1_ISR: service-id=0, is-reentrant=false, is-synchronous=true, call-type=INTERRUPT, execution-context=INTERRUPT-CAT-2
    FTM_1_OVF_ISR: service-id=0, is-reentrant=false, is-synchronous=true, call-type=INTERRUPT, execution-context=INTERRUPT-CAT-2
    FTM_2_CH_0_CH_1_ISR: service-id=0, is-reentrant=false, is-synchronous=true, call-type=INTERRUPT, execution-context=INTERRUPT-CAT-2
    FTM_2_CH_2_CH_3_ISR: service-id=0, is-reentrant=false, is-synchronous=true, call-type=INTERRUPT, execution-context=INTERRUPT-CAT-2
    FTM_2_CH_4_CH_5_ISR: service-id=0, is-reentrant=false, is-synchronous=true, call-type=INTERRUPT, execution-context=INTERRUPT-CAT-2
    FTM_2_CH_6_CH_7_ISR: service-id=0, is-reentrant=false, is-synchronous=true, call-type=INTERRUPT, execution-context=INTERRUPT-CAT-2
    FTM_2_OVF_ISR: service-id=0, is-reentrant=false, is-synchronous=true, call-type=INTERRUPT, execution-context=INTERRUPT-CAT-2
    FTM_3_CH_0_CH_1_ISR: service-id=0, is-reentrant=false, is-synchronous=true, call-type=INTERRUPT, execution-context=INTERRUPT-CAT-2
    FTM_3_CH_2_CH_3_ISR: service-id=0, is-reentrant=false, is-synchronous=true, call-type=INTERRUPT, execution-context=INTERRUPT-CAT-2
    FTM_3_CH_4_CH_5_ISR: service-id=0, is-reentrant=false, is-synchronous=true, call-type=INTERRUPT, execution-context=INTERRUPT-CAT-2
    FTM_3_CH_6_CH_7_ISR: service-id=0, is-reentrant=false, is-synchronous=true, call-type=INTERRUPT, execution-context=INTERRUPT-CAT-2
    FTM_3_OVF_ISR: service-id=0, is-reentrant=false, is-synchronous=true, call-type=INTERRUPT, execution-context=INTERRUPT-CAT-2
    FTM_4_CH_0_CH_1_ISR: service-id=0, is-reentrant=false, is-synchronous=true, call-type=INTERRUPT, execution-context=INTERRUPT-CAT-2
    FTM_4_CH_2_CH_3_ISR: service-id=0, is-reentrant=false, is-synchronous=true, call-type=INTERRUPT, execution-context=INTERRUPT-CAT-2
    FTM_4_CH_4_CH_5_ISR: service-id=0, is-reentrant=false, is-synchronous=true, call-type=INTERRUPT, execution-context=INTERRUPT-CAT-2
    FTM_4_CH_6_CH_7_ISR: service-id=0, is-reentrant=false, is-synchronous=true, call-type=INTERRUPT, execution-context=INTERRUPT-CAT-2
    FTM_4_OVF_ISR: service-id=0, is-reentrant=false, is-synchronous=true, call-type=INTERRUPT, execution-context=INTERRUPT-CAT-2
    FTM_5_CH_0_CH_1_ISR: service-id=0, is-reentrant=false, is-synchronous=true, call-type=INTERRUPT, execution-context=INTERRUPT-CAT-2
    FTM_5_CH_2_CH_3_ISR: service-id=0, is-reentrant=false, is-synchronous=true, call-type=INTERRUPT, execution-context=INTERRUPT-CAT-2
    FTM_5_CH_4_CH_5_ISR: service-id=0, is-reentrant=false, is-synchronous=true, call-type=INTERRUPT, execution-context=INTERRUPT-CAT-2
    FTM_5_CH_6_CH_7_ISR: service-id=0, is-reentrant=false, is-synchronous=true, call-type=INTERRUPT, execution-context=INTERRUPT-CAT-2
    FTM_5_OVF_ISR: service-id=0, is-reentrant=false, is-synchronous=true, call-type=INTERRUPT, execution-context=INTERRUPT-CAT-2
    FTM_6_CH_0_CH_1_ISR: service-id=0, is-reentrant=false, is-synchronous=true, call-type=INTERRUPT, execution-context=INTERRUPT-CAT-2
    FTM_6_CH_2_CH_3_ISR: service-id=0, is-reentrant=false, is-synchronous=true, call-type=INTERRUPT, execution-context=INTERRUPT-CAT-2
    FTM_6_CH_4_CH_5_ISR: service-id=0, is-reentrant=false, is-synchronous=true, call-type=INTERRUPT, execution-context=INTERRUPT-CAT-2
    FTM_6_CH_6_CH_7_ISR: service-id=0, is-reentrant=false, is-synchronous=true, call-type=INTERRUPT, execution-context=INTERRUPT-CAT-2
    FTM_6_OVF_ISR: service-id=0, is-reentrant=false, is-synchronous=true, call-type=INTERRUPT, execution-context=INTERRUPT-CAT-2
    FTM_7_CH_0_CH_1_ISR: service-id=0, is-reentrant=false, is-synchronous=true, call-type=INTERRUPT, execution-context=INTERRUPT-CAT-2
    FTM_7_CH_2_CH_3_ISR: service-id=0, is-reentrant=false, is-synchronous=true, call-type=INTERRUPT, execution-context=INTERRUPT-CAT-2
    FTM_7_CH_4_CH_5_ISR: service-id=0, is-reentrant=false, is-synchronous=true, call-type=INTERRUPT, execution-context=INTERRUPT-CAT-2
    FTM_7_CH_6_CH_7_ISR: service-id=0, is-reentrant=false, is-synchronous=true, call-type=INTERRUPT, execution-context=INTERRUPT-CAT-2
    FTM_7_OVF_ISR: service-id=0, is-reentrant=false, is-synchronous=true, call-type=INTERRUPT, execution-context=INTERRUPT-CAT-2
    SIUL2_0_ICU_EIRQ_SINGLE_INT_HANDLER: service-id=0, is-reentrant=false, is-synchronous=true, call-type=INTERRUPT, execution-context=INTERRUPT-CAT-2
    SIUL2_1_ICU_EIRQ_SINGLE_INT_HANDLER: service-id=0, is-reentrant=false, is-synchronous=true, call-type=INTERRUPT, execution-context=INTERRUPT-CAT-2
    SIUL2_4_ICU_EIRQ_SINGLE_INT_HANDLER: service-id=0, is-reentrant=false, is-synchronous=true, call-type=INTERRUPT, execution-context=INTERRUPT-CAT-2
    SIUL2_5_ICU_EIRQ_SINGLE_INT_HANDLER: service-id=0, is-reentrant=false, is-synchronous=true, call-type=INTERRUPT, execution-context=INTERRUPT-CAT-2
    SIUL2_EXT_IRQ_0_7_ISR: service-id=0, is-reentrant=false, is-synchronous=true, call-type=INTERRUPT, execution-context=INTERRUPT-CAT-2
    SIUL2_EXT_IRQ_16_23_ISR: service-id=0, is-reentrant=false, is-synchronous=true, call-type=INTERRUPT, execution-context=INTERRUPT-CAT-2
    SIUL2_EXT_IRQ_24_31_ISR: service-id=0, is-reentrant=false, is-synchronous=true, call-type=INTERRUPT, execution-context=INTERRUPT-CAT-2
    SIUL2_EXT_IRQ_8_15_ISR: service-id=0, is-reentrant=false, is-synchronous=true, call-type=INTERRUPT, execution-context=INTERRUPT-CAT-2
    WKPU_EXT_IRQ_0_7_ISR: service-id=0, is-reentrant=false, is-synchronous=true, call-type=INTERRUPT, execution-context=INTERRUPT-CAT-2
    WKPU_EXT_IRQ_16_23_ISR: service-id=0, is-reentrant=false, is-synchronous=true, call-type=INTERRUPT, execution-context=INTERRUPT-CAT-2
    WKPU_EXT_IRQ_24_31_ISR: service-id=0, is-reentrant=false, is-synchronous=true, call-type=INTERRUPT, execution-context=INTERRUPT-CAT-2
    WKPU_EXT_IRQ_8_15_ISR: service-id=0, is-reentrant=false, is-synchronous=true, call-type=INTERRUPT, execution-context=INTERRUPT-CAT-2
    WKPU_EXT_IRQ_SINGLE_ISR: service-id=0, is-reentrant=false, is-synchronous=true, call-type=INTERRUPT, execution-context=INTERRUPT-CAT-2
package /Icu_TS_T40D11M40I2R0/Implementations
  bsw implementation BswImplementation_0: programming-language=C, sw-version=4.0.2, vendor-id=43, ar-release-version=4.4.0, behavior=InternalBehavior_0, vendor-specific-module-def=Icu
    code-descriptors:
      code Files
        artifact-descriptors:
          short-label=config::Icu.xdm, category=SWCFG
          short-label=doc::RTD_ICU_IM.pdf, category=SWDOC
          short-label=doc::RTD_ICU_UM.pdf, category=SWDOC
          short-label=EBT::Icu.xdm, category=SWCFG
          short-label=examples::EBT::S32G2::Icu_CheckNofi_S32G274A_M7::generate::epc::BaseNXP.xdm, category=SWCFG
          short-label=examples::EBT::S32G2::Icu_CheckNofi_S32G274A_M7::generate::epc::Dem.xdm, category=SWCFG
          short-label=examples::EBT::S32G2::Icu_CheckNofi_S32G274A_M7::generate::epc::Dio.xdm, category=SWCFG
          short-label=examples::EBT::S32G2::Icu_CheckNofi_S32G274A_M7::generate::epc::Icu.xdm, category=SWCFG
          short-label=examples::EBT::S32G2::Icu_CheckNofi_S32G274A_M7::generate::epc::Mcu.xdm, category=SWCFG
          short-label=examples::EBT::S32G2::Icu_CheckNofi_S32G274A_M7::generate::epc::Platform.xdm, category=SWCFG
          short-label=examples::EBT::S32G2::Icu_CheckNofi_S32G274A_M7::generate::epc::Port.xdm, category=SWCFG
          short-label=examples::EBT::S32G2::Icu_CheckNofi_S32G274A_M7::generate::epc::Resource.xdm, category=SWCFG
          short-label=examples::EBT::S32G2::Icu_CheckNofi_S32G274A_M7::include::check_example.h, category=SWHDR
          short-label=examples::EBT::S32G2::Icu_CheckNofi_S32G274A_M7::src::main.c, category=SWSRC
          short-label=examples::EBT::S32G2::Icu_CheckNofi_S32G274A_M7::TresosProject::Icu_CheckNofi_S32G274A_M7::.prefs::preferences.xdm, category=SWCFG
          short-label=examples::EBT::S32G2::Icu_CheckNofi_S32G274A_M7::TresosProject::Icu_CheckNofi_S32G274A_M7::config::BaseNXP.xdm, category=SWCFG
          short-label=examples::EBT::S32G2::Icu_CheckNofi_S32G274A_M7::TresosProject::Icu_CheckNofi_S32G274A_M7::config::Dem.xdm, category=SWCFG
          short-label=examples::EBT::S32G2::Icu_CheckNofi_S32G274A_M7::TresosProject::Icu_CheckNofi_S32G274A_M7::config::Dio.xdm, category=SWCFG
          short-label=examples::EBT::S32G2::Icu_CheckNofi_S32G274A_M7::TresosProject::Icu_CheckNofi_S32G274A_M7::config::EcuC.xdm, category=SWCFG
          short-label=examples::EBT::S32G2::Icu_CheckNofi_S32G274A_M7::TresosProject::Icu_CheckNofi_S32G274A_M7::config::Icu.xdm, category=SWCFG
          short-label=examples::EBT::S32G2::Icu_CheckNofi_S32G274A_M7::TresosProject::Icu_CheckNofi_S32G274A_M7::config::Mcu.xdm, category=SWCFG
          short-label=examples::EBT::S32G2::Icu_CheckNofi_S32G274A_M7::TresosProject::Icu_CheckNofi_S32G274A_M7::config::Platform.xdm, category=SWCFG
          short-label=examples::EBT::S32G2::Icu_CheckNofi_S32G274A_M7::TresosProject::Icu_CheckNofi_S32G274A_M7::config::Port.xdm, category=SWCFG
          short-label=examples::EBT::S32G2::Icu_CheckNofi_S32G274A_M7::TresosProject::Icu_CheckNofi_S32G274A_M7::config::Resource.xdm, category=SWCFG
          short-label=examples::EBT::S32G3::Icu_CheckNofi_S32G399A_M7::generate::epc::BaseNXP.xdm, category=SWCFG
          short-label=examples::EBT::S32G3::Icu_CheckNofi_S32G399A_M7::generate::epc::Dem.xdm, category=SWCFG
          short-label=examples::EBT::S32G3::Icu_CheckNofi_S32G399A_M7::generate::epc::Dio.xdm, category=SWCFG
          short-label=examples::EBT::S32G3::Icu_CheckNofi_S32G399A_M7::generate::epc::Icu.xdm, category=SWCFG
          short-label=examples::EBT::S32G3::Icu_CheckNofi_S32G399A_M7::generate::epc::Mcu.xdm, category=SWCFG
          short-label=examples::EBT::S32G3::Icu_CheckNofi_S32G399A_M7::generate::epc::Platform.xdm, category=SWCFG
          short-label=examples::EBT::S32G3::Icu_CheckNofi_S32G399A_M7::generate::epc::Port.xdm, category=SWCFG
          short-label=examples::EBT::S32G3::Icu_CheckNofi_S32G399A_M7::generate::epc::Resource.xdm, category=SWCFG
          short-label=examples::EBT::S32G3::Icu_CheckNofi_S32G399A_M7::include::check_example.h, category=SWHDR
          short-label=examples::EBT::S32G3::Icu_CheckNofi_S32G399A_M7::src::main.c, category=SWSRC
          short-label=examples::EBT::S32G3::Icu_CheckNofi_S32G399A_M7::TresosProject::Icu_CheckNofi_S32G399A_M7::.prefs::preferences.xdm, category=SWCFG
          short-label=examples::EBT::S32G3::Icu_CheckNofi_S32G399A_M7::TresosProject::Icu_CheckNofi_S32G399A_M7::config::BaseNXP.xdm, category=SWCFG
          short-label=examples::EBT::S32G3::Icu_CheckNofi_S32G399A_M7::TresosProject::Icu_CheckNofi_S32G399A_M7::config::Dem.xdm, category=SWCFG
          short-label=examples::EBT::S32G3::Icu_CheckNofi_S32G399A_M7::TresosProject::Icu_CheckNofi_S32G399A_M7::config::Dio.xdm, category=SWCFG
          short-label=examples::EBT::S32G3::Icu_CheckNofi_S32G399A_M7::TresosProject::Icu_CheckNofi_S32G399A_M7::config::EcuC.xdm, category=SWCFG
          short-label=examples::EBT::S32G3::Icu_CheckNofi_S32G399A_M7::TresosProject::Icu_CheckNofi_S32G399A_M7::config::Icu.xdm, category=SWCFG
          short-label=examples::EBT::S32G3::Icu_CheckNofi_S32G399A_M7::TresosProject::Icu_CheckNofi_S32G399A_M7::config::Mcu.xdm, category=SWCFG
          short-label=examples::EBT::S32G3::Icu_CheckNofi_S32G399A_M7::TresosProject::Icu_CheckNofi_S32G399A_M7::config::Platform.xdm, category=SWCFG
          short-label=examples::EBT::S32G3::Icu_CheckNofi_S32G399A_M7::TresosProject::Icu_CheckNofi_S32G399A_M7::config::Port.xdm, category=SWCFG
          short-label=examples::EBT::S32G3::Icu_CheckNofi_S32G399A_M7::TresosProject::Icu_CheckNofi_S32G399A_M7::config::Resource.xdm, category=SWCFG
          short-label=examples::EBT::S32R45::Icu_BlinkLed_S32R45_M7::generate::epc::BaseNXP.xdm, category=SWCFG
          short-label=examples::EBT::S32R45::Icu_BlinkLed_S32R45_M7::generate::epc::Dem.xdm, category=SWCFG
          short-label=examples::EBT::S32R45::Icu_BlinkLed_S32R45_M7::generate::epc::Dio.xdm, category=SWCFG
          short-label=examples::EBT::S32R45::Icu_BlinkLed_S32R45_M7::generate::epc::Icu.xdm, category=SWCFG
          short-label=examples::EBT::S32R45::Icu_BlinkLed_S32R45_M7::generate::epc::Mcu.xdm, category=SWCFG
          short-label=examples::EBT::S32R45::Icu_BlinkLed_S32R45_M7::generate::epc::Platform.xdm, category=SWCFG
          short-label=examples::EBT::S32R45::Icu_BlinkLed_S32R45_M7::generate::epc::Port.xdm, category=SWCFG
          short-label=examples::EBT::S32R45::Icu_BlinkLed_S32R45_M7::generate::epc::Resource.xdm, category=SWCFG
          short-label=examples::EBT::S32R45::Icu_BlinkLed_S32R45_M7::include::check_example.h, category=SWHDR
          short-label=examples::EBT::S32R45::Icu_BlinkLed_S32R45_M7::src::main.c, category=SWSRC
          short-label=examples::EBT::S32R45::Icu_BlinkLed_S32R45_M7::TresosProject::Icu_BlinkLed_S32R45_M7::.prefs::preferences.xdm, category=SWCFG
          short-label=examples::EBT::S32R45::Icu_BlinkLed_S32R45_M7::TresosProject::Icu_BlinkLed_S32R45_M7::config::BaseNXP.xdm, category=SWCFG
          short-label=examples::EBT::S32R45::Icu_BlinkLed_S32R45_M7::TresosProject::Icu_BlinkLed_S32R45_M7::config::Dem.xdm, category=SWCFG
          short-label=examples::EBT::S32R45::Icu_BlinkLed_S32R45_M7::TresosProject::Icu_BlinkLed_S32R45_M7::config::Dio.xdm, category=SWCFG
          short-label=examples::EBT::S32R45::Icu_BlinkLed_S32R45_M7::TresosProject::Icu_BlinkLed_S32R45_M7::config::EcuC.xdm, category=SWCFG
          short-label=examples::EBT::S32R45::Icu_BlinkLed_S32R45_M7::TresosProject::Icu_BlinkLed_S32R45_M7::config::Icu.xdm, category=SWCFG
          short-label=examples::EBT::S32R45::Icu_BlinkLed_S32R45_M7::TresosProject::Icu_BlinkLed_S32R45_M7::config::Mcu.xdm, category=SWCFG
          short-label=examples::EBT::S32R45::Icu_BlinkLed_S32R45_M7::TresosProject::Icu_BlinkLed_S32R45_M7::config::Platform.xdm, category=SWCFG
          short-label=examples::EBT::S32R45::Icu_BlinkLed_S32R45_M7::TresosProject::Icu_BlinkLed_S32R45_M7::config::Port.xdm, category=SWCFG
          short-label=examples::EBT::S32R45::Icu_BlinkLed_S32R45_M7::TresosProject::Icu_BlinkLed_S32R45_M7::config::Resource.xdm, category=SWCFG
          short-label=examples::S32DS::S32G2::Ftm_Icu_Ip_CheckNofi_S32G274A_M7::include::check_example.h, category=SWHDR
          short-label=examples::S32DS::S32G2::Ftm_Icu_Ip_CheckNofi_S32G274A_M7::Project_Settings::Startup_Code::exceptions.c, category=SWSRC
          short-label=examples::S32DS::S32G2::Ftm_Icu_Ip_CheckNofi_S32G274A_M7::Project_Settings::Startup_Code::nvic.c, category=SWSRC
          short-label=examples::S32DS::S32G2::Ftm_Icu_Ip_CheckNofi_S32G274A_M7::Project_Settings::Startup_Code::startup.c, category=SWSRC
          short-label=examples::S32DS::S32G2::Ftm_Icu_Ip_CheckNofi_S32G274A_M7::Project_Settings::Startup_Code::system.c, category=SWSRC
          short-label=examples::S32DS::S32G2::Ftm_Icu_Ip_CheckNofi_S32G274A_M7::src::main.c, category=SWSRC
          short-label=examples::S32DS::S32G2::Icu_CheckNofi_S32G274A_M7::include::check_example.h, category=SWHDR
          short-label=examples::S32DS::S32G2::Icu_CheckNofi_S32G274A_M7::Project_Settings::Startup_Code::exceptions.c, category=SWSRC
          short-label=examples::S32DS::S32G2::Icu_CheckNofi_S32G274A_M7::Project_Settings::Startup_Code::nvic.c, category=SWSRC
          short-label=examples::S32DS::S32G2::Icu_CheckNofi_S32G274A_M7::Project_Settings::Startup_Code::startup.c, category=SWSRC
          short-label=examples::S32DS::S32G2::Icu_CheckNofi_S32G274A_M7::Project_Settings::Startup_Code::system.c, category=SWSRC
          short-label=examples::S32DS::S32G2::Icu_CheckNofi_S32G274A_M7::src::main.c, category=SWSRC
          short-label=examples::S32DS::S32G3::Ftm_Icu_Ip_CheckNofi_S32G399A_M7::include::check_example.h, category=SWHDR
          short-label=examples::S32DS::S32G3::Ftm_Icu_Ip_CheckNofi_S32G399A_M7::Project_Settings::Startup_Code::exceptions.c, category=SWSRC
          short-label=examples::S32DS::S32G3::Ftm_Icu_Ip_CheckNofi_S32G399A_M7::Project_Settings::Startup_Code::nvic.c, category=SWSRC
          short-label=examples::S32DS::S32G3::Ftm_Icu_Ip_CheckNofi_S32G399A_M7::Project_Settings::Startup_Code::startup.c, category=SWSRC
          short-label=examples::S32DS::S32G3::Ftm_Icu_Ip_CheckNofi_S32G399A_M7::Project_Settings::Startup_Code::system.c, category=SWSRC
          short-label=examples::S32DS::S32G3::Ftm_Icu_Ip_CheckNofi_S32G399A_M7::src::main.c, category=SWSRC
          short-label=examples::S32DS::S32G3::Icu_CheckNofi_S32G399A_M7::include::check_example.h, category=SWHDR
          short-label=examples::S32DS::S32G3::Icu_CheckNofi_S32G399A_M7::Project_Settings::Startup_Code::exceptions.c, category=SWSRC
          short-label=examples::S32DS::S32G3::Icu_CheckNofi_S32G399A_M7::Project_Settings::Startup_Code::nvic.c, category=SWSRC
          short-label=examples::S32DS::S32G3::Icu_CheckNofi_S32G399A_M7::Project_Settings::Startup_Code::startup.c, category=SWSRC
          short-label=examples::S32DS::S32G3::Icu_CheckNofi_S32G399A_M7::Project_Settings::Startup_Code::system.c, category=SWSRC
          short-label=examples::S32DS::S32G3::Icu_CheckNofi_S32G399A_M7::src::main.c, category=SWSRC
          short-label=examples::S32DS::S32R45::Ftm_Icu_Ip_BlinkLed_S32R45_M7::include::check_example.h, category=SWHDR
          short-label=examples::S32DS::S32R45::Ftm_Icu_Ip_BlinkLed_S32R45_M7::Project_Settings::Startup_Code::exceptions.c, category=SWSRC
          short-label=examples::S32DS::S32R45::Ftm_Icu_Ip_BlinkLed_S32R45_M7::Project_Settings::Startup_Code::nvic.c, category=SWSRC
          short-label=examples::S32DS::S32R45::Ftm_Icu_Ip_BlinkLed_S32R45_M7::Project_Settings::Startup_Code::startup.c, category=SWSRC
          short-label=examples::S32DS::S32R45::Ftm_Icu_Ip_BlinkLed_S32R45_M7::Project_Settings::Startup_Code::system.c, category=SWSRC
          short-label=examples::S32DS::S32R45::Ftm_Icu_Ip_BlinkLed_S32R45_M7::src::main.c, category=SWSRC
          short-label=examples::S32DS::S32R45::Icu_BlinkLed_S32R45_M7::include::check_example.h, category=SWHDR
          short-label=examples::S32DS::S32R45::Icu_BlinkLed_S32R45_M7::Project_Settings::Startup_Code::exceptions.c, category=SWSRC
          short-label=examples::S32DS::S32R45::Icu_BlinkLed_S32R45_M7::Project_Settings::Startup_Code::nvic.c, category=SWSRC
          short-label=examples::S32DS::S32R45::Icu_BlinkLed_S32R45_M7::Project_Settings::Startup_Code::startup.c, category=SWSRC
          short-label=examples::S32DS::S32R45::Icu_BlinkLed_S32R45_M7::Project_Settings::Startup_Code::system.c, category=SWSRC
          short-label=examples::S32DS::S32R45::Icu_BlinkLed_S32R45_M7::src::main.c, category=SWSRC
          short-label=include::Ftm_Icu_Ip.h, category=SWHDR
          short-label=include::Ftm_Icu_Ip_Irq.h, category=SWHDR
          short-label=include::Ftm_Icu_Ip_TrustedFunctions.h, category=SWHDR
          short-label=include::Ftm_Icu_Ip_Types.h, category=SWHDR
          short-label=include::Icu.h, category=SWHDR
          short-label=include::Icu_EnvCfg.h, category=SWHDR
          short-label=include::Icu_Ipw.h, category=SWHDR
          short-label=include::Icu_Ipw_Irq.h, category=SWHDR
          short-label=include::Icu_Ipw_Types.h, category=SWHDR
          short-label=include::Icu_Irq.h, category=SWHDR
          short-label=include::Icu_Types.h, category=SWHDR
          short-label=include::Siul2_Icu_Ip.h, category=SWHDR
          short-label=include::Siul2_Icu_Ip_Irq.h, category=SWHDR
          short-label=include::Siul2_Icu_Ip_TrustedFunctions.h, category=SWHDR
          short-label=include::Siul2_Icu_Ip_Types.h, category=SWHDR
          short-label=include::Wkpu_Ip.h, category=SWHDR
          short-label=include::Wkpu_Ip_Irq.h, category=SWHDR
          short-label=include::Wkpu_Ip_TrustedFunctions.h, category=SWHDR
          short-label=include::Wkpu_Ip_Types.h, category=SWHDR
          short-label=src::Ftm_Icu_Ip.c, category=SWSRC
          short-label=src::Ftm_Icu_Ip_Irq.c, category=SWSRC
          short-label=src::Icu.c, category=SWSRC
          short-label=src::Icu_Ipw.c, category=SWSRC
          short-label=src::Siul2_Icu_Ip.c, category=SWSRC
          short-label=src::Siul2_Icu_Ip_Irq.c, category=SWSRC
          short-label=src::Wkpu_Ip.c, category=SWSRC
          short-label=src::Wkpu_Ip_Irq.c, category=SWSRC
    compiler DIAB_Compiler:
      name=Windriver Diab
      options=-tARMCORTEXM7MG:simple -mthumb -std=c99 -Oz -g -fstandalone-debug -Wstrict-prototypes -Wsign-compare -Wdouble-promotion -Wunknown-pragmas -Wundef -Wextra -Wall -pedantic -Werror=implicit-function-declaration -fno-common -fno-signed-char -fno-trigraphs -V -c -DS32XX -DS32G2XX -DS32G3XX -DS32R45 -DDIAB -DUSE_SW_VECTOR_MODE -DD_CACHE_ENABLE -DI_CACHE_ENABLE -DENABLE_FPU -DMCAL_ENABLE_USER_MODE_SUPPORT
      vendor=Windriver
      version=DIAB_7_0_3_0-FCS_20200409_160912
    compiler GCC_Compiler:
      name=GCC Compiler
      options=-mcpu=cortex-m7 -mthumb -mlittle-endian -mfpu=fpv5-sp-d16 -mfloat-abi=hard -std=c99 -Os -ggdb3 -Wall -Wextra -pedantic -Wstrict-prototypes -Wundef -Wunused -Werror=implicit-function-declaration -Wsign-compare -Wdouble-promotion -fno-short-enums -funsigned-char -funsigned-bitfields -fomit-frame-pointer -fno-common -fstack-usage -fdump-ipa-all -c -DS32XX -DS32G2XX -DS32G3XX -DS32R45 -DGCC -DUSE_SW_VECTOR_MODE -DD_CACHE_ENABLE -DI_CACHE_ENABLE -DENABLE_FPU -DMCAL_ENABLE_USER_MODE_SUPPORT
      vendor=GCC Systems
      version=NXP GCC 9.2.0 20190812 (Build 1649 Revision gaf57174)
    compiler GHS_Compiler:
      name=Green Hills
      options=-cpu=cortexm7 -thumb -fpu=vfpv5_d16 -fsingle -C99 --ghstd=last -Osize --gnu_asm -dual_debug -G -keeptempfiles -Wimplicit-int -Wshadow -Wtrigraphs -Wundef --unsigned_chars --unsigned_fields --no_commons --no_exceptions --no_slash_comment --prototype_errors --incorrect_pragma_warnings -c -DS32XX -DS32G2XX -DS32G3XX -DS32R45 -DGHS -DUSE_SW_VECTOR_MODE -DD_CACHE_ENABLE -DI_CACHE_ENABLE -DENABLE_FPU -DMCAL_ENABLE_USER_MODE_SUPPORT
      vendor=Green Hills
      version=Green Hills Multi 7.1.6d / Compiler 2020.1.4
    generated-artifacts:
      20 x dependency on artifact:
        Ftm_Icu_Ip_PBcfg_h: artifact-descriptor={short-label=generate_PB::include::Ftm_Icu_Ip_PBcfg.h, category=SWHDR}, usages=EXECUTE
        Icu_Ipw_PBcfg_h: artifact-descriptor={short-label=generate_PB::include::Icu_Ipw_PBcfg.h, category=SWHDR}, usages=EXECUTE
        Icu_PBcfg_h: artifact-descriptor={short-label=generate_PB::include::Icu_PBcfg.h, category=SWHDR}, usages=EXECUTE
        Siul2_Icu_Ip_PBcfg_h: artifact-descriptor={short-label=generate_PB::include::Siul2_Icu_Ip_PBcfg.h, category=SWHDR}, usages=EXECUTE
        Wkpu_Ip_PBcfg_h: artifact-descriptor={short-label=generate_PB::include::Wkpu_Ip_PBcfg.h, category=SWHDR}, usages=EXECUTE
        Ftm_Icu_Ip_PBcfg_c: artifact-descriptor={short-label=generate_PB::src::Ftm_Icu_Ip_PBcfg.c, category=SWSRC}, usages=EXECUTE
        Icu_DmaNotification_c: artifact-descriptor={short-label=generate_PB::src::Icu_DmaNotification.c, category=SWSRC}, usages=EXECUTE
        Icu_Ipw_PBcfg_c: artifact-descriptor={short-label=generate_PB::src::Icu_Ipw_PBcfg.c, category=SWSRC}, usages=EXECUTE
        Icu_PBcfg_c: artifact-descriptor={short-label=generate_PB::src::Icu_PBcfg.c, category=SWSRC}, usages=EXECUTE
        Siul2_Icu_Ip_PBcfg_c: artifact-descriptor={short-label=generate_PB::src::Siul2_Icu_Ip_PBcfg.c, category=SWSRC}, usages=EXECUTE
        Wkpu_Ip_PBcfg_c: artifact-descriptor={short-label=generate_PB::src::Wkpu_Ip_PBcfg.c, category=SWSRC}, usages=EXECUTE
        Ftm_Icu_Ip_Cfg_h: artifact-descriptor={short-label=generate_PC::include::Ftm_Icu_Ip_Cfg.h, category=SWHDR}, usages=COMPILE
        Ftm_Icu_Ip_Defines_h: artifact-descriptor={short-label=generate_PC::include::Ftm_Icu_Ip_Defines.h, category=SWHDR}, usages=COMPILE
        Icu_Cfg_h: artifact-descriptor={short-label=generate_PC::include::Icu_Cfg.h, category=SWHDR}, usages=COMPILE
        Icu_Ipw_Cfg_h: artifact-descriptor={short-label=generate_PC::include::Icu_Ipw_Cfg.h, category=SWHDR}, usages=COMPILE
        Siul2_Icu_Ip_Cfg_h: artifact-descriptor={short-label=generate_PC::include::Siul2_Icu_Ip_Cfg.h, category=SWHDR}, usages=COMPILE
        Siul2_Icu_Ip_Defines_h: artifact-descriptor={short-label=generate_PC::include::Siul2_Icu_Ip_Defines.h, category=SWHDR}, usages=COMPILE
        Wkpu_Ip_Cfg_h: artifact-descriptor={short-label=generate_PC::include::Wkpu_Ip_Cfg.h, category=SWHDR}, usages=COMPILE
        Wkpu_Ip_Defines_h: artifact-descriptor={short-label=generate_PC::include::Wkpu_Ip_Defines.h, category=SWHDR}, usages=COMPILE
        Icu_Cfg_c: artifact-descriptor={short-label=generate_PC::src::Icu_Cfg.c, category=SWSRC}, usages=COMPILE
    linker DIAB_Linker: name=Windriver Diab, options=-e Reset_Handler linker_script_file.dld -m30 -Xstack-usage -Xpreprocess-lecl -Llibrary_path -lc -lm, vendor=Windriver, version=DIAB_7_0_3_0-FCS_20200409_160912
    linker GCC_Linker: name=GCC Compiler, options=-Wl,-Map,filename -T linkerfile --entry=Reset_Handler -nostartfiles -mcpu=cortexm7 -mthumb -mfpu=fpv5-sp-d16 -mfloat-abi=hard -mlittle-endian -ggdb3 -lc -lm -lgcc, vendor=GCC Systems, version=NXP GCC 9.2.0 20190812 (Build 1649 Revision gaf57174)
    linker GHS_Linker: name=Green Hills, options=-e Reset_Handler -T linker_script_file.ld -map -keepmap -Mn -delete -ignore_debug_references -Llibrary_path -larch -lstartup -lind_sd -v -nostartfiles, vendor=Green Hills, version=Green Hills Multi 7.1.6d / Compiler 2020.1.4
    resource consumption ResourceConsumption
      6 x memory section:
        ICU_CODE: alignment=UNSPECIFIED, sw-addrmethod=CODE, symbol=CODE
        ICU_CONFIG_DATA_UNSPECIFIED: alignment=UNSPECIFIED, sw-addrmethod=CONFIG_DATA, symbol=CONFIG_DATA_UNSPECIFIED
        ICU_CONST_UNSPECIFIED: alignment=UNSPECIFIED, sw-addrmethod=CONST, symbol=CONST_UNSPECIFIED
        ICU_VAR_CLEARED_16: alignment=16, sw-addrmethod=VAR_CLEARED, symbol=VAR_CLEARED_16
        ICU_VAR_CLEARED_UNSPECIFIED: alignment=UNSPECIFIED, sw-addrmethod=VAR_CLEARED, symbol=VAR_CLEARED_UNSPECIFIED
        ICU_VAR_CLEARED_UNSPECIFIED_NO_CACHEABLE: alignment=UNSPECIFIED, sw-addrmethod=VAR_CLEARED_NO_CACHEABLE, symbol=VAR_CLEARED_UNSPECIFIED_NO_CACHEABLE
