AUTOSAR XML (schema 00046)
package /AUTOSAR_Mcl/BswModuleDescriptions
  bsw module description Mcl: module-id=255
    provided-entrys:
      Mcl_CacheClean
      Mcl_CacheCleanByAddr
      Mcl_CacheDisable
      Mcl_CacheEnable
      Mcl_CacheInvalidate
      Mcl_CacheInvalidateByAddr
      Mcl_DeInit
      Mcl_GetDmaChannelParam
      Mcl_GetDmaChannelStatus
      Mcl_GetDmaInstanceStatus
      Mcl_GetVersionInfo
      Mcl_Init
      Mcl_SetDmaChannelCommand
      Mcl_SetDmaChannelCrcList
      Mcl_SetDmaChannelGlobalList
      Mcl_SetDmaChannelScatterGatherConfig
      Mcl_SetDmaChannelScatterGatherList
      Mcl_SetDmaChannelTransferList
      Mcl_SetDmaInstanceCommand
      Dma0_Ch0_Ch15_IrqHandler
      Dma0_Ch16_Ch31_IrqHandler
      Dma0_Error_IrqHandler
      Dma1_Ch0_Ch15_IrqHandler
      Dma1_Ch16_Ch31_IrqHandler
      Dma1_Error_IrqHandler
    bsw internal behavior InternalBehavior_0
      19 x exclusive area:
        MCL_EXCLUSIVE_AREA_{00..18}
      19 x bsw called entity:
        Mcl_CacheClean: can-enter-exclusive-area=MCL_EXCLUSIVE_AREA_16, implemented-entry=Mcl_CacheClean
        Mcl_CacheCleanByAddr: can-enter-exclusive-area=MCL_EXCLUSIVE_AREA_18, implemented-entry=Mcl_CacheCleanByAddr
        Mcl_CacheDisable: can-enter-exclusive-area=MCL_EXCLUSIVE_AREA_14, implemented-entry=Mcl_CacheDisable
        Mcl_CacheEnable: can-enter-exclusive-area=MCL_EXCLUSIVE_AREA_13, implemented-entry=Mcl_CacheEnable
        Mcl_CacheInvalidate: can-enter-exclusive-area=MCL_EXCLUSIVE_AREA_15, implemented-entry=Mcl_CacheInvalidate
        Mcl_CacheInvalidateByAddr: can-enter-exclusive-area=MCL_EXCLUSIVE_AREA_17, implemented-entry=Mcl_CacheInvalidateByAddr
        Mcl_DeInit: can-enter-exclusive-area=[MCL_EXCLUSIVE_AREA_01, MCL_EXCLUSIVE_AREA_04], implemented-entry=Mcl_DeInit
        Mcl_GetDmaChannelParam: implemented-entry=Mcl_GetDmaChannelParam
        Mcl_GetDmaChannelStatus: can-enter-exclusive-area=MCL_EXCLUSIVE_AREA_06, implemented-entry=Mcl_GetDmaChannelStatus
        Mcl_GetDmaInstanceStatus: implemented-entry=Mcl_GetDmaInstanceStatus
        Mcl_GetVersionInfo: implemented-entry=Mcl_GetVersionInfo
        Mcl_Init: can-enter-exclusive-area=[MCL_EXCLUSIVE_AREA_00, MCL_EXCLUSIVE_AREA_03, MCL_EXCLUSIVE_AREA_12], implemented-entry=Mcl_Init
        Mcl_SetDmaChannelCommand: can-enter-exclusive-area=MCL_EXCLUSIVE_AREA_05, implemented-entry=Mcl_SetDmaChannelCommand
        Mcl_SetDmaChannelCrcList: implemented-entry=Mcl_SetDmaChannelCrcList
        Mcl_SetDmaChannelGlobalList: can-enter-exclusive-area=[MCL_EXCLUSIVE_AREA_07, MCL_EXCLUSIVE_AREA_08], implemented-entry=Mcl_SetDmaChannelGlobalList
        Mcl_SetDmaChannelScatterGatherConfig: can-enter-exclusive-area=MCL_EXCLUSIVE_AREA_11, implemented-entry=Mcl_SetDmaChannelScatterGatherConfig
        Mcl_SetDmaChannelScatterGatherList: can-enter-exclusive-area=[MCL_EXCLUSIVE_AREA_09, MCL_EXCLUSIVE_AREA_10], implemented-entry=Mcl_SetDmaChannelScatterGatherList
        Mcl_SetDmaChannelTransferList: implemented-entry=Mcl_SetDmaChannelTransferList
        Mcl_SetDmaInstanceCommand: can-enter-exclusive-area=MCL_EXCLUSIVE_AREA_02, implemented-entry=Mcl_SetDmaInstanceCommand
      6 x bsw interrupt entity, all with interrupt-category=CAT-2, interrupt-source=Hardware:
        Dma0_Ch0_Ch15_IrqHandler: implemented-entry=Dma0_Ch0_Ch15_IrqHandler
        Dma0_Ch16_Ch31_IrqHandler: implemented-entry=Dma0_Ch16_Ch31_IrqHandler
        Dma0_Error_IrqHandler: implemented-entry=Dma0_Error_IrqHandler
        Dma1_Ch0_Ch15_IrqHandler: implemented-entry=Dma1_Ch0_Ch15_IrqHandler
        Dma1_Ch16_Ch31_IrqHandler: implemented-entry=Dma1_Ch16_Ch31_IrqHandler
        Dma1_Error_IrqHandler: implemented-entry=Dma1_Error_IrqHandler
package /AUTOSAR_Mcl/BswModuleEntrys
  25 x bsw module entry, all with is-synchronous=true, sw-service-impl-policy=STANDARD:
    Mcl_CacheClean: service-id=0x13, is-reentrant=true, call-type=REGULAR, execution-context=UNSPECIFIED
    Mcl_CacheCleanByAddr: service-id=0x15, is-reentrant=true, call-type=REGULAR, execution-context=UNSPECIFIED
    Mcl_CacheDisable: service-id=0x11, is-reentrant=true, call-type=REGULAR, execution-context=UNSPECIFIED
    Mcl_CacheEnable: service-id=0x10, is-reentrant=true, call-type=REGULAR, execution-context=UNSPECIFIED
    Mcl_CacheInvalidate: service-id=0x12, is-reentrant=true, call-type=REGULAR, execution-context=UNSPECIFIED
    Mcl_CacheInvalidateByAddr: service-id=0x14, is-reentrant=true, call-type=REGULAR, execution-context=UNSPECIFIED
    Mcl_DeInit: service-id=0x0b, is-reentrant=false, call-type=REGULAR, execution-context=UNSPECIFIED
    Mcl_GetDmaChannelParam: service-id=0x08, is-reentrant=true, call-type=REGULAR, execution-context=UNSPECIFIED
    Mcl_GetDmaChannelStatus: service-id=0x04, is-reentrant=true, call-type=REGULAR, execution-context=UNSPECIFIED
    Mcl_GetDmaInstanceStatus: service-id=0x02, is-reentrant=true, call-type=REGULAR, execution-context=UNSPECIFIED
    Mcl_GetVersionInfo: service-id=0x60, is-reentrant=true, call-type=REGULAR, execution-context=UNSPECIFIED
    Mcl_Init: service-id=0x00, is-reentrant=false, call-type=REGULAR, execution-context=UNSPECIFIED
    Mcl_SetDmaChannelCommand: service-id=0x03, is-reentrant=true, call-type=REGULAR, execution-context=UNSPECIFIED
    Mcl_SetDmaChannelCrcList: service-id=0x0a, is-reentrant=true, call-type=REGULAR, execution-context=UNSPECIFIED
    Mcl_SetDmaChannelGlobalList: service-id=0x05, is-reentrant=true, call-type=REGULAR, execution-context=UNSPECIFIED
    Mcl_SetDmaChannelScatterGatherConfig: service-id=0x09, is-reentrant=true, call-type=REGULAR, execution-context=UNSPECIFIED
    Mcl_SetDmaChannelScatterGatherList: service-id=0x07, is-reentrant=true, call-type=REGULAR, execution-context=UNSPECIFIED
    Mcl_SetDmaChannelTransferList: service-id=0x06, is-reentrant=true, call-type=REGULAR, execution-context=UNSPECIFIED
    Mcl_SetDmaInstanceCommand: service-id=0x01, is-reentrant=true, call-type=REGULAR, execution-context=UNSPECIFIED
    Dma0_Ch0_Ch15_IrqHandler: service-id=0, is-reentrant=false, call-type=INTERRUPT, execution-context=INTERRUPT-CAT-2
    Dma0_Ch16_Ch31_IrqHandler: service-id=0, is-reentrant=false, call-type=INTERRUPT, execution-context=INTERRUPT-CAT-2
    Dma0_Error_IrqHandler: service-id=0, is-reentrant=false, call-type=INTERRUPT, execution-context=INTERRUPT-CAT-2
    Dma1_Ch0_Ch15_IrqHandler: service-id=0, is-reentrant=false, call-type=INTERRUPT, execution-context=INTERRUPT-CAT-2
    Dma1_Ch16_Ch31_IrqHandler: service-id=0, is-reentrant=false, call-type=INTERRUPT, execution-context=INTERRUPT-CAT-2
    Dma1_Error_IrqHandler: service-id=0, is-reentrant=false, call-type=INTERRUPT, execution-context=INTERRUPT-CAT-2
package /Mcl_TS_T40D11M40I2R0/Implementations
  bsw implementation BswImplementation_0: programming-language=C, sw-version=4.0.2, vendor-id=43, ar-release-version=4.4.0, behavior=InternalBehavior_0, vendor-specific-module-def=Mcl
    code-descriptors:
      code Files
        artifact-descriptors:
          short-label=config::Mcl.xdm, category=SWCFG
          short-label=doc::RTD_MCL_IM.pdf, category=SWDOC
          short-label=doc::RTD_MCL_UM.pdf, category=SWDOC
          short-label=examples::EBT::S32G2::Mcl_DmaTransfer_S32G274A_M7::generate::epc::BaseNXP.xdm, category=SWCFG
          short-label=examples::EBT::S32G2::Mcl_DmaTransfer_S32G274A_M7::generate::epc::Mcl.xdm, category=SWCFG
          short-label=examples::EBT::S32G2::Mcl_DmaTransfer_S32G274A_M7::generate::epc::Mcu.xdm, category=SWCFG
          short-label=examples::EBT::S32G2::Mcl_DmaTransfer_S32G274A_M7::generate::epc::Platform.xdm, category=SWCFG
          short-label=examples::EBT::S32G2::Mcl_DmaTransfer_S32G274A_M7::generate::epc::Resource.xdm, category=SWCFG
          short-label=examples::EBT::S32G2::Mcl_DmaTransfer_S32G274A_M7::include::check_example.h, category=SWHDR
          short-label=examples::EBT::S32G2::Mcl_DmaTransfer_S32G274A_M7::include::Mcl_Example_EBT.h, category=SWHDR
          short-label=examples::EBT::S32G2::Mcl_DmaTransfer_S32G274A_M7::src::main.c, category=SWSRC
          short-label=examples::EBT::S32G2::Mcl_DmaTransfer_S32G274A_M7::TresosProject::Mcl_DmaTransfer_S32G274A_M7::.prefs::preferences.xdm, category=SWCFG
          short-label=examples::EBT::S32G2::Mcl_DmaTransfer_S32G274A_M7::TresosProject::Mcl_DmaTransfer_S32G274A_M7::config::BaseNXP.xdm, category=SWCFG
          short-label=examples::EBT::S32G2::Mcl_DmaTransfer_S32G274A_M7::TresosProject::Mcl_DmaTransfer_S32G274A_M7::config::EcuC.xdm, category=SWCFG
          short-label=examples::EBT::S32G2::Mcl_DmaTransfer_S32G274A_M7::TresosProject::Mcl_DmaTransfer_S32G274A_M7::config::Mcl.xdm, category=SWCFG
          short-label=examples::EBT::S32G2::Mcl_DmaTransfer_S32G274A_M7::TresosProject::Mcl_DmaTransfer_S32G274A_M7::config::Mcu.xdm, category=SWCFG
          short-label=examples::EBT::S32G2::Mcl_DmaTransfer_S32G274A_M7::TresosProject::Mcl_DmaTransfer_S32G274A_M7::config::Platform.xdm, category=SWCFG
          short-label=examples::EBT::S32G2::Mcl_DmaTransfer_S32G274A_M7::TresosProject::Mcl_DmaTransfer_S32G274A_M7::config::Resource.xdm, category=SWCFG
          short-label=examples::EBT::S32G3::Mcl_DmaTransfer_S32G399A_M7::generate::epc::BaseNXP.xdm, category=SWCFG
          short-label=examples::EBT::S32G3::Mcl_DmaTransfer_S32G399A_M7::generate::epc::Mcl.xdm, category=SWCFG
          short-label=examples::EBT::S32G3::Mcl_DmaTransfer_S32G399A_M7::generate::epc::Mcu.xdm, category=SWCFG
          short-label=examples::EBT::S32G3::Mcl_DmaTransfer_S32G399A_M7::generate::epc::Platform.xdm, category=SWCFG
          short-label=examples::EBT::S32G3::Mcl_DmaTransfer_S32G399A_M7::generate::epc::Resource.xdm, category=SWCFG
          short-label=examples::EBT::S32G3::Mcl_DmaTransfer_S32G399A_M7::include::check_example.h, category=SWHDR
          short-label=examples::EBT::S32G3::Mcl_DmaTransfer_S32G399A_M7::include::Mcl_Example_EBT.h, category=SWHDR
          short-label=examples::EBT::S32G3::Mcl_DmaTransfer_S32G399A_M7::src::main.c, category=SWSRC
          short-label=examples::EBT::S32G3::Mcl_DmaTransfer_S32G399A_M7::TresosProject::Mcl_DmaTransfer_S32G399A_M7::.prefs::preferences.xdm, category=SWCFG
          short-label=examples::EBT::S32G3::Mcl_DmaTransfer_S32G399A_M7::TresosProject::Mcl_DmaTransfer_S32G399A_M7::config::BaseNXP.xdm, category=SWCFG
          short-label=examples::EBT::S32G3::Mcl_DmaTransfer_S32G399A_M7::TresosProject::Mcl_DmaTransfer_S32G399A_M7::config::EcuC.xdm, category=SWCFG
          short-label=examples::EBT::S32G3::Mcl_DmaTransfer_S32G399A_M7::TresosProject::Mcl_DmaTransfer_S32G399A_M7::config::Mcl.xdm, category=SWCFG
          short-label=examples::EBT::S32G3::Mcl_DmaTransfer_S32G399A_M7::TresosProject::Mcl_DmaTransfer_S32G399A_M7::config::Mcu.xdm, category=SWCFG
          short-label=examples::EBT::S32G3::Mcl_DmaTransfer_S32G399A_M7::TresosProject::Mcl_DmaTransfer_S32G399A_M7::config::Platform.xdm, category=SWCFG
          short-label=examples::EBT::S32G3::Mcl_DmaTransfer_S32G399A_M7::TresosProject::Mcl_DmaTransfer_S32G399A_M7::config::Resource.xdm, category=SWCFG
          short-label=examples::EBT::S32R45::Mcl_DmaTransfer_S32R45_M7::generate::epc::BaseNXP.xdm, category=SWCFG
          short-label=examples::EBT::S32R45::Mcl_DmaTransfer_S32R45_M7::generate::epc::Mcl.xdm, category=SWCFG
          short-label=examples::EBT::S32R45::Mcl_DmaTransfer_S32R45_M7::generate::epc::Mcu.xdm, category=SWCFG
          short-label=examples::EBT::S32R45::Mcl_DmaTransfer_S32R45_M7::generate::epc::Platform.xdm, category=SWCFG
          short-label=examples::EBT::S32R45::Mcl_DmaTransfer_S32R45_M7::generate::epc::Resource.xdm, category=SWCFG
          short-label=examples::EBT::S32R45::Mcl_DmaTransfer_S32R45_M7::include::check_example.h, category=SWHDR
          short-label=examples::EBT::S32R45::Mcl_DmaTransfer_S32R45_M7::include::Mcl_Example_EBT.h, category=SWHDR
          short-label=examples::EBT::S32R45::Mcl_DmaTransfer_S32R45_M7::src::main.c, category=SWSRC
          short-label=examples::EBT::S32R45::Mcl_DmaTransfer_S32R45_M7::TresosProject::Mcl_DmaTransfer_S32R45_M7::.prefs::preferences.xdm, category=SWCFG
          short-label=examples::EBT::S32R45::Mcl_DmaTransfer_S32R45_M7::TresosProject::Mcl_DmaTransfer_S32R45_M7::config::BaseNXP.xdm, category=SWCFG
          short-label=examples::EBT::S32R45::Mcl_DmaTransfer_S32R45_M7::TresosProject::Mcl_DmaTransfer_S32R45_M7::config::EcuC.xdm, category=SWCFG
          short-label=examples::EBT::S32R45::Mcl_DmaTransfer_S32R45_M7::TresosProject::Mcl_DmaTransfer_S32R45_M7::config::Mcl.xdm, category=SWCFG
          short-label=examples::EBT::S32R45::Mcl_DmaTransfer_S32R45_M7::TresosProject::Mcl_DmaTransfer_S32R45_M7::config::Mcu.xdm, category=SWCFG
          short-label=examples::EBT::S32R45::Mcl_DmaTransfer_S32R45_M7::TresosProject::Mcl_DmaTransfer_S32R45_M7::config::Platform.xdm, category=SWCFG
          short-label=examples::EBT::S32R45::Mcl_DmaTransfer_S32R45_M7::TresosProject::Mcl_DmaTransfer_S32R45_M7::config::Resource.xdm, category=SWCFG
          short-label=examples::S32DS::S32G2::Dma_Ip_DmaTransfer_S32G274A_M7::include::check_example.h, category=SWHDR
          short-label=examples::S32DS::S32G2::Dma_Ip_DmaTransfer_S32G274A_M7::Project_Settings::Startup_Code::exceptions.c, category=SWSRC
          short-label=examples::S32DS::S32G2::Dma_Ip_DmaTransfer_S32G274A_M7::Project_Settings::Startup_Code::nvic.c, category=SWSRC
          short-label=examples::S32DS::S32G2::Dma_Ip_DmaTransfer_S32G274A_M7::Project_Settings::Startup_Code::startup.c, category=SWSRC
          short-label=examples::S32DS::S32G2::Dma_Ip_DmaTransfer_S32G274A_M7::Project_Settings::Startup_Code::system.c, category=SWSRC
          short-label=examples::S32DS::S32G2::Dma_Ip_DmaTransfer_S32G274A_M7::src::main.c, category=SWSRC
          short-label=examples::S32DS::S32G2::Mcl_DmaTransfer_S32G274A_M7::include::check_example.h, category=SWHDR
          short-label=examples::S32DS::S32G2::Mcl_DmaTransfer_S32G274A_M7::Project_Settings::Startup_Code::exceptions.c, category=SWSRC
          short-label=examples::S32DS::S32G2::Mcl_DmaTransfer_S32G274A_M7::Project_Settings::Startup_Code::nvic.c, category=SWSRC
          short-label=examples::S32DS::S32G2::Mcl_DmaTransfer_S32G274A_M7::Project_Settings::Startup_Code::startup.c, category=SWSRC
          short-label=examples::S32DS::S32G2::Mcl_DmaTransfer_S32G274A_M7::Project_Settings::Startup_Code::system.c, category=SWSRC
          short-label=examples::S32DS::S32G2::Mcl_DmaTransfer_S32G274A_M7::src::main.c, category=SWSRC
          short-label=examples::S32DS::S32G3::Dma_Ip_DmaTransfer_S32G399A_M7::include::check_example.h, category=SWHDR
          short-label=examples::S32DS::S32G3::Dma_Ip_DmaTransfer_S32G399A_M7::Project_Settings::Startup_Code::exceptions.c, category=SWSRC
          short-label=examples::S32DS::S32G3::Dma_Ip_DmaTransfer_S32G399A_M7::Project_Settings::Startup_Code::nvic.c, category=SWSRC
          short-label=examples::S32DS::S32G3::Dma_Ip_DmaTransfer_S32G399A_M7::Project_Settings::Startup_Code::startup.c, category=SWSRC
          short-label=examples::S32DS::S32G3::Dma_Ip_DmaTransfer_S32G399A_M7::Project_Settings::Startup_Code::system.c, category=SWSRC
          short-label=examples::S32DS::S32G3::Dma_Ip_DmaTransfer_S32G399A_M7::src::main.c, category=SWSRC
          short-label=examples::S32DS::S32G3::Mcl_DmaTransfer_S32G399A_M7::include::check_example.h, category=SWHDR
          short-label=examples::S32DS::S32G3::Mcl_DmaTransfer_S32G399A_M7::Project_Settings::Startup_Code::exceptions.c, category=SWSRC
          short-label=examples::S32DS::S32G3::Mcl_DmaTransfer_S32G399A_M7::Project_Settings::Startup_Code::nvic.c, category=SWSRC
          short-label=examples::S32DS::S32G3::Mcl_DmaTransfer_S32G399A_M7::Project_Settings::Startup_Code::startup.c, category=SWSRC
          short-label=examples::S32DS::S32G3::Mcl_DmaTransfer_S32G399A_M7::Project_Settings::Startup_Code::system.c, category=SWSRC
          short-label=examples::S32DS::S32G3::Mcl_DmaTransfer_S32G399A_M7::src::main.c, category=SWSRC
          short-label=examples::S32DS::S32R45::Dma_Ip_DmaTransfer_S32R45_M7::include::check_example.h, category=SWHDR
          short-label=examples::S32DS::S32R45::Dma_Ip_DmaTransfer_S32R45_M7::Project_Settings::Startup_Code::exceptions.c, category=SWSRC
          short-label=examples::S32DS::S32R45::Dma_Ip_DmaTransfer_S32R45_M7::Project_Settings::Startup_Code::nvic.c, category=SWSRC
          short-label=examples::S32DS::S32R45::Dma_Ip_DmaTransfer_S32R45_M7::Project_Settings::Startup_Code::startup.c, category=SWSRC
          short-label=examples::S32DS::S32R45::Dma_Ip_DmaTransfer_S32R45_M7::Project_Settings::Startup_Code::system.c, category=SWSRC
          short-label=examples::S32DS::S32R45::Dma_Ip_DmaTransfer_S32R45_M7::src::main.c, category=SWSRC
          short-label=examples::S32DS::S32R45::Mcl_DmaTransfer_S32R45_M7::include::check_example.h, category=SWHDR
          short-label=examples::S32DS::S32R45::Mcl_DmaTransfer_S32R45_M7::Project_Settings::Startup_Code::exceptions.c, category=SWSRC
          short-label=examples::S32DS::S32R45::Mcl_DmaTransfer_S32R45_M7::Project_Settings::Startup_Code::nvic.c, category=SWSRC
          short-label=examples::S32DS::S32R45::Mcl_DmaTransfer_S32R45_M7::Project_Settings::Startup_Code::startup.c, category=SWSRC
          short-label=examples::S32DS::S32R45::Mcl_DmaTransfer_S32R45_M7::Project_Settings::Startup_Code::system.c, category=SWSRC
          short-label=examples::S32DS::S32R45::Mcl_DmaTransfer_S32R45_M7::src::main.c, category=SWSRC
          short-label=include::Cache_Ip.h, category=SWHDR
          short-label=include::Cache_Ip_Devassert.h, category=SWHDR
          short-label=include::Cache_Ip_HwAcc_ArmCoreMx.h, category=SWHDR
          short-label=include::Cache_Ip_TrustedFunctions.h, category=SWHDR
          short-label=include::Cache_Ip_Types.h, category=SWHDR
          short-label=include::CDD_Mcl.h, category=SWHDR
          short-label=include::CDD_Mcl_Ipw.h, category=SWHDR
          short-label=include::CDD_Mcl_Irq.h, category=SWHDR
          short-label=include::Dma_Ip.h, category=SWHDR
          short-label=include::Dma_Ip_Devassert.h, category=SWHDR
          short-label=include::Dma_Ip_Driver_State.h, category=SWHDR
          short-label=include::Dma_Ip_Hwv3_AccessInline.h, category=SWHDR
          short-label=include::Dma_Ip_Hw_Access.h, category=SWHDR
          short-label=include::Dma_Ip_Irq.h, category=SWHDR
          short-label=include::Dma_Ip_Multicore.h, category=SWHDR
          short-label=include::Dma_Ip_TrustedFunctions.h, category=SWHDR
          short-label=include::Dma_Ip_Types.h, category=SWHDR
          short-label=include::Ftm_Ip_TrustedFunctions.h, category=SWHDR
          short-label=include::Ftm_Mcl_Ip.h, category=SWHDR
          short-label=include::Mcl.h, category=SWHDR
          short-label=include::Mcl_TrustedFunctions.h, category=SWHDR
          short-label=include::Mcl_Types.h, category=SWHDR
          short-label=src::Cache_Ip.c, category=SWSRC
          short-label=src::Cache_Ip_HwAcc_ArmCoreMx.c, category=SWSRC
          short-label=src::CDD_Mcl.c, category=SWSRC
          short-label=src::Dma_Ip.c, category=SWSRC
          short-label=src::Dma_Ip_Driver_State.c, category=SWSRC
          short-label=src::Dma_Ip_Hw_Access.c, category=SWSRC
          short-label=src::Dma_Ip_Irq.c, category=SWSRC
          short-label=src::Dma_Ip_Multicore.c, category=SWSRC
          short-label=src::Ftm_Mcl_Ip.c, category=SWSRC
    compiler DIAB_Compiler:
      name=Windriver Diab
      options=-tARMCORTEXM7MG:simple -mthumb -std=c99 -Oz -g -fstandalone-debug -Wstrict-prototypes -Wsign-compare -Wdouble-promotion -Wunknown-pragmas -Wundef -Wextra -Wall -pedantic -Werror=implicit-function-declaration -fno-common -fno-signed-char -fno-trigraphs -V -c -DS32XX -DS32G2XX -DS32G3XX -DS32R45 -DDIAB -DUSE_SW_VECTOR_MODE -DD_CACHE_ENABLE -DI_CACHE_ENABLE -DENABLE_FPU -DMCAL_ENABLE_USER_MODE_SUPPORT
      vendor=Windriver
      version=DIAB_7_0_3_0-FCS_20200409_160912
    compiler GCC_Compiler:
      name=GCC Compiler
      options=-mcpu=cortex-m7 -mthumb -mlittle-endian -mfpu=fpv5-sp-d16 -mfloat-abi=hard -std=c99 -Os -ggdb3 -Wall -Wextra -pedantic -Wstrict-prototypes -Wundef -Wunused -Werror=implicit-function-declaration -Wsign-compare -Wdouble-promotion -fno-short-enums -funsigned-char -funsigned-bitfields -fomit-frame-pointer -fno-common -fstack-usage -fdump-ipa-all -c -DS32XX -DS32G2XX -DS32G3XX -DS32R45 -DGCC -DUSE_SW_VECTOR_MODE -DD_CACHE_ENABLE -DI_CACHE_ENABLE -DENABLE_FPU -DMCAL_ENABLE_USER_MODE_SUPPORT
      vendor=GCC Systems
      version=NXP GCC 9.2.0 20190812 (Build 1649 Revision gaf57174)
    compiler GHS_Compiler:
      name=Green Hills
      options=-cpu=cortexm7 -thumb -fpu=vfpv5_d16 -fsingle -C99 --ghstd=last -Osize --gnu_asm -dual_debug -G -keeptempfiles -Wimplicit-int -Wshadow -Wtrigraphs -Wundef --unsigned_chars --unsigned_fields --no_commons --no_exceptions --no_slash_comment --prototype_errors --incorrect_pragma_warnings -c -DS32XX -DS32G2XX -DS32G3XX -DS32R45 -DGHS -DUSE_SW_VECTOR_MODE -DD_CACHE_ENABLE -DI_CACHE_ENABLE -DENABLE_FPU -DMCAL_ENABLE_USER_MODE_SUPPORT
      vendor=Green Hills
      version=Green Hills Multi 7.1.6d / Compiler 2020.1.4
    generated-artifacts:
      16 x dependency on artifact:
        CDD_Mcl_PBcfg_h: artifact-descriptor={short-label=generate_PB::include::CDD_Mcl_PBcfg.h, category=SWHDR}, usages=EXECUTE
        Dma_Ip_PBcfg_h: artifact-descriptor={short-label=generate_PB::include::Dma_Ip_PBcfg.h, category=SWHDR}, usages=EXECUTE
        CDD_Mcl_PBcfg_c: artifact-descriptor={short-label=generate_PB::src::CDD_Mcl_PBcfg.c, category=SWSRC}, usages=EXECUTE
        Dma_Ip_PBcfg_c: artifact-descriptor={short-label=generate_PB::src::Dma_Ip_PBcfg.c, category=SWSRC}, usages=EXECUTE
        Cache_Ip_Cfg_Defines_h: artifact-descriptor={short-label=generate_PC::include::Cache_Ip_Cfg_Defines.h, category=SWHDR}, usages=COMPILE
        Cache_Ip_Cfg_DeviceRegisters_h: artifact-descriptor={short-label=generate_PC::include::Cache_Ip_Cfg_DeviceRegisters.h, category=SWHDR}, usages=COMPILE
        CDD_Mcl_Cfg_h: artifact-descriptor={short-label=generate_PC::include::CDD_Mcl_Cfg.h, category=SWHDR}, usages=COMPILE
        CDD_Mcl_Cfg_Defines_h: artifact-descriptor={short-label=generate_PC::include::CDD_Mcl_Cfg_Defines.h, category=SWHDR}, usages=COMPILE
        Dma_Ip_Cfg_h: artifact-descriptor={short-label=generate_PC::include::Dma_Ip_Cfg.h, category=SWHDR}, usages=COMPILE
        Dma_Ip_Cfg_Defines_h: artifact-descriptor={short-label=generate_PC::include::Dma_Ip_Cfg_Defines.h, category=SWHDR}, usages=COMPILE
        Dma_Ip_Cfg_DeviceRegistersV3_h: artifact-descriptor={short-label=generate_PC::include::Dma_Ip_Cfg_DeviceRegistersV3.h, category=SWHDR}, usages=COMPILE
        Dma_Ip_Cfg_Devices_h: artifact-descriptor={short-label=generate_PC::include::Dma_Ip_Cfg_Devices.h, category=SWHDR}, usages=COMPILE
        Ftm_Mcl_Ip_Cfg_h: artifact-descriptor={short-label=generate_PC::include::Ftm_Mcl_Ip_Cfg.h, category=SWHDR}, usages=COMPILE
        Ftm_Mcl_Ip_Cfg_DeviceRegisters_h: artifact-descriptor={short-label=generate_PC::include::Ftm_Mcl_Ip_Cfg_DeviceRegisters.h, category=SWHDR}, usages=COMPILE
        CDD_Mcl_Cfg_c: artifact-descriptor={short-label=generate_PC::src::CDD_Mcl_Cfg.c, category=SWSRC}, usages=COMPILE
        Dma_Ip_Cfg_c: artifact-descriptor={short-label=generate_PC::src::Dma_Ip_Cfg.c, category=SWSRC}, usages=COMPILE
    linker DIAB_Linker: name=Windriver Diab, options=-e Reset_Handler linker_script_file.dld -m30 -Xstack-usage -Xpreprocess-lecl -Llibrary_path -lc -lm, vendor=Windriver, version=DIAB_7_0_3_0-FCS_20200409_160912
    linker GCC_Linker: name=GCC Compiler, options=-Wl,-Map,filename -T linkerfile --entry=Reset_Handler -nostartfiles -mcpu=cortexm7 -mthumb -mfpu=fpv5-sp-d16 -mfloat-abi=hard -mlittle-endian -ggdb3 -lc -lm -lgcc, vendor=GCC Systems, version=NXP GCC 9.2.0 20190812 (Build 1649 Revision gaf57174)
    linker GHS_Linker: name=Green Hills, options=-e Reset_Handler -T linker_script_file.ld -map -keepmap -Mn -delete -ignore_debug_references -Llibrary_path -larch -lstartup -lind_sd -v -nostartfiles, vendor=Green Hills, version=Green Hills Multi 7.1.6d / Compiler 2020.1.4
    resource consumption ResourceConsumption
      6 x memory section, all with alignment=UNSPECIFIED:
        MCL_CODE: sw-addrmethod=CODE, symbol=CODE
        MCL_CONFIG_DATA_UNSPECIFIED: sw-addrmethod=CONFIG_DATA, symbol=CONFIG_DATA_UNSPECIFIED
        MCL_CONST_UNSPECIFIED: sw-addrmethod=CONST, symbol=CONST_UNSPECIFIED
        MCL_VAR_CLEARED_UNSPECIFIED_NO_CACHEABLE: sw-addrmethod=VAR_CLEARED_NO_CACHEABLE, symbol=VAR_CLEARED_UNSPECIFIED_NO_CACHEABLE
        MCL_VAR_INIT_UNSPECIFIED: sw-addrmethod=VAR_INIT, symbol=VAR_INIT_UNSPECIFIED
        MCL_VAR_INIT_UNSPECIFIED_NO_CACHEABLE: sw-addrmethod=VAR_INIT_NO_CACHEABLE, symbol=VAR_INIT_UNSPECIFIED_NO_CACHEABLE
