AUTOSAR XML (schema 00046)
package /AUTOSAR_Dio/BswModuleDescriptions
  bsw module description Dio: module-id=120
    provided-entrys:
      Dio_FlipChannel
      Dio_GetVersionInfo
      Dio_MaskedWritePort
      Dio_ReadChannel
      Dio_ReadChannelGroup
      Dio_ReadPort
      Dio_WriteChannel
      Dio_WriteChannelGroup
      Dio_WritePort
      Dio_Ip_WritePin
    bsw internal behavior InternalBehavior_0
      exclusive area DIO_EXCLUSIVE_AREA_00
      exclusive area DIO_EXCLUSIVE_AREA_01
      10 x bsw called entity:
        Dio_FlipChannel: can-enter-exclusive-area=DIO_EXCLUSIVE_AREA_00, implemented-entry=Dio_FlipChannel
        Dio_GetVersionInfo: implemented-entry=Dio_GetVersionInfo
        Dio_MaskedWritePort: implemented-entry=Dio_MaskedWritePort
        Dio_ReadChannel: implemented-entry=Dio_ReadChannel
        Dio_ReadChannelGroup: implemented-entry=Dio_ReadChannelGroup
        Dio_ReadPort: implemented-entry=Dio_ReadPort
        Dio_WriteChannel: implemented-entry=Dio_WriteChannel
        Dio_WriteChannelGroup: implemented-entry=Dio_WriteChannelGroup
        Dio_WritePort: implemented-entry=Dio_WritePort
        Siul2_Dio_Ip_WritePin: can-enter-exclusive-area=DIO_EXCLUSIVE_AREA_01, implemented-entry=Dio_Ip_WritePin
package /AUTOSAR_Dio/BswModuleEntrys
  10 x bsw module entry, all with is-reentrant=true, call-type=REGULAR, execution-context=UNSPECIFIED, sw-service-impl-policy=STANDARD:
    Dio_FlipChannel: service-id=0x11, is-synchronous=true
    Dio_GetVersionInfo: service-id=0x12, is-synchronous=true
    Dio_MaskedWritePort: service-id=0x13, is-synchronous=true
    Dio_ReadChannel: service-id=0x00, is-synchronous=true
    Dio_ReadChannelGroup: service-id=0x04, is-synchronous=true
    Dio_ReadPort: service-id=0x02, is-synchronous=true
    Dio_WriteChannel: service-id=0x01, is-synchronous=true
    Dio_WriteChannelGroup: service-id=0x05, is-synchronous=true
    Dio_WritePort: service-id=0x03, is-synchronous=true
    Dio_Ip_WritePin: service-id=0xf1, is-synchronous=false
package /Dio_TS_T40D11M40I2R0/Implementations
  bsw implementation BswImplementation_0: programming-language=C, sw-version=4.0.2, vendor-id=43, ar-release-version=4.4.0, behavior=InternalBehavior_0, vendor-specific-module-def=Dio
    code-descriptors:
      code Files
        artifact-descriptors:
          short-label=config::Dio.xdm, category=SWCFG
          short-label=doc::RTD_DIO_IM.pdf, category=SWDOC
          short-label=doc::RTD_DIO_UM.pdf, category=SWDOC
          short-label=examples::EBT::S32G2::Dio_Example_S32G274A_M7::generate::epc::BaseNXP.xdm, category=SWCFG
          short-label=examples::EBT::S32G2::Dio_Example_S32G274A_M7::generate::epc::Dem.xdm, category=SWCFG
          short-label=examples::EBT::S32G2::Dio_Example_S32G274A_M7::generate::epc::Dio.xdm, category=SWCFG
          short-label=examples::EBT::S32G2::Dio_Example_S32G274A_M7::generate::epc::EcuC.xdm, category=SWCFG
          short-label=examples::EBT::S32G2::Dio_Example_S32G274A_M7::generate::epc::Mcu.xdm, category=SWCFG
          short-label=examples::EBT::S32G2::Dio_Example_S32G274A_M7::generate::epc::Port.xdm, category=SWCFG
          short-label=examples::EBT::S32G2::Dio_Example_S32G274A_M7::generate::epc::Resource.xdm, category=SWCFG
          short-label=examples::EBT::S32G2::Dio_Example_S32G274A_M7::include::check_example.h, category=SWHDR
          short-label=examples::EBT::S32G2::Dio_Example_S32G274A_M7::src::main.c, category=SWSRC
          short-label=examples::EBT::S32G2::Dio_Example_S32G274A_M7::TresosProject::Dio_Example_S32G274A_M7::.prefs::preferences.xdm, category=SWCFG
          short-label=examples::EBT::S32G2::Dio_Example_S32G274A_M7::TresosProject::Dio_Example_S32G274A_M7::config::BaseNXP.xdm, category=SWCFG
          short-label=examples::EBT::S32G2::Dio_Example_S32G274A_M7::TresosProject::Dio_Example_S32G274A_M7::config::Dem.xdm, category=SWCFG
          short-label=examples::EBT::S32G2::Dio_Example_S32G274A_M7::TresosProject::Dio_Example_S32G274A_M7::config::Dio.xdm, category=SWCFG
          short-label=examples::EBT::S32G2::Dio_Example_S32G274A_M7::TresosProject::Dio_Example_S32G274A_M7::config::EcuC.xdm, category=SWCFG
          short-label=examples::EBT::S32G2::Dio_Example_S32G274A_M7::TresosProject::Dio_Example_S32G274A_M7::config::Mcu.xdm, category=SWCFG
          short-label=examples::EBT::S32G2::Dio_Example_S32G274A_M7::TresosProject::Dio_Example_S32G274A_M7::config::Port.xdm, category=SWCFG
          short-label=examples::EBT::S32G2::Dio_Example_S32G274A_M7::TresosProject::Dio_Example_S32G274A_M7::config::Resource.xdm, category=SWCFG
          short-label=examples::EBT::S32G3::Dio_Example_S32G399A_M7::generate::epc::BaseNXP.xdm, category=SWCFG
          short-label=examples::EBT::S32G3::Dio_Example_S32G399A_M7::generate::epc::Dem.xdm, category=SWCFG
          short-label=examples::EBT::S32G3::Dio_Example_S32G399A_M7::generate::epc::Dio.xdm, category=SWCFG
          short-label=examples::EBT::S32G3::Dio_Example_S32G399A_M7::generate::epc::EcuC.xdm, category=SWCFG
          short-label=examples::EBT::S32G3::Dio_Example_S32G399A_M7::generate::epc::Mcu.xdm, category=SWCFG
          short-label=examples::EBT::S32G3::Dio_Example_S32G399A_M7::generate::epc::Port.xdm, category=SWCFG
          short-label=examples::EBT::S32G3::Dio_Example_S32G399A_M7::generate::epc::Resource.xdm, category=SWCFG
          short-label=examples::EBT::S32G3::Dio_Example_S32G399A_M7::include::check_example.h, category=SWHDR
          short-label=examples::EBT::S32G3::Dio_Example_S32G399A_M7::src::main.c, category=SWSRC
          short-label=examples::EBT::S32G3::Dio_Example_S32G399A_M7::TresosProject::Dio_Example_S32G399A_M7::.prefs::preferences.xdm, category=SWCFG
          short-label=examples::EBT::S32G3::Dio_Example_S32G399A_M7::TresosProject::Dio_Example_S32G399A_M7::config::BaseNXP.xdm, category=SWCFG
          short-label=examples::EBT::S32G3::Dio_Example_S32G399A_M7::TresosProject::Dio_Example_S32G399A_M7::config::Dem.xdm, category=SWCFG
          short-label=examples::EBT::S32G3::Dio_Example_S32G399A_M7::TresosProject::Dio_Example_S32G399A_M7::config::Dio.xdm, category=SWCFG
          short-label=examples::EBT::S32G3::Dio_Example_S32G399A_M7::TresosProject::Dio_Example_S32G399A_M7::config::EcuC.xdm, category=SWCFG
          short-label=examples::EBT::S32G3::Dio_Example_S32G399A_M7::TresosProject::Dio_Example_S32G399A_M7::config::Mcu.xdm, category=SWCFG
          short-label=examples::EBT::S32G3::Dio_Example_S32G399A_M7::TresosProject::Dio_Example_S32G399A_M7::config::Port.xdm, category=SWCFG
          short-label=examples::EBT::S32G3::Dio_Example_S32G399A_M7::TresosProject::Dio_Example_S32G399A_M7::config::Resource.xdm, category=SWCFG
          short-label=examples::EBT::S32R45::Dio_Example_S32R45_M7::generate::epc::BaseNXP.xdm, category=SWCFG
          short-label=examples::EBT::S32R45::Dio_Example_S32R45_M7::generate::epc::Dem.xdm, category=SWCFG
          short-label=examples::EBT::S32R45::Dio_Example_S32R45_M7::generate::epc::Dio.xdm, category=SWCFG
          short-label=examples::EBT::S32R45::Dio_Example_S32R45_M7::generate::epc::EcuC.xdm, category=SWCFG
          short-label=examples::EBT::S32R45::Dio_Example_S32R45_M7::generate::epc::Mcu.xdm, category=SWCFG
          short-label=examples::EBT::S32R45::Dio_Example_S32R45_M7::generate::epc::Port.xdm, category=SWCFG
          short-label=examples::EBT::S32R45::Dio_Example_S32R45_M7::generate::epc::Resource.xdm, category=SWCFG
          short-label=examples::EBT::S32R45::Dio_Example_S32R45_M7::include::check_example.h, category=SWHDR
          short-label=examples::EBT::S32R45::Dio_Example_S32R45_M7::src::main.c, category=SWSRC
          short-label=examples::EBT::S32R45::Dio_Example_S32R45_M7::TresosProject::Dio_Example_S32R45_M7::.prefs::preferences.xdm, category=SWCFG
          short-label=examples::EBT::S32R45::Dio_Example_S32R45_M7::TresosProject::Dio_Example_S32R45_M7::config::BaseNXP.xdm, category=SWCFG
          short-label=examples::EBT::S32R45::Dio_Example_S32R45_M7::TresosProject::Dio_Example_S32R45_M7::config::Dem.xdm, category=SWCFG
          short-label=examples::EBT::S32R45::Dio_Example_S32R45_M7::TresosProject::Dio_Example_S32R45_M7::config::Dio.xdm, category=SWCFG
          short-label=examples::EBT::S32R45::Dio_Example_S32R45_M7::TresosProject::Dio_Example_S32R45_M7::config::EcuC.xdm, category=SWCFG
          short-label=examples::EBT::S32R45::Dio_Example_S32R45_M7::TresosProject::Dio_Example_S32R45_M7::config::Mcu.xdm, category=SWCFG
          short-label=examples::EBT::S32R45::Dio_Example_S32R45_M7::TresosProject::Dio_Example_S32R45_M7::config::Port.xdm, category=SWCFG
          short-label=examples::EBT::S32R45::Dio_Example_S32R45_M7::TresosProject::Dio_Example_S32R45_M7::config::Resource.xdm, category=SWCFG
          short-label=examples::S32DS::S32G2::Dio_Example_S32G274A_M7::include::check_example.h, category=SWHDR
          short-label=examples::S32DS::S32G2::Dio_Example_S32G274A_M7::Project_Settings::Startup_Code::exceptions.c, category=SWSRC
          short-label=examples::S32DS::S32G2::Dio_Example_S32G274A_M7::Project_Settings::Startup_Code::nvic.c, category=SWSRC
          short-label=examples::S32DS::S32G2::Dio_Example_S32G274A_M7::Project_Settings::Startup_Code::startup.c, category=SWSRC
          short-label=examples::S32DS::S32G2::Dio_Example_S32G274A_M7::Project_Settings::Startup_Code::system.c, category=SWSRC
          short-label=examples::S32DS::S32G2::Dio_Example_S32G274A_M7::src::main.c, category=SWSRC
          short-label=examples::S32DS::S32G2::Siul2_Dio_Ip_Example_S32G274A_M7::include::check_example.h, category=SWHDR
          short-label=examples::S32DS::S32G2::Siul2_Dio_Ip_Example_S32G274A_M7::Project_Settings::Startup_Code::exceptions.c, category=SWSRC
          short-label=examples::S32DS::S32G2::Siul2_Dio_Ip_Example_S32G274A_M7::Project_Settings::Startup_Code::nvic.c, category=SWSRC
          short-label=examples::S32DS::S32G2::Siul2_Dio_Ip_Example_S32G274A_M7::Project_Settings::Startup_Code::startup.c, category=SWSRC
          short-label=examples::S32DS::S32G2::Siul2_Dio_Ip_Example_S32G274A_M7::Project_Settings::Startup_Code::system.c, category=SWSRC
          short-label=examples::S32DS::S32G2::Siul2_Dio_Ip_Example_S32G274A_M7::src::main.c, category=SWSRC
          short-label=examples::S32DS::S32G3::Dio_Example_S32G399A_M7::include::check_example.h, category=SWHDR
          short-label=examples::S32DS::S32G3::Dio_Example_S32G399A_M7::Project_Settings::Startup_Code::exceptions.c, category=SWSRC
          short-label=examples::S32DS::S32G3::Dio_Example_S32G399A_M7::Project_Settings::Startup_Code::nvic.c, category=SWSRC
          short-label=examples::S32DS::S32G3::Dio_Example_S32G399A_M7::Project_Settings::Startup_Code::startup.c, category=SWSRC
          short-label=examples::S32DS::S32G3::Dio_Example_S32G399A_M7::Project_Settings::Startup_Code::system.c, category=SWSRC
          short-label=examples::S32DS::S32G3::Dio_Example_S32G399A_M7::src::main.c, category=SWSRC
          short-label=examples::S32DS::S32G3::Siul2_Dio_Ip_Example_S32G399A_M7::include::check_example.h, category=SWHDR
          short-label=examples::S32DS::S32G3::Siul2_Dio_Ip_Example_S32G399A_M7::Project_Settings::Startup_Code::exceptions.c, category=SWSRC
          short-label=examples::S32DS::S32G3::Siul2_Dio_Ip_Example_S32G399A_M7::Project_Settings::Startup_Code::nvic.c, category=SWSRC
          short-label=examples::S32DS::S32G3::Siul2_Dio_Ip_Example_S32G399A_M7::Project_Settings::Startup_Code::startup.c, category=SWSRC
          short-label=examples::S32DS::S32G3::Siul2_Dio_Ip_Example_S32G399A_M7::Project_Settings::Startup_Code::system.c, category=SWSRC
          short-label=examples::S32DS::S32G3::Siul2_Dio_Ip_Example_S32G399A_M7::src::main.c, category=SWSRC
          short-label=examples::S32DS::S32R45::Dio_Example_S32R45_M7::include::check_example.h, category=SWHDR
          short-label=examples::S32DS::S32R45::Dio_Example_S32R45_M7::Project_Settings::Startup_Code::exceptions.c, category=SWSRC
          short-label=examples::S32DS::S32R45::Dio_Example_S32R45_M7::Project_Settings::Startup_Code::nvic.c, category=SWSRC
          short-label=examples::S32DS::S32R45::Dio_Example_S32R45_M7::Project_Settings::Startup_Code::startup.c, category=SWSRC
          short-label=examples::S32DS::S32R45::Dio_Example_S32R45_M7::Project_Settings::Startup_Code::system.c, category=SWSRC
          short-label=examples::S32DS::S32R45::Dio_Example_S32R45_M7::src::main.c, category=SWSRC
          short-label=examples::S32DS::S32R45::Siul2_Dio_Ip_Example_S32R45_M7::include::check_example.h, category=SWHDR
          short-label=examples::S32DS::S32R45::Siul2_Dio_Ip_Example_S32R45_M7::Project_Settings::Startup_Code::exceptions.c, category=SWSRC
          short-label=examples::S32DS::S32R45::Siul2_Dio_Ip_Example_S32R45_M7::Project_Settings::Startup_Code::nvic.c, category=SWSRC
          short-label=examples::S32DS::S32R45::Siul2_Dio_Ip_Example_S32R45_M7::Project_Settings::Startup_Code::startup.c, category=SWSRC
          short-label=examples::S32DS::S32R45::Siul2_Dio_Ip_Example_S32R45_M7::Project_Settings::Startup_Code::system.c, category=SWSRC
          short-label=examples::S32DS::S32R45::Siul2_Dio_Ip_Example_S32R45_M7::src::main.c, category=SWSRC
          short-label=include::Dio.h, category=SWHDR
          short-label=include::Dio_Ipw.h, category=SWHDR
          short-label=include::Siul2_Dio_Ip.h, category=SWHDR
          short-label=src::Dio.c, category=SWSRC
          short-label=src::Dio_Ipw.c, category=SWSRC
          short-label=src::Siul2_Dio_Ip.c, category=SWSRC
    compiler DIAB_Compiler:
      name=Windriver Diab
      options=-tARMCORTEXM7MG:simple -mthumb -std=c99 -Oz -g -fstandalone-debug -Wstrict-prototypes -Wsign-compare -Wdouble-promotion -Wunknown-pragmas -Wundef -Wextra -Wall -pedantic -Werror=implicit-function-declaration -fno-common -fno-signed-char -fno-trigraphs -V -c -DS32XX -DS32G2XX -DS32G3XX -DS32R45 -DDIAB -DUSE_SW_VECTOR_MODE -DD_CACHE_ENABLE -DI_CACHE_ENABLE -DENABLE_FPU -DMCAL_ENABLE_USER_MODE_SUPPORT
      vendor=Windriver
      version=DIAB_7_0_3_0-FCS_20200409_160912
    compiler GCC_Compiler:
      name=GCC Compiler
      options=-mcpu=cortex-m7 -mthumb -mlittle-endian -mfpu=fpv5-sp-d16 -mfloat-abi=hard -std=c99 -Os -ggdb3 -Wall -Wextra -pedantic -Wstrict-prototypes -Wundef -Wunused -Werror=implicit-function-declaration -Wsign-compare -Wdouble-promotion -fno-short-enums -funsigned-char -funsigned-bitfields -fomit-frame-pointer -fno-common -fstack-usage -fdump-ipa-all -c -DS32XX -DS32G2XX -DS32G3XX -DS32R45 -DGCC -DUSE_SW_VECTOR_MODE -DD_CACHE_ENABLE -DI_CACHE_ENABLE -DENABLE_FPU -DMCAL_ENABLE_USER_MODE_SUPPORT
      vendor=GCC Systems
      version=NXP GCC 9.2.0 20190812 (Build 1649 Revision gaf57174)
    compiler GHS_Compiler:
      name=Green Hills
      options=-cpu=cortexm7 -thumb -fpu=vfpv5_d16 -fsingle -C99 --ghstd=last -Osize --gnu_asm -dual_debug -G -keeptempfiles -Wimplicit-int -Wshadow -Wtrigraphs -Wundef --unsigned_chars --unsigned_fields --no_commons --no_exceptions --no_slash_comment --prototype_errors --incorrect_pragma_warnings -c -DS32XX -DS32G2XX -DS32G3XX -DS32R45 -DGHS -DUSE_SW_VECTOR_MODE -DD_CACHE_ENABLE -DI_CACHE_ENABLE -DENABLE_FPU -DMCAL_ENABLE_USER_MODE_SUPPORT
      vendor=Green Hills
      version=Green Hills Multi 7.1.6d / Compiler 2020.1.4
    generated-artifacts:
      dependency on artifact Dio_Cfg_h: artifact-descriptor={short-label=generate_PC::include::Dio_Cfg.h, category=SWHDR}, usages=COMPILE
      dependency on artifact Siul2_Dio_Ip_Cfg_h: artifact-descriptor={short-label=generate_PC::include::Siul2_Dio_Ip_Cfg.h, category=SWHDR}, usages=COMPILE
      dependency on artifact Dio_Cfg_c: artifact-descriptor={short-label=generate_PC::src::Dio_Cfg.c, category=SWSRC}, usages=COMPILE
    linker DIAB_Linker: name=Windriver Diab, options=-e Reset_Handler linker_script_file.dld -m30 -Xstack-usage -Xpreprocess-lecl -Llibrary_path -lc -lm, vendor=Windriver, version=DIAB_7_0_3_0-FCS_20200409_160912
    linker GCC_Linker: name=GCC Compiler, options=-Wl,-Map,filename -T linkerfile --entry=Reset_Handler -nostartfiles -mcpu=cortexm7 -mthumb -mfpu=fpv5-sp-d16 -mfloat-abi=hard -mlittle-endian -ggdb3 -lc -lm -lgcc, vendor=GCC Systems, version=NXP GCC 9.2.0 20190812 (Build 1649 Revision gaf57174)
    linker GHS_Linker: name=Green Hills, options=-e Reset_Handler -T linker_script_file.ld -map -keepmap -Mn -delete -ignore_debug_references -Llibrary_path -larch -lstartup -lind_sd -v -nostartfiles, vendor=Green Hills, version=Green Hills Multi 7.1.6d / Compiler 2020.1.4
    resource consumption ResourceConsumption
      6 x memory section:
        DIO_CODE: alignment=UNSPECIFIED, sw-addrmethod=CODE, symbol=CODE
        DIO_CONFIG_DATA_UNSPECIFIED: alignment=UNSPECIFIED, sw-addrmethod=CONFIG_DATA, symbol=CONFIG_DATA_UNSPECIFIED
        DIO_CONST_16: alignment=16, sw-addrmethod=CONST, symbol=CONST_16
        DIO_CONST_32: alignment=32, sw-addrmethod=CONST, symbol=CONST_32
        DIO_CONST_8: alignment=8, sw-addrmethod=CONST, symbol=CONST_8
        DIO_VAR_INIT_32: alignment=32, sw-addrmethod=VAR_INIT, symbol=VAR_INIT_32
