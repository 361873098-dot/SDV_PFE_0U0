[part 2 of 3]
  (continued)
  <AR-PACKAGES>  (continued)
    <AR-PACKAGE>  (continued)
      <AR-PACKAGES>  (continued)
        <AR-PACKAGE>  (continued)
          <ELEMENTS>  (continued)
            <BSW-MODULE-DESCRIPTION>  (continued)
              <INTERNAL-BEHAVIORS>
                <BSW-INTERNAL-BEHAVIOR>
                  <SHORT-NAME>InternalBehavior_0</SHORT-NAME>
                  <EXCLUSIVE-AREAS>
                    <EXCLUSIVE-AREA>
                      <SHORT-NAME>ETH_EXCLUSIVE_AREA_00</SHORT-NAME>
                    </EXCLUSIVE-AREA>
                    <EXCLUSIVE-AREA>
                      <SHORT-NAME>ETH_EXCLUSIVE_AREA_01</SHORT-NAME>
                    </EXCLUSIVE-AREA>
                    <EXCLUSIVE-AREA>
                      <SHORT-NAME>ETH_EXCLUSIVE_AREA_02</SHORT-NAME>
                    </EXCLUSIVE-AREA>
                    <EXCLUSIVE-AREA>
                      <SHORT-NAME>ETH_EXCLUSIVE_AREA_03</SHORT-NAME>
                    </EXCLUSIVE-AREA>
                    <EXCLUSIVE-AREA>
                      <SHORT-NAME>ETH_EXCLUSIVE_AREA_04</SHORT-NAME>
                    </EXCLUSIVE-AREA>
                    <EXCLUSIVE-AREA>
                      <SHORT-NAME>ETH_EXCLUSIVE_AREA_05</SHORT-NAME>
                    </EXCLUSIVE-AREA>
                    <EXCLUSIVE-AREA>
                      <SHORT-NAME>ETH_EXCLUSIVE_AREA_06</SHORT-NAME>
                    </EXCLUSIVE-AREA>
                    <EXCLUSIVE-AREA>
                      <SHORT-NAME>ETH_EXCLUSIVE_AREA_07</SHORT-NAME>
                    </EXCLUSIVE-AREA>
                    <EXCLUSIVE-AREA>
                      <SHORT-NAME>ETH_EXCLUSIVE_AREA_08</SHORT-NAME>
                    </EXCLUSIVE-AREA>
                    <EXCLUSIVE-AREA>
                      <SHORT-NAME>ETH_EXCLUSIVE_AREA_09</SHORT-NAME>
                    </EXCLUSIVE-AREA>
                    <EXCLUSIVE-AREA>
                      <SHORT-NAME>ETH_EXCLUSIVE_AREA_10</SHORT-NAME>
                    </EXCLUSIVE-AREA>
                    <EXCLUSIVE-AREA>
                      <SHORT-NAME>ETH_EXCLUSIVE_AREA_11</SHORT-NAME>
                    </EXCLUSIVE-AREA>
                    <EXCLUSIVE-AREA>
                      <SHORT-NAME>ETH_EXCLUSIVE_AREA_12</SHORT-NAME>
                    </EXCLUSIVE-AREA>
                    <EXCLUSIVE-AREA>
                      <SHORT-NAME>ETH_EXCLUSIVE_AREA_13</SHORT-NAME>
                    </EXCLUSIVE-AREA>
                    <EXCLUSIVE-AREA>
                      <SHORT-NAME>ETH_EXCLUSIVE_AREA_14</SHORT-NAME>
                    </EXCLUSIVE-AREA>
                    <EXCLUSIVE-AREA>
                      <SHORT-NAME>ETH_EXCLUSIVE_AREA_15</SHORT-NAME>
                    </EXCLUSIVE-AREA>
                    <EXCLUSIVE-AREA>
                      <SHORT-NAME>ETH_EXCLUSIVE_AREA_16</SHORT-NAME>
                    </EXCLUSIVE-AREA>
                    <EXCLUSIVE-AREA>
                      <SHORT-NAME>ETH_EXCLUSIVE_AREA_17</SHORT-NAME>
                    </EXCLUSIVE-AREA>
                    <EXCLUSIVE-AREA>
                      <SHORT-NAME>ETH_EXCLUSIVE_AREA_18</SHORT-NAME>
                    </EXCLUSIVE-AREA>
                    <EXCLUSIVE-AREA>
                      <SHORT-NAME>ETH_EXCLUSIVE_AREA_19</SHORT-NAME>
                    </EXCLUSIVE-AREA>
                    <EXCLUSIVE-AREA>
                      <SHORT-NAME>ETH_EXCLUSIVE_AREA_20</SHORT-NAME>
                    </EXCLUSIVE-AREA>
                    <EXCLUSIVE-AREA>
                      <SHORT-NAME>ETH_EXCLUSIVE_AREA_21</SHORT-NAME>
                    </EXCLUSIVE-AREA>
                    <EXCLUSIVE-AREA>
                      <SHORT-NAME>ETH_EXCLUSIVE_AREA_22</SHORT-NAME>
                    </EXCLUSIVE-AREA>
                    <EXCLUSIVE-AREA>
                      <SHORT-NAME>ETH_EXCLUSIVE_AREA_23</SHORT-NAME>
                    </EXCLUSIVE-AREA>
                    <EXCLUSIVE-AREA>
                      <SHORT-NAME>ETH_EXCLUSIVE_AREA_24</SHORT-NAME>
                    </EXCLUSIVE-AREA>
                    <EXCLUSIVE-AREA>
                      <SHORT-NAME>ETH_EXCLUSIVE_AREA_25</SHORT-NAME>
                    </EXCLUSIVE-AREA>
                    <EXCLUSIVE-AREA>
                      <SHORT-NAME>ETH_EXCLUSIVE_AREA_26</SHORT-NAME>
                    </EXCLUSIVE-AREA>
                    <EXCLUSIVE-AREA>
                      <SHORT-NAME>ETH_EXCLUSIVE_AREA_27</SHORT-NAME>
                    </EXCLUSIVE-AREA>
                    <EXCLUSIVE-AREA>
                      <SHORT-NAME>ETH_EXCLUSIVE_AREA_28</SHORT-NAME>
                    </EXCLUSIVE-AREA>
                    <EXCLUSIVE-AREA>
                      <SHORT-NAME>ETH_EXCLUSIVE_AREA_29</SHORT-NAME>
                    </EXCLUSIVE-AREA>
                    <EXCLUSIVE-AREA>
                      <SHORT-NAME>ETH_EXCLUSIVE_AREA_30</SHORT-NAME>
                    </EXCLUSIVE-AREA>
                    <EXCLUSIVE-AREA>
                      <SHORT-NAME>ETH_EXCLUSIVE_AREA_31</SHORT-NAME>
                    </EXCLUSIVE-AREA>
                    <EXCLUSIVE-AREA>
                      <SHORT-NAME>ETH_EXCLUSIVE_AREA_32</SHORT-NAME>
                    </EXCLUSIVE-AREA>
                    <EXCLUSIVE-AREA>
                      <SHORT-NAME>ETH_EXCLUSIVE_AREA_33</SHORT-NAME>
                    </EXCLUSIVE-AREA>
                    <EXCLUSIVE-AREA>
                      <SHORT-NAME>ETH_EXCLUSIVE_AREA_34</SHORT-NAME>
                    </EXCLUSIVE-AREA>
                    <EXCLUSIVE-AREA>
                      <SHORT-NAME>ETH_EXCLUSIVE_AREA_35</SHORT-NAME>
                    </EXCLUSIVE-AREA>
                    <EXCLUSIVE-AREA>
                      <SHORT-NAME>ETH_EXCLUSIVE_AREA_36</SHORT-NAME>
                    </EXCLUSIVE-AREA>
                    <EXCLUSIVE-AREA>
                      <SHORT-NAME>ETH_EXCLUSIVE_AREA_37</SHORT-NAME>
                    </EXCLUSIVE-AREA>
                    <EXCLUSIVE-AREA>
                      <SHORT-NAME>ETH_EXCLUSIVE_AREA_38</SHORT-NAME>
                    </EXCLUSIVE-AREA>
                    <EXCLUSIVE-AREA>
                      <SHORT-NAME>ETH_EXCLUSIVE_AREA_39</SHORT-NAME>
                    </EXCLUSIVE-AREA>
                    <EXCLUSIVE-AREA>
                      <SHORT-NAME>ETH_EXCLUSIVE_AREA_40</SHORT-NAME>
                    </EXCLUSIVE-AREA>
                    <EXCLUSIVE-AREA>
                      <SHORT-NAME>ETH_EXCLUSIVE_AREA_41</SHORT-NAME>
                    </EXCLUSIVE-AREA>
                    <EXCLUSIVE-AREA>
                      <SHORT-NAME>ETH_EXCLUSIVE_AREA_42</SHORT-NAME>
                    </EXCLUSIVE-AREA>
                    <EXCLUSIVE-AREA>
                      <SHORT-NAME>ETH_EXCLUSIVE_AREA_43</SHORT-NAME>
                    </EXCLUSIVE-AREA>
                    <EXCLUSIVE-AREA>
                      <SHORT-NAME>ETH_EXCLUSIVE_AREA_44</SHORT-NAME>
                    </EXCLUSIVE-AREA>
                    <EXCLUSIVE-AREA>
                      <SHORT-NAME>ETH_EXCLUSIVE_AREA_45</SHORT-NAME>
                    </EXCLUSIVE-AREA>
                    <EXCLUSIVE-AREA>
                      <SHORT-NAME>ETH_EXCLUSIVE_AREA_46</SHORT-NAME>
                    </EXCLUSIVE-AREA>
                    <EXCLUSIVE-AREA>
                      <SHORT-NAME>ETH_EXCLUSIVE_AREA_47</SHORT-NAME>
                    </EXCLUSIVE-AREA>
                    <EXCLUSIVE-AREA>
                      <SHORT-NAME>ETH_EXCLUSIVE_AREA_48</SHORT-NAME>
                    </EXCLUSIVE-AREA>
                    <EXCLUSIVE-AREA>
                      <SHORT-NAME>ETH_EXCLUSIVE_AREA_49</SHORT-NAME>
                    </EXCLUSIVE-AREA>
                    <EXCLUSIVE-AREA>
                      <SHORT-NAME>ETH_EXCLUSIVE_AREA_50</SHORT-NAME>
                    </EXCLUSIVE-AREA>
                    <EXCLUSIVE-AREA>
                      <SHORT-NAME>ETH_EXCLUSIVE_AREA_51</SHORT-NAME>
                    </EXCLUSIVE-AREA>
                    <EXCLUSIVE-AREA>
                      <SHORT-NAME>ETH_EXCLUSIVE_AREA_52</SHORT-NAME>
                    </EXCLUSIVE-AREA>
                    <EXCLUSIVE-AREA>
                      <SHORT-NAME>ETH_EXCLUSIVE_AREA_53</SHORT-NAME>
                    </EXCLUSIVE-AREA>
                    <EXCLUSIVE-AREA>
                      <SHORT-NAME>ETH_EXCLUSIVE_AREA_54</SHORT-NAME>
                    </EXCLUSIVE-AREA>
                    <EXCLUSIVE-AREA>
                      <SHORT-NAME>ETH_EXCLUSIVE_AREA_55</SHORT-NAME>
                    </EXCLUSIVE-AREA>
                    <EXCLUSIVE-AREA>
                      <SHORT-NAME>ETH_EXCLUSIVE_AREA_56</SHORT-NAME>
                    </EXCLUSIVE-AREA>
                    <EXCLUSIVE-AREA>
                      <SHORT-NAME>ETH_EXCLUSIVE_AREA_57</SHORT-NAME>
                    </EXCLUSIVE-AREA>
                    <EXCLUSIVE-AREA>
                      <SHORT-NAME>ETH_EXCLUSIVE_AREA_58</SHORT-NAME>
                    </EXCLUSIVE-AREA>
                    <EXCLUSIVE-AREA>
                      <SHORT-NAME>ETH_EXCLUSIVE_AREA_59</SHORT-NAME>
                    </EXCLUSIVE-AREA>
                    <EXCLUSIVE-AREA>
                      <SHORT-NAME>ETH_EXCLUSIVE_AREA_60</SHORT-NAME>
                    </EXCLUSIVE-AREA>
                    <EXCLUSIVE-AREA>
                      <SHORT-NAME>ETH_EXCLUSIVE_AREA_61</SHORT-NAME>
                    </EXCLUSIVE-AREA>
                    <EXCLUSIVE-AREA>
                      <SHORT-NAME>ETH_EXCLUSIVE_AREA_62</SHORT-NAME>
                    </EXCLUSIVE-AREA>
                    <EXCLUSIVE-AREA>
                      <SHORT-NAME>ETH_EXCLUSIVE_AREA_63</SHORT-NAME>
                    </EXCLUSIVE-AREA>
                    <EXCLUSIVE-AREA>
                      <SHORT-NAME>ETH_EXCLUSIVE_AREA_64</SHORT-NAME>
                    </EXCLUSIVE-AREA>
                    <EXCLUSIVE-AREA>
                      <SHORT-NAME>ETH_EXCLUSIVE_AREA_65</SHORT-NAME>
                    </EXCLUSIVE-AREA>
                    <EXCLUSIVE-AREA>
                      <SHORT-NAME>ETH_EXCLUSIVE_AREA_66</SHORT-NAME>
                    </EXCLUSIVE-AREA>
                    <EXCLUSIVE-AREA>
                      <SHORT-NAME>ETH_EXCLUSIVE_AREA_67</SHORT-NAME>
                    </EXCLUSIVE-AREA>
                    <EXCLUSIVE-AREA>
                      <SHORT-NAME>ETH_EXCLUSIVE_AREA_68</SHORT-NAME>
                    </EXCLUSIVE-AREA>
                    <EXCLUSIVE-AREA>
                      <SHORT-NAME>ETH_EXCLUSIVE_AREA_69</SHORT-NAME>
                    </EXCLUSIVE-AREA>
                    <EXCLUSIVE-AREA>
                      <SHORT-NAME>ETH_EXCLUSIVE_AREA_70</SHORT-NAME>
                    </EXCLUSIVE-AREA>
                    <EXCLUSIVE-AREA>
                      <SHORT-NAME>ETH_EXCLUSIVE_AREA_71</SHORT-NAME>
                    </EXCLUSIVE-AREA>
                    <EXCLUSIVE-AREA>
                      <SHORT-NAME>ETH_EXCLUSIVE_AREA_72</SHORT-NAME>
                    </EXCLUSIVE-AREA>
                    <EXCLUSIVE-AREA>
                      <SHORT-NAME>ETH_EXCLUSIVE_AREA_73</SHORT-NAME>
                    </EXCLUSIVE-AREA>
                    <EXCLUSIVE-AREA>
                      <SHORT-NAME>ETH_EXCLUSIVE_AREA_74</SHORT-NAME>
                    </EXCLUSIVE-AREA>
                    <EXCLUSIVE-AREA>
                      <SHORT-NAME>ETH_EXCLUSIVE_AREA_75</SHORT-NAME>
                    </EXCLUSIVE-AREA>
                    <EXCLUSIVE-AREA>
                      <SHORT-NAME>ETH_EXCLUSIVE_AREA_76</SHORT-NAME>
                    </EXCLUSIVE-AREA>
                    <EXCLUSIVE-AREA>
                      <SHORT-NAME>ETH_EXCLUSIVE_AREA_77</SHORT-NAME>
                    </EXCLUSIVE-AREA>
                    <EXCLUSIVE-AREA>
                      <SHORT-NAME>ETH_EXCLUSIVE_AREA_78</SHORT-NAME>
                    </EXCLUSIVE-AREA>
                    <EXCLUSIVE-AREA>
                      <SHORT-NAME>ETH_EXCLUSIVE_AREA_79</SHORT-NAME>
                    </EXCLUSIVE-AREA>
                    <EXCLUSIVE-AREA>
                      <SHORT-NAME>ETH_EXCLUSIVE_AREA_80</SHORT-NAME>
                    </EXCLUSIVE-AREA>
                    <EXCLUSIVE-AREA>
                      <SHORT-NAME>ETH_EXCLUSIVE_AREA_81</SHORT-NAME>
                    </EXCLUSIVE-AREA>
                    <EXCLUSIVE-AREA>
                      <SHORT-NAME>ETH_EXCLUSIVE_AREA_82</SHORT-NAME>
                    </EXCLUSIVE-AREA>
                    <EXCLUSIVE-AREA>
                      <SHORT-NAME>ETH_EXCLUSIVE_AREA_83</SHORT-NAME>
                    </EXCLUSIVE-AREA>
                    <EXCLUSIVE-AREA>
                      <SHORT-NAME>ETH_EXCLUSIVE_AREA_84</SHORT-NAME>
                    </EXCLUSIVE-AREA>
                    <EXCLUSIVE-AREA>
                      <SHORT-NAME>ETH_EXCLUSIVE_AREA_85</SHORT-NAME>
                    </EXCLUSIVE-AREA>
                    <EXCLUSIVE-AREA>
                      <SHORT-NAME>ETH_EXCLUSIVE_AREA_86</SHORT-NAME>
                    </EXCLUSIVE-AREA>
                    <EXCLUSIVE-AREA>
                      <SHORT-NAME>ETH_EXCLUSIVE_AREA_87</SHORT-NAME>
                    </EXCLUSIVE-AREA>
                    <EXCLUSIVE-AREA>
                      <SHORT-NAME>ETH_EXCLUSIVE_AREA_88</SHORT-NAME>
                    </EXCLUSIVE-AREA>
                    <EXCLUSIVE-AREA>
                      <SHORT-NAME>ETH_EXCLUSIVE_AREA_89</SHORT-NAME>
                    </EXCLUSIVE-AREA>
                    <EXCLUSIVE-AREA>
                      <SHORT-NAME>ETH_EXCLUSIVE_AREA_90</SHORT-NAME>
                    </EXCLUSIVE-AREA>
                    <EXCLUSIVE-AREA>
                      <SHORT-NAME>ETH_EXCLUSIVE_AREA_91</SHORT-NAME>
                    </EXCLUSIVE-AREA>
                    <EXCLUSIVE-AREA>
                      <SHORT-NAME>ETH_EXCLUSIVE_AREA_92</SHORT-NAME>
                    </EXCLUSIVE-AREA>
                    <EXCLUSIVE-AREA>
                      <SHORT-NAME>ETH_EXCLUSIVE_AREA_93</SHORT-NAME>
                    </EXCLUSIVE-AREA>
                    <EXCLUSIVE-AREA>
                      <SHORT-NAME>ETH_EXCLUSIVE_AREA_94</SHORT-NAME>
                    </EXCLUSIVE-AREA>
                    <EXCLUSIVE-AREA>
                      <SHORT-NAME>ETH_EXCLUSIVE_AREA_95</SHORT-NAME>
                    </EXCLUSIVE-AREA>
                    <EXCLUSIVE-AREA>
                      <SHORT-NAME>ETH_EXCLUSIVE_AREA_96</SHORT-NAME>
                    </EXCLUSIVE-AREA>
                    <EXCLUSIVE-AREA>
                      <SHORT-NAME>ETH_EXCLUSIVE_AREA_97</SHORT-NAME>
                    </EXCLUSIVE-AREA>
                    <EXCLUSIVE-AREA>
                      <SHORT-NAME>ETH_EXCLUSIVE_AREA_98</SHORT-NAME>
                    </EXCLUSIVE-AREA>
                    <EXCLUSIVE-AREA>
                      <SHORT-NAME>ETH_EXCLUSIVE_AREA_99</SHORT-NAME>
                    </EXCLUSIVE-AREA>
                    <EXCLUSIVE-AREA>
                      <SHORT-NAME>ETH_EXCLUSIVE_AREA_100</SHORT-NAME>
                    </EXCLUSIVE-AREA>
                    <EXCLUSIVE-AREA>
                      <SHORT-NAME>ETH_EXCLUSIVE_AREA_101</SHORT-NAME>
                    </EXCLUSIVE-AREA>
                    <EXCLUSIVE-AREA>
                      <SHORT-NAME>ETH_EXCLUSIVE_AREA_102</SHORT-NAME>
                    </EXCLUSIVE-AREA>
                    <EXCLUSIVE-AREA>
                      <SHORT-NAME>ETH_EXCLUSIVE_AREA_103</SHORT-NAME>
                    </EXCLUSIVE-AREA>
                    <EXCLUSIVE-AREA>
                      <SHORT-NAME>ETH_EXCLUSIVE_AREA_104</SHORT-NAME>
                    </EXCLUSIVE-AREA>
                  </EXCLUSIVE-AREAS>
                  <ENTITYS>
                    <BSW-CALLED-ENTITY>
                      <SHORT-NAME>Eth_43_PFE_Init</SHORT-NAME>
                      <CAN-ENTER-EXCLUSIVE-AREA-REFS>
                        <CAN-ENTER-EXCLUSIVE-AREA-REF DEST="EXCLUSIVE-AREA">/AUTOSAR_Eth_43_PFE/BswModuleDescriptions/Eth/InternalBehavior_0/ETH_EXCLUSIVE_AREA_00</CAN-ENTER-EXCLUSIVE-AREA-REF>
                        <CAN-ENTER-EXCLUSIVE-AREA-REF DEST="EXCLUSIVE-AREA">/AUTOSAR_Eth_43_PFE/BswModuleDescriptions/Eth/InternalBehavior_0/ETH_EXCLUSIVE_AREA_01</CAN-ENTER-EXCLUSIVE-AREA-REF>
                        <CAN-ENTER-EXCLUSIVE-AREA-REF DEST="EXCLUSIVE-AREA">/AUTOSAR_Eth_43_PFE/BswModuleDescriptions/Eth/InternalBehavior_0/ETH_EXCLUSIVE_AREA_03</CAN-ENTER-EXCLUSIVE-AREA-REF>
                        <CAN-ENTER-EXCLUSIVE-AREA-REF DEST="EXCLUSIVE-AREA">/AUTOSAR_Eth_43_PFE/BswModuleDescriptions/Eth/InternalBehavior_0/ETH_EXCLUSIVE_AREA_04</CAN-ENTER-EXCLUSIVE-AREA-REF>
                        <CAN-ENTER-EXCLUSIVE-AREA-REF DEST="EXCLUSIVE-AREA">/AUTOSAR_Eth_43_PFE/BswModuleDescriptions/Eth/InternalBehavior_0/ETH_EXCLUSIVE_AREA_05</CAN-ENTER-EXCLUSIVE-AREA-REF>
                        <CAN-ENTER-EXCLUSIVE-AREA-REF DEST="EXCLUSIVE-AREA">/AUTOSAR_Eth_43_PFE/BswModuleDescriptions/Eth/InternalBehavior_0/ETH_EXCLUSIVE_AREA_07</CAN-ENTER-EXCLUSIVE-AREA-REF>
                        <CAN-ENTER-EXCLUSIVE-AREA-REF DEST="EXCLUSIVE-AREA">/AUTOSAR_Eth_43_PFE/BswModuleDescriptions/Eth/InternalBehavior_0/ETH_EXCLUSIVE_AREA_08</CAN-ENTER-EXCLUSIVE-AREA-REF>
                        <CAN-ENTER-EXCLUSIVE-AREA-REF DEST="EXCLUSIVE-AREA">/AUTOSAR_Eth_43_PFE/BswModuleDescriptions/Eth/InternalBehavior_0/ETH_EXCLUSIVE_AREA_09</CAN-ENTER-EXCLUSIVE-AREA-REF>
                        <CAN-ENTER-EXCLUSIVE-AREA-REF DEST="EXCLUSIVE-AREA">/AUTOSAR_Eth_43_PFE/BswModuleDescriptions/Eth/InternalBehavior_0/ETH_EXCLUSIVE_AREA_10</CAN-ENTER-EXCLUSIVE-AREA-REF>
                        <CAN-ENTER-EXCLUSIVE-AREA-REF DEST="EXCLUSIVE-AREA">/AUTOSAR_Eth_43_PFE/BswModuleDescriptions/Eth/InternalBehavior_0/ETH_EXCLUSIVE_AREA_13</CAN-ENTER-EXCLUSIVE-AREA-REF>
                        <CAN-ENTER-EXCLUSIVE-AREA-REF DEST="EXCLUSIVE-AREA">/AUTOSAR_Eth_43_PFE/BswModuleDescriptions/Eth/InternalBehavior_0/ETH_EXCLUSIVE_AREA_14</CAN-ENTER-EXCLUSIVE-AREA-REF>
                        <CAN-ENTER-EXCLUSIVE-AREA-REF DEST="EXCLUSIVE-AREA">/AUTOSAR_Eth_43_PFE/BswModuleDescriptions/Eth/InternalBehavior_0/ETH_EXCLUSIVE_AREA_15</CAN-ENTER-EXCLUSIVE-AREA-REF>
                        <CAN-ENTER-EXCLUSIVE-AREA-REF DEST="EXCLUSIVE-AREA">/AUTOSAR_Eth_43_PFE/BswModuleDescriptions/Eth/InternalBehavior_0/ETH_EXCLUSIVE_AREA_16</CAN-ENTER-EXCLUSIVE-AREA-REF>
                        <CAN-ENTER-EXCLUSIVE-AREA-REF DEST="EXCLUSIVE-AREA">/AUTOSAR_Eth_43_PFE/BswModuleDescriptions/Eth/InternalBehavior_0/ETH_EXCLUSIVE_AREA_18</CAN-ENTER-EXCLUSIVE-AREA-REF>
                        <CAN-ENTER-EXCLUSIVE-AREA-REF DEST="EXCLUSIVE-AREA">/AUTOSAR_Eth_43_PFE/BswModuleDescriptions/Eth/InternalBehavior_0/ETH_EXCLUSIVE_AREA_20</CAN-ENTER-EXCLUSIVE-AREA-REF>
                        <CAN-ENTER-EXCLUSIVE-AREA-REF DEST="EXCLUSIVE-AREA">/AUTOSAR_Eth_43_PFE/BswModuleDescriptions/Eth/InternalBehavior_0/ETH_EXCLUSIVE_AREA_21</CAN-ENTER-EXCLUSIVE-AREA-REF>
                        <CAN-ENTER-EXCLUSIVE-AREA-REF DEST="EXCLUSIVE-AREA">/AUTOSAR_Eth_43_PFE/BswModuleDescriptions/Eth/InternalBehavior_0/ETH_EXCLUSIVE_AREA_22</CAN-ENTER-EXCLUSIVE-AREA-REF>
                        <CAN-ENTER-EXCLUSIVE-AREA-REF DEST="EXCLUSIVE-AREA">/AUTOSAR_Eth_43_PFE/BswModuleDescriptions/Eth/InternalBehavior_0/ETH_EXCLUSIVE_AREA_23</CAN-ENTER-EXCLUSIVE-AREA-REF>
                        <CAN-ENTER-EXCLUSIVE-AREA-REF DEST="EXCLUSIVE-AREA">/AUTOSAR_Eth_43_PFE/BswModuleDescriptions/Eth/InternalBehavior_0/ETH_EXCLUSIVE_AREA_24</CAN-ENTER-EXCLUSIVE-AREA-REF>
                        <CAN-ENTER-EXCLUSIVE-AREA-REF DEST="EXCLUSIVE-AREA">/AUTOSAR_Eth_43_PFE/BswModuleDescriptions/Eth/InternalBehavior_0/ETH_EXCLUSIVE_AREA_26</CAN-ENTER-EXCLUSIVE-AREA-REF>
                        <CAN-ENTER-EXCLUSIVE-AREA-REF DEST="EXCLUSIVE-AREA">/AUTOSAR_Eth_43_PFE/BswModuleDescriptions/Eth/InternalBehavior_0/ETH_EXCLUSIVE_AREA_28</CAN-ENTER-EXCLUSIVE-AREA-REF>
                        <CAN-ENTER-EXCLUSIVE-AREA-REF DEST="EXCLUSIVE-AREA">/AUTOSAR_Eth_43_PFE/BswModuleDescriptions/Eth/InternalBehavior_0/ETH_EXCLUSIVE_AREA_29</CAN-ENTER-EXCLUSIVE-AREA-REF>
                        <CAN-ENTER-EXCLUSIVE-AREA-REF DEST="EXCLUSIVE-AREA">/AUTOSAR_Eth_43_PFE/BswModuleDescriptions/Eth/InternalBehavior_0/ETH_EXCLUSIVE_AREA_30</CAN-ENTER-EXCLUSIVE-AREA-REF>
                        <CAN-ENTER-EXCLUSIVE-AREA-REF DEST="EXCLUSIVE-AREA">/AUTOSAR_Eth_43_PFE/BswModuleDescriptions/Eth/InternalBehavior_0/ETH_EXCLUSIVE_AREA_31</CAN-ENTER-EXCLUSIVE-AREA-REF>
                        <CAN-ENTER-EXCLUSIVE-AREA-REF DEST="EXCLUSIVE-AREA">/AUTOSAR_Eth_43_PFE/BswModuleDescriptions/Eth/InternalBehavior_0/ETH_EXCLUSIVE_AREA_32</CAN-ENTER-EXCLUSIVE-AREA-REF>
                        <CAN-ENTER-EXCLUSIVE-AREA-REF DEST="EXCLUSIVE-AREA">/AUTOSAR_Eth_43_PFE/BswModuleDescriptions/Eth/InternalBehavior_0/ETH_EXCLUSIVE_AREA_33</CAN-ENTER-EXCLUSIVE-AREA-REF>
                        <CAN-ENTER-EXCLUSIVE-AREA-REF DEST="EXCLUSIVE-AREA">/AUTOSAR_Eth_43_PFE/BswModuleDescriptions/Eth/InternalBehavior_0/ETH_EXCLUSIVE_AREA_37</CAN-ENTER-EXCLUSIVE-AREA-REF>
                        <CAN-ENTER-EXCLUSIVE-AREA-REF DEST="EXCLUSIVE-AREA">/AUTOSAR_Eth_43_PFE/BswModuleDescriptions/Eth/InternalBehavior_0/ETH_EXCLUSIVE_AREA_38</CAN-ENTER-EXCLUSIVE-AREA-REF>
                        <CAN-ENTER-EXCLUSIVE-AREA-REF DEST="EXCLUSIVE-AREA">/AUTOSAR_Eth_43_PFE/BswModuleDescriptions/Eth/InternalBehavior_0/ETH_EXCLUSIVE_AREA_39</CAN-ENTER-EXCLUSIVE-AREA-REF>
                        <CAN-ENTER-EXCLUSIVE-AREA-REF DEST="EXCLUSIVE-AREA">/AUTOSAR_Eth_43_PFE/BswModuleDescriptions/Eth/InternalBehavior_0/ETH_EXCLUSIVE_AREA_40</CAN-ENTER-EXCLUSIVE-AREA-REF>
                        <CAN-ENTER-EXCLUSIVE-AREA-REF DEST="EXCLUSIVE-AREA">/AUTOSAR_Eth_43_PFE/BswModuleDescriptions/Eth/InternalBehavior_0/ETH_EXCLUSIVE_AREA_42</CAN-ENTER-EXCLUSIVE-AREA-REF>
                        <CAN-ENTER-EXCLUSIVE-AREA-REF DEST="EXCLUSIVE-AREA">/AUTOSAR_Eth_43_PFE/BswModuleDescriptions/Eth/InternalBehavior_0/ETH_EXCLUSIVE_AREA_43</CAN-ENTER-EXCLUSIVE-AREA-REF>
                        <CAN-ENTER-EXCLUSIVE-AREA-REF DEST="EXCLUSIVE-AREA">/AUTOSAR_Eth_43_PFE/BswModuleDescriptions/Eth/InternalBehavior_0/ETH_EXCLUSIVE_AREA_44</CAN-ENTER-EXCLUSIVE-AREA-REF>
                        <CAN-ENTER-EXCLUSIVE-AREA-REF DEST="EXCLUSIVE-AREA">/AUTOSAR_Eth_43_PFE/BswModuleDescriptions/Eth/InternalBehavior_0/ETH_EXCLUSIVE_AREA_45</CAN-ENTER-EXCLUSIVE-AREA-REF>
                        <CAN-ENTER-EXCLUSIVE-AREA-REF DEST="EXCLUSIVE-AREA">/AUTOSAR_Eth_43_PFE/BswModuleDescriptions/Eth/InternalBehavior_0/ETH_EXCLUSIVE_AREA_46</CAN-ENTER-EXCLUSIVE-AREA-REF>
                        <CAN-ENTER-EXCLUSIVE-AREA-REF DEST="EXCLUSIVE-AREA">/AUTOSAR_Eth_43_PFE/BswModuleDescriptions/Eth/InternalBehavior_0/ETH_EXCLUSIVE_AREA_47</CAN-ENTER-EXCLUSIVE-AREA-REF>
                        <CAN-ENTER-EXCLUSIVE-AREA-REF DEST="EXCLUSIVE-AREA">/AUTOSAR_Eth_43_PFE/BswModuleDescriptions/Eth/InternalBehavior_0/ETH_EXCLUSIVE_AREA_48</CAN-ENTER-EXCLUSIVE-AREA-REF>
                        <CAN-ENTER-EXCLUSIVE-AREA-REF DEST="EXCLUSIVE-AREA">/AUTOSAR_Eth_43_PFE/BswModuleDescriptions/Eth/InternalBehavior_0/ETH_EXCLUSIVE_AREA_49</CAN-ENTER-EXCLUSIVE-AREA-REF>
                        <CAN-ENTER-EXCLUSIVE-AREA-REF DEST="EXCLUSIVE-AREA">/AUTOSAR_Eth_43_PFE/BswModuleDescriptions/Eth/InternalBehavior_0/ETH_EXCLUSIVE_AREA_50</CAN-ENTER-EXCLUSIVE-AREA-REF>
                        <CAN-ENTER-EXCLUSIVE-AREA-REF DEST="EXCLUSIVE-AREA">/AUTOSAR_Eth_43_PFE/BswModuleDescriptions/Eth/InternalBehavior_0/ETH_EXCLUSIVE_AREA_51</CAN-ENTER-EXCLUSIVE-AREA-REF>
                        <CAN-ENTER-EXCLUSIVE-AREA-REF DEST="EXCLUSIVE-AREA">/AUTOSAR_Eth_43_PFE/BswModuleDescriptions/Eth/InternalBehavior_0/ETH_EXCLUSIVE_AREA_52</CAN-ENTER-EXCLUSIVE-AREA-REF>
                        <CAN-ENTER-EXCLUSIVE-AREA-REF DEST="EXCLUSIVE-AREA">/AUTOSAR_Eth_43_PFE/BswModuleDescriptions/Eth/InternalBehavior_0/ETH_EXCLUSIVE_AREA_53</CAN-ENTER-EXCLUSIVE-AREA-REF>
                        <CAN-ENTER-EXCLUSIVE-AREA-REF DEST="EXCLUSIVE-AREA">/AUTOSAR_Eth_43_PFE/BswModuleDescriptions/Eth/InternalBehavior_0/ETH_EXCLUSIVE_AREA_54</CAN-ENTER-EXCLUSIVE-AREA-REF>
                        <CAN-ENTER-EXCLUSIVE-AREA-REF DEST="EXCLUSIVE-AREA">/AUTOSAR_Eth_43_PFE/BswModuleDescriptions/Eth/InternalBehavior_0/ETH_EXCLUSIVE_AREA_55</CAN-ENTER-EXCLUSIVE-AREA-REF>
                        <CAN-ENTER-EXCLUSIVE-AREA-REF DEST="EXCLUSIVE-AREA">/AUTOSAR_Eth_43_PFE/BswModuleDescriptions/Eth/InternalBehavior_0/ETH_EXCLUSIVE_AREA_56</CAN-ENTER-EXCLUSIVE-AREA-REF>
                        <CAN-ENTER-EXCLUSIVE-AREA-REF DEST="EXCLUSIVE-AREA">/AUTOSAR_Eth_43_PFE/BswModuleDescriptions/Eth/InternalBehavior_0/ETH_EXCLUSIVE_AREA_57</CAN-ENTER-EXCLUSIVE-AREA-REF>
                        <CAN-ENTER-EXCLUSIVE-AREA-REF DEST="EXCLUSIVE-AREA">/AUTOSAR_Eth_43_PFE/BswModuleDescriptions/Eth/InternalBehavior_0/ETH_EXCLUSIVE_AREA_58</CAN-ENTER-EXCLUSIVE-AREA-REF>
                        <CAN-ENTER-EXCLUSIVE-AREA-REF DEST="EXCLUSIVE-AREA">/AUTOSAR_Eth_43_PFE/BswModuleDescriptions/Eth/InternalBehavior_0/ETH_EXCLUSIVE_AREA_59</CAN-ENTER-EXCLUSIVE-AREA-REF>
                        <CAN-ENTER-EXCLUSIVE-AREA-REF DEST="EXCLUSIVE-AREA">/AUTOSAR_Eth_43_PFE/BswModuleDescriptions/Eth/InternalBehavior_0/ETH_EXCLUSIVE_AREA_60</CAN-ENTER-EXCLUSIVE-AREA-REF>
                        <CAN-ENTER-EXCLUSIVE-AREA-REF DEST="EXCLUSIVE-AREA">/AUTOSAR_Eth_43_PFE/BswModuleDescriptions/Eth/InternalBehavior_0/ETH_EXCLUSIVE_AREA_61</CAN-ENTER-EXCLUSIVE-AREA-REF>
                        <CAN-ENTER-EXCLUSIVE-AREA-REF DEST="EXCLUSIVE-AREA">/AUTOSAR_Eth_43_PFE/BswModuleDescriptions/Eth/InternalBehavior_0/ETH_EXCLUSIVE_AREA_65</CAN-ENTER-EXCLUSIVE-AREA-REF>
                        <CAN-ENTER-EXCLUSIVE-AREA-REF DEST="EXCLUSIVE-AREA">/AUTOSAR_Eth_43_PFE/BswModuleDescriptions/Eth/InternalBehavior_0/ETH_EXCLUSIVE_AREA_66</CAN-ENTER-EXCLUSIVE-AREA-REF>
                        <CAN-ENTER-EXCLUSIVE-AREA-REF DEST="EXCLUSIVE-AREA">/AUTOSAR_Eth_43_PFE/BswModuleDescriptions/Eth/InternalBehavior_0/ETH_EXCLUSIVE_AREA_67</CAN-ENTER-EXCLUSIVE-AREA-REF>
                        <CAN-ENTER-EXCLUSIVE-AREA-REF DEST="EXCLUSIVE-AREA">/AUTOSAR_Eth_43_PFE/BswModuleDescriptions/Eth/InternalBehavior_0/ETH_EXCLUSIVE_AREA_68</CAN-ENTER-EXCLUSIVE-AREA-REF>
                        <CAN-ENTER-EXCLUSIVE-AREA-REF DEST="EXCLUSIVE-AREA">/AUTOSAR_Eth_43_PFE/BswModuleDescriptions/Eth/InternalBehavior_0/ETH_EXCLUSIVE_AREA_69</CAN-ENTER-EXCLUSIVE-AREA-REF>
                        <CAN-ENTER-EXCLUSIVE-AREA-REF DEST="EXCLUSIVE-AREA">/AUTOSAR_Eth_43_PFE/BswModuleDescriptions/Eth/InternalBehavior_0/ETH_EXCLUSIVE_AREA_70</CAN-ENTER-EXCLUSIVE-AREA-REF>
                        <CAN-ENTER-EXCLUSIVE-AREA-REF DEST="EXCLUSIVE-AREA">/AUTOSAR_Eth_43_PFE/BswModuleDescriptions/Eth/InternalBehavior_0/ETH_EXCLUSIVE_AREA_71</CAN-ENTER-EXCLUSIVE-AREA-REF>
                        <CAN-ENTER-EXCLUSIVE-AREA-REF DEST="EXCLUSIVE-AREA">/AUTOSAR_Eth_43_PFE/BswModuleDescriptions/Eth/InternalBehavior_0/ETH_EXCLUSIVE_AREA_72</CAN-ENTER-EXCLUSIVE-AREA-REF>
                        <CAN-ENTER-EXCLUSIVE-AREA-REF DEST="EXCLUSIVE-AREA">/AUTOSAR_Eth_43_PFE/BswModuleDescriptions/Eth/InternalBehavior_0/ETH_EXCLUSIVE_AREA_73</CAN-ENTER-EXCLUSIVE-AREA-REF>
                        <CAN-ENTER-EXCLUSIVE-AREA-REF DEST="EXCLUSIVE-AREA">/AUTOSAR_Eth_43_PFE/BswModuleDescriptions/Eth/InternalBehavior_0/ETH_EXCLUSIVE_AREA_74</CAN-ENTER-EXCLUSIVE-AREA-REF>
                        <CAN-ENTER-EXCLUSIVE-AREA-REF DEST="EXCLUSIVE-AREA">/AUTOSAR_Eth_43_PFE/BswModuleDescriptions/Eth/InternalBehavior_0/ETH_EXCLUSIVE_AREA_77</CAN-ENTER-EXCLUSIVE-AREA-REF>
                        <CAN-ENTER-EXCLUSIVE-AREA-REF DEST="EXCLUSIVE-AREA">/AUTOSAR_Eth_43_PFE/BswModuleDescriptions/Eth/InternalBehavior_0/ETH_EXCLUSIVE_AREA_78</CAN-ENTER-EXCLUSIVE-AREA-REF>
                        <CAN-ENTER-EXCLUSIVE-AREA-REF DEST="EXCLUSIVE-AREA">/AUTOSAR_Eth_43_PFE/BswModuleDescriptions/Eth/InternalBehavior_0/ETH_EXCLUSIVE_AREA_79</CAN-ENTER-EXCLUSIVE-AREA-REF>
                        <CAN-ENTER-EXCLUSIVE-AREA-REF DEST="EXCLUSIVE-AREA">/AUTOSAR_Eth_43_PFE/BswModuleDescriptions/Eth/InternalBehavior_0/ETH_EXCLUSIVE_AREA_81</CAN-ENTER-EXCLUSIVE-AREA-REF>
                        <CAN-ENTER-EXCLUSIVE-AREA-REF DEST="EXCLUSIVE-AREA">/AUTOSAR_Eth_43_PFE/BswModuleDescriptions/Eth/InternalBehavior_0/ETH_EXCLUSIVE_AREA_82</CAN-ENTER-EXCLUSIVE-AREA-REF>
                        <CAN-ENTER-EXCLUSIVE-AREA-REF DEST="EXCLUSIVE-AREA">/AUTOSAR_Eth_43_PFE/BswModuleDescriptions/Eth/InternalBehavior_0/ETH_EXCLUSIVE_AREA_83</CAN-ENTER-EXCLUSIVE-AREA-REF>
                        <CAN-ENTER-EXCLUSIVE-AREA-REF DEST="EXCLUSIVE-AREA">/AUTOSAR_Eth_43_PFE/BswModuleDescriptions/Eth/InternalBehavior_0/ETH_EXCLUSIVE_AREA_84</CAN-ENTER-EXCLUSIVE-AREA-REF>
                        <CAN-ENTER-EXCLUSIVE-AREA-REF DEST="EXCLUSIVE-AREA">/AUTOSAR_Eth_43_PFE/BswModuleDescriptions/Eth/InternalBehavior_0/ETH_EXCLUSIVE_AREA_85</CAN-ENTER-EXCLUSIVE-AREA-REF>
                        <CAN-ENTER-EXCLUSIVE-AREA-REF DEST="EXCLUSIVE-AREA">/AUTOSAR_Eth_43_PFE/BswModuleDescriptions/Eth/InternalBehavior_0/ETH_EXCLUSIVE_AREA_86</CAN-ENTER-EXCLUSIVE-AREA-REF>
                        <CAN-ENTER-EXCLUSIVE-AREA-REF DEST="EXCLUSIVE-AREA">/AUTOSAR_Eth_43_PFE/BswModuleDescriptions/Eth/InternalBehavior_0/ETH_EXCLUSIVE_AREA_88</CAN-ENTER-EXCLUSIVE-AREA-REF>
                        <CAN-ENTER-EXCLUSIVE-AREA-REF DEST="EXCLUSIVE-AREA">/AUTOSAR_Eth_43_PFE/BswModuleDescriptions/Eth/InternalBehavior_0/ETH_EXCLUSIVE_AREA_89</CAN-ENTER-EXCLUSIVE-AREA-REF>
                        <CAN-ENTER-EXCLUSIVE-AREA-REF DEST="EXCLUSIVE-AREA">/AUTOSAR_Eth_43_PFE/BswModuleDescriptions/Eth/InternalBehavior_0/ETH_EXCLUSIVE_AREA_90</CAN-ENTER-EXCLUSIVE-AREA-REF>
                        <CAN-ENTER-EXCLUSIVE-AREA-REF DEST="EXCLUSIVE-AREA">/AUTOSAR_Eth_43_PFE/BswModuleDescriptions/Eth/InternalBehavior_0/ETH_EXCLUSIVE_AREA_91</CAN-ENTER-EXCLUSIVE-AREA-REF>
                        <CAN-ENTER-EXCLUSIVE-AREA-REF DEST="EXCLUSIVE-AREA">/AUTOSAR_Eth_43_PFE/BswModuleDescriptions/Eth/InternalBehavior_0/ETH_EXCLUSIVE_AREA_92</CAN-ENTER-EXCLUSIVE-AREA-REF>
                        <CAN-ENTER-EXCLUSIVE-AREA-REF DEST="EXCLUSIVE-AREA">/AUTOSAR_Eth_43_PFE/BswModuleDescriptions/Eth/InternalBehavior_0/ETH_EXCLUSIVE_AREA_93</CAN-ENTER-EXCLUSIVE-AREA-REF>
                        <CAN-ENTER-EXCLUSIVE-AREA-REF DEST="EXCLUSIVE-AREA">/AUTOSAR_Eth_43_PFE/BswModuleDescriptions/Eth/InternalBehavior_0/ETH_EXCLUSIVE_AREA_94</CAN-ENTER-EXCLUSIVE-AREA-REF>
                        <CAN-ENTER-EXCLUSIVE-AREA-REF DEST="EXCLUSIVE-AREA">/AUTOSAR_Eth_43_PFE/BswModuleDescriptions/Eth/InternalBehavior_0/ETH_EXCLUSIVE_AREA_95</CAN-ENTER-EXCLUSIVE-AREA-REF>
                        <CAN-ENTER-EXCLUSIVE-AREA-REF DEST="EXCLUSIVE-AREA">/AUTOSAR_Eth_43_PFE/BswModuleDescriptions/Eth/InternalBehavior_0/ETH_EXCLUSIVE_AREA_97</CAN-ENTER-EXCLUSIVE-AREA-REF>
                        <CAN-ENTER-EXCLUSIVE-AREA-REF DEST="EXCLUSIVE-AREA">/AUTOSAR_Eth_43_PFE/BswModuleDescriptions/Eth/InternalBehavior_0/ETH_EXCLUSIVE_AREA_98</CAN-ENTER-EXCLUSIVE-AREA-REF>
                        <CAN-ENTER-EXCLUSIVE-AREA-REF DEST="EXCLUSIVE-AREA">/AUTOSAR_Eth_43_PFE/BswModuleDescriptions/Eth/InternalBehavior_0/ETH_EXCLUSIVE_AREA_99</CAN-ENTER-EXCLUSIVE-AREA-REF>
                        <CAN-ENTER-EXCLUSIVE-AREA-REF DEST="EXCLUSIVE-AREA">/AUTOSAR_Eth_43_PFE/BswModuleDescriptions/Eth/InternalBehavior_0/ETH_EXCLUSIVE_AREA_100</CAN-ENTER-EXCLUSIVE-AREA-REF>
                        <CAN-ENTER-EXCLUSIVE-AREA-REF DEST="EXCLUSIVE-AREA">/AUTOSAR_Eth_43_PFE/BswModuleDescriptions/Eth/InternalBehavior_0/ETH_EXCLUSIVE_AREA_101</CAN-ENTER-EXCLUSIVE-AREA-REF>
                        <CAN-ENTER-EXCLUSIVE-AREA-REF DEST="EXCLUSIVE-AREA">/AUTOSAR_Eth_43_PFE/BswModuleDescriptions/Eth/InternalBehavior_0/ETH_EXCLUSIVE_AREA_102</CAN-ENTER-EXCLUSIVE-AREA-REF>
                        <CAN-ENTER-EXCLUSIVE-AREA-REF DEST="EXCLUSIVE-AREA">/AUTOSAR_Eth_43_PFE/BswModuleDescriptions/Eth/InternalBehavior_0/ETH_EXCLUSIVE_AREA_103</CAN-ENTER-EXCLUSIVE-AREA-REF>
                        <CAN-ENTER-EXCLUSIVE-AREA-REF DEST="EXCLUSIVE-AREA">/AUTOSAR_Eth_43_PFE/BswModuleDescriptions/Eth/InternalBehavior_0/ETH_EXCLUSIVE_AREA_104</CAN-ENTER-EXCLUSIVE-AREA-REF>
                      </CAN-ENTER-EXCLUSIVE-AREA-REFS>
                      <MINIMUM-START-INTERVAL>0.0</MINIMUM-START-INTERVAL>
                      <IMPLEMENTED-ENTRY-REF DEST="BSW-MODULE-ENTRY">/AUTOSAR_Eth_43_PFE/BswModuleEntrys/Eth_Init</IMPLEMENTED-ENTRY-REF>
                    </BSW-CALLED-ENTITY>
                    <BSW-CALLED-ENTITY>
                      <SHORT-NAME>Eth_43_PFE_DeInit</SHORT-NAME>
                      <CAN-ENTER-EXCLUSIVE-AREA-REFS>
                        <CAN-ENTER-EXCLUSIVE-AREA-REF DEST="EXCLUSIVE-AREA">/AUTOSAR_Eth_43_PFE/BswModuleDescriptions/Eth/InternalBehavior_0/ETH_EXCLUSIVE_AREA_01</CAN-ENTER-EXCLUSIVE-AREA-REF>
                        <CAN-ENTER-EXCLUSIVE-AREA-REF DEST="EXCLUSIVE-AREA">/AUTOSAR_Eth_43_PFE/BswModuleDescriptions/Eth/InternalBehavior_0/ETH_EXCLUSIVE_AREA_03</CAN-ENTER-EXCLUSIVE-AREA-REF>
                        <CAN-ENTER-EXCLUSIVE-AREA-REF DEST="EXCLUSIVE-AREA">/AUTOSAR_Eth_43_PFE/BswModuleDescriptions/Eth/InternalBehavior_0/ETH_EXCLUSIVE_AREA_04</CAN-ENTER-EXCLUSIVE-AREA-REF>
                        <CAN-ENTER-EXCLUSIVE-AREA-REF DEST="EXCLUSIVE-AREA">/AUTOSAR_Eth_43_PFE/BswModuleDescriptions/Eth/InternalBehavior_0/ETH_EXCLUSIVE_AREA_05</CAN-ENTER-EXCLUSIVE-AREA-REF>
                        <CAN-ENTER-EXCLUSIVE-AREA-REF DEST="EXCLUSIVE-AREA">/AUTOSAR_Eth_43_PFE/BswModuleDescriptions/Eth/InternalBehavior_0/ETH_EXCLUSIVE_AREA_07</CAN-ENTER-EXCLUSIVE-AREA-REF>
                        <CAN-ENTER-EXCLUSIVE-AREA-REF DEST="EXCLUSIVE-AREA">/AUTOSAR_Eth_43_PFE/BswModuleDescriptions/Eth/InternalBehavior_0/ETH_EXCLUSIVE_AREA_08</CAN-ENTER-EXCLUSIVE-AREA-REF>
                        <CAN-ENTER-EXCLUSIVE-AREA-REF DEST="EXCLUSIVE-AREA">/AUTOSAR_Eth_43_PFE/BswModuleDescriptions/Eth/InternalBehavior_0/ETH_EXCLUSIVE_AREA_09</CAN-ENTER-EXCLUSIVE-AREA-REF>
                        <CAN-ENTER-EXCLUSIVE-AREA-REF DEST="EXCLUSIVE-AREA">/AUTOSAR_Eth_43_PFE/BswModuleDescriptions/Eth/InternalBehavior_0/ETH_EXCLUSIVE_AREA_10</CAN-ENTER-EXCLUSIVE-AREA-REF>
                        <CAN-ENTER-EXCLUSIVE-AREA-REF DEST="EXCLUSIVE-AREA">/AUTOSAR_Eth_43_PFE/BswModuleDescriptions/Eth/InternalBehavior_0/ETH_EXCLUSIVE_AREA_13</CAN-ENTER-EXCLUSIVE-AREA-REF>
                        <CAN-ENTER-EXCLUSIVE-AREA-REF DEST="EXCLUSIVE-AREA">/AUTOSAR_Eth_43_PFE/BswModuleDescriptions/Eth/InternalBehavior_0/ETH_EXCLUSIVE_AREA_14</CAN-ENTER-EXCLUSIVE-AREA-REF>
                        <CAN-ENTER-EXCLUSIVE-AREA-REF DEST="EXCLUSIVE-AREA">/AUTOSAR_Eth_43_PFE/BswModuleDescriptions/Eth/InternalBehavior_0/ETH_EXCLUSIVE_AREA_15</CAN-ENTER-EXCLUSIVE-AREA-REF>
                        <CAN-ENTER-EXCLUSIVE-AREA-REF DEST="EXCLUSIVE-AREA">/AUTOSAR_Eth_43_PFE/BswModuleDescriptions/Eth/InternalBehavior_0/ETH_EXCLUSIVE_AREA_16</CAN-ENTER-EXCLUSIVE-AREA-REF>
                        <CAN-ENTER-EXCLUSIVE-AREA-REF DEST="EXCLUSIVE-AREA">/AUTOSAR_Eth_43_PFE/BswModuleDescriptions/Eth/InternalBehavior_0/ETH_EXCLUSIVE_AREA_18</CAN-ENTER-EXCLUSIVE-AREA-REF>
                        <CAN-ENTER-EXCLUSIVE-AREA-REF DEST="EXCLUSIVE-AREA">/AUTOSAR_Eth_43_PFE/BswModuleDescriptions/Eth/InternalBehavior_0/ETH_EXCLUSIVE_AREA_20</CAN-ENTER-EXCLUSIVE-AREA-REF>
                        <CAN-ENTER-EXCLUSIVE-AREA-REF DEST="EXCLUSIVE-AREA">/AUTOSAR_Eth_43_PFE/BswModuleDescriptions/Eth/InternalBehavior_0/ETH_EXCLUSIVE_AREA_21</CAN-ENTER-EXCLUSIVE-AREA-REF>
                        <CAN-ENTER-EXCLUSIVE-AREA-REF DEST="EXCLUSIVE-AREA">/AUTOSAR_Eth_43_PFE/BswModuleDescriptions/Eth/InternalBehavior_0/ETH_EXCLUSIVE_AREA_22</CAN-ENTER-EXCLUSIVE-AREA-REF>
                        <CAN-ENTER-EXCLUSIVE-AREA-REF DEST="EXCLUSIVE-AREA">/AUTOSAR_Eth_43_PFE/BswModuleDescriptions/Eth/InternalBehavior_0/ETH_EXCLUSIVE_AREA_23</CAN-ENTER-EXCLUSIVE-AREA-REF>
                        <CAN-ENTER-EXCLUSIVE-AREA-REF DEST="EXCLUSIVE-AREA">/AUTOSAR_Eth_43_PFE/BswModuleDescriptions/Eth/InternalBehavior_0/ETH_EXCLUSIVE_AREA_26</CAN-ENTER-EXCLUSIVE-AREA-REF>
                        <CAN-ENTER-EXCLUSIVE-AREA-REF DEST="EXCLUSIVE-AREA">/AUTOSAR_Eth_43_PFE/BswModuleDescriptions/Eth/InternalBehavior_0/ETH_EXCLUSIVE_AREA_28</CAN-ENTER-EXCLUSIVE-AREA-REF>
                        <CAN-ENTER-EXCLUSIVE-AREA-REF DEST="EXCLUSIVE-AREA">/AUTOSAR_Eth_43_PFE/BswModuleDescriptions/Eth/InternalBehavior_0/ETH_EXCLUSIVE_AREA_30</CAN-ENTER-EXCLUSIVE-AREA-REF>
                        <CAN-ENTER-EXCLUSIVE-AREA-REF DEST="EXCLUSIVE-AREA">/AUTOSAR_Eth_43_PFE/BswModuleDescriptions/Eth/InternalBehavior_0/ETH_EXCLUSIVE_AREA_31</CAN-ENTER-EXCLUSIVE-AREA-REF>
                        <CAN-ENTER-EXCLUSIVE-AREA-REF DEST="EXCLUSIVE-AREA">/AUTOSAR_Eth_43_PFE/BswModuleDescriptions/Eth/InternalBehavior_0/ETH_EXCLUSIVE_AREA_37</CAN-ENTER-EXCLUSIVE-AREA-REF>
                        <CAN-ENTER-EXCLUSIVE-AREA-REF DEST="EXCLUSIVE-AREA">/AUTOSAR_Eth_43_PFE/BswModuleDescriptions/Eth/InternalBehavior_0/ETH_EXCLUSIVE_AREA_38</CAN-ENTER-EXCLUSIVE-AREA-REF>
                        <CAN-ENTER-EXCLUSIVE-AREA-REF DEST="EXCLUSIVE-AREA">/AUTOSAR_Eth_43_PFE/BswModuleDescriptions/Eth/InternalBehavior_0/ETH_EXCLUSIVE_AREA_39</CAN-ENTER-EXCLUSIVE-AREA-REF>
                        <CAN-ENTER-EXCLUSIVE-AREA-REF DEST="EXCLUSIVE-AREA">/AUTOSAR_Eth_43_PFE/BswModuleDescriptions/Eth/InternalBehavior_0/ETH_EXCLUSIVE_AREA_40</CAN-ENTER-EXCLUSIVE-AREA-REF>
                        <CAN-ENTER-EXCLUSIVE-AREA-REF DEST="EXCLUSIVE-AREA">/AUTOSAR_Eth_43_PFE/BswModuleDescriptions/Eth/InternalBehavior_0/ETH_EXCLUSIVE_AREA_42</CAN-ENTER-EXCLUSIVE-AREA-REF>
                        <CAN-ENTER-EXCLUSIVE-AREA-REF DEST="EXCLUSIVE-AREA">/AUTOSAR_Eth_43_PFE/BswModuleDescriptions/Eth/InternalBehavior_0/ETH_EXCLUSIVE_AREA_45</CAN-ENTER-EXCLUSIVE-AREA-REF>
                        <CAN-ENTER-EXCLUSIVE-AREA-REF DEST="EXCLUSIVE-AREA">/AUTOSAR_Eth_43_PFE/BswModuleDescriptions/Eth/InternalBehavior_0/ETH_EXCLUSIVE_AREA_46</CAN-ENTER-EXCLUSIVE-AREA-REF>
                        <CAN-ENTER-EXCLUSIVE-AREA-REF DEST="EXCLUSIVE-AREA">/AUTOSAR_Eth_43_PFE/BswModuleDescriptions/Eth/InternalBehavior_0/ETH_EXCLUSIVE_AREA_47</CAN-ENTER-EXCLUSIVE-AREA-REF>
                        <CAN-ENTER-EXCLUSIVE-AREA-REF DEST="EXCLUSIVE-AREA">/AUTOSAR_Eth_43_PFE/BswModuleDescriptions/Eth/InternalBehavior_0/ETH_EXCLUSIVE_AREA_48</CAN-ENTER-EXCLUSIVE-AREA-REF>
                        <CAN-ENTER-EXCLUSIVE-AREA-REF DEST="EXCLUSIVE-AREA">/AUTOSAR_Eth_43_PFE/BswModuleDescriptions/Eth/InternalBehavior_0/ETH_EXCLUSIVE_AREA_49</CAN-ENTER-EXCLUSIVE-AREA-REF>
                        <CAN-ENTER-EXCLUSIVE-AREA-REF DEST="EXCLUSIVE-AREA">/AUTOSAR_Eth_43_PFE/BswModuleDescriptions/Eth/InternalBehavior_0/ETH_EXCLUSIVE_AREA_50</CAN-ENTER-EXCLUSIVE-AREA-REF>
                        <CAN-ENTER-EXCLUSIVE-AREA-REF DEST="EXCLUSIVE-AREA">/AUTOSAR_Eth_43_PFE/BswModuleDescriptions/Eth/InternalBehavior_0/ETH_EXCLUSIVE_AREA_51</CAN-ENTER-EXCLUSIVE-AREA-REF>
                        <CAN-ENTER-EXCLUSIVE-AREA-REF DEST="EXCLUSIVE-AREA">/AUTOSAR_Eth_43_PFE/BswModuleDescriptions/Eth/InternalBehavior_0/ETH_EXCLUSIVE_AREA_52</CAN-ENTER-EXCLUSIVE-AREA-REF>
                        <CAN-ENTER-EXCLUSIVE-AREA-REF DEST="EXCLUSIVE-AREA">/AUTOSAR_Eth_43_PFE/BswModuleDescriptions/Eth/InternalBehavior_0/ETH_EXCLUSIVE_AREA_53</CAN-ENTER-EXCLUSIVE-AREA-REF>
                        <CAN-ENTER-EXCLUSIVE-AREA-REF DEST="EXCLUSIVE-AREA">/AUTOSAR_Eth_43_PFE/BswModuleDescriptions/Eth/InternalBehavior_0/ETH_EXCLUSIVE_AREA_54</CAN-ENTER-EXCLUSIVE-AREA-REF>
                        <CAN-ENTER-EXCLUSIVE-AREA-REF DEST="EXCLUSIVE-AREA">/AUTOSAR_Eth_43_PFE/BswModuleDescriptions/Eth/InternalBehavior_0/ETH_EXCLUSIVE_AREA_55</CAN-ENTER-EXCLUSIVE-AREA-REF>
                        <CAN-ENTER-EXCLUSIVE-AREA-REF DEST="EXCLUSIVE-AREA">/AUTOSAR_Eth_43_PFE/BswModuleDescriptions/Eth/InternalBehavior_0/ETH_EXCLUSIVE_AREA_56</CAN-ENTER-EXCLUSIVE-AREA-REF>
                        <CAN-ENTER-EXCLUSIVE-AREA-REF DEST="EXCLUSIVE-AREA">/AUTOSAR_Eth_43_PFE/BswModuleDescriptions/Eth/InternalBehavior_0/ETH_EXCLUSIVE_AREA_57</CAN-ENTER-EXCLUSIVE-AREA-REF>
                        <CAN-ENTER-EXCLUSIVE-AREA-REF DEST="EXCLUSIVE-AREA">/AUTOSAR_Eth_43_PFE/BswModuleDescriptions/Eth/InternalBehavior_0/ETH_EXCLUSIVE_AREA_58</CAN-ENTER-EXCLUSIVE-AREA-REF>
                        <CAN-ENTER-EXCLUSIVE-AREA-REF DEST="EXCLUSIVE-AREA">/AUTOSAR_Eth_43_PFE/BswModuleDescriptions/Eth/InternalBehavior_0/ETH_EXCLUSIVE_AREA_59</CAN-ENTER-EXCLUSIVE-AREA-REF>
                        <CAN-ENTER-EXCLUSIVE-AREA-REF DEST="EXCLUSIVE-AREA">/AUTOSAR_Eth_43_PFE/BswModuleDescriptions/Eth/InternalBehavior_0/ETH_EXCLUSIVE_AREA_60</CAN-ENTER-EXCLUSIVE-AREA-REF>
                        <CAN-ENTER-EXCLUSIVE-AREA-REF DEST="EXCLUSIVE-AREA">/AUTOSAR_Eth_43_PFE/BswModuleDescriptions/Eth/InternalBehavior_0/ETH_EXCLUSIVE_AREA_65</CAN-ENTER-EXCLUSIVE-AREA-REF>
                        <CAN-ENTER-EXCLUSIVE-AREA-REF DEST="EXCLUSIVE-AREA">/AUTOSAR_Eth_43_PFE/BswModuleDescriptions/Eth/InternalBehavior_0/ETH_EXCLUSIVE_AREA_66</CAN-ENTER-EXCLUSIVE-AREA-REF>
                        <CAN-ENTER-EXCLUSIVE-AREA-REF DEST="EXCLUSIVE-AREA">/AUTOSAR_Eth_43_PFE/BswModuleDescriptions/Eth/InternalBehavior_0/ETH_EXCLUSIVE_AREA_67</CAN-ENTER-EXCLUSIVE-AREA-REF>
                        <CAN-ENTER-EXCLUSIVE-AREA-REF DEST="EXCLUSIVE-AREA">/AUTOSAR_Eth_43_PFE/BswModuleDescriptions/Eth/InternalBehavior_0/ETH_EXCLUSIVE_AREA_68</CAN-ENTER-EXCLUSIVE-AREA-REF>
                        <CAN-ENTER-EXCLUSIVE-AREA-REF DEST="EXCLUSIVE-AREA">/AUTOSAR_Eth_43_PFE/BswModuleDescriptions/Eth/InternalBehavior_0/ETH_EXCLUSIVE_AREA_69</CAN-ENTER-EXCLUSIVE-AREA-REF>
                        <CAN-ENTER-EXCLUSIVE-AREA-REF DEST="EXCLUSIVE-AREA">/AUTOSAR_Eth_43_PFE/BswModuleDescriptions/Eth/InternalBehavior_0/ETH_EXCLUSIVE_AREA_70</CAN-ENTER-EXCLUSIVE-AREA-REF>
                        <CAN-ENTER-EXCLUSIVE-AREA-REF DEST="EXCLUSIVE-AREA">/AUTOSAR_Eth_43_PFE/BswModuleDescriptions/Eth/InternalBehavior_0/ETH_EXCLUSIVE_AREA_71</CAN-ENTER-EXCLUSIVE-AREA-REF>
                        <CAN-ENTER-EXCLUSIVE-AREA-REF DEST="EXCLUSIVE-AREA">/AUTOSAR_Eth_43_PFE/BswModuleDescriptions/Eth/InternalBehavior_0/ETH_EXCLUSIVE_AREA_72</CAN-ENTER-EXCLUSIVE-AREA-REF>
                        <CAN-ENTER-EXCLUSIVE-AREA-REF DEST="EXCLUSIVE-AREA">/AUTOSAR_Eth_43_PFE/BswModuleDescriptions/Eth/InternalBehavior_0/ETH_EXCLUSIVE_AREA_73</CAN-ENTER-EXCLUSIVE-AREA-REF>
                        <CAN-ENTER-EXCLUSIVE-AREA-REF DEST="EXCLUSIVE-AREA">/AUTOSAR_Eth_43_PFE/BswModuleDescriptions/Eth/InternalBehavior_0/ETH_EXCLUSIVE_AREA_74</CAN-ENTER-EXCLUSIVE-AREA-REF>
                        <CAN-ENTER-EXCLUSIVE-AREA-REF DEST="EXCLUSIVE-AREA">/AUTOSAR_Eth_43_PFE/BswModuleDescriptions/Eth/InternalBehavior_0/ETH_EXCLUSIVE_AREA_77</CAN-ENTER-EXCLUSIVE-AREA-REF>
                        <CAN-ENTER-EXCLUSIVE-AREA-REF DEST="EXCLUSIVE-AREA">/AUTOSAR_Eth_43_PFE/BswModuleDescriptions/Eth/InternalBehavior_0/ETH_EXCLUSIVE_AREA_78</CAN-ENTER-EXCLUSIVE-AREA-REF>
                        <CAN-ENTER-EXCLUSIVE-AREA-REF DEST="EXCLUSIVE-AREA">/AUTOSAR_Eth_43_PFE/BswModuleDescriptions/Eth/InternalBehavior_0/ETH_EXCLUSIVE_AREA_79</CAN-ENTER-EXCLUSIVE-AREA-REF>
                        <CAN-ENTER-EXCLUSIVE-AREA-REF DEST="EXCLUSIVE-AREA">/AUTOSAR_Eth_43_PFE/BswModuleDescriptions/Eth/InternalBehavior_0/ETH_EXCLUSIVE_AREA_81</CAN-ENTER-EXCLUSIVE-AREA-REF>
                        <CAN-ENTER-EXCLUSIVE-AREA-REF DEST="EXCLUSIVE-AREA">/AUTOSAR_Eth_43_PFE/BswModuleDescriptions/Eth/InternalBehavior_0/ETH_EXCLUSIVE_AREA_82</CAN-ENTER-EXCLUSIVE-AREA-REF>
                        <CAN-ENTER-EXCLUSIVE-AREA-REF DEST="EXCLUSIVE-AREA">/AUTOSAR_Eth_43_PFE/BswModuleDescriptions/Eth/InternalBehavior_0/ETH_EXCLUSIVE_AREA_84</CAN-ENTER-EXCLUSIVE-AREA-REF>
                        <CAN-ENTER-EXCLUSIVE-AREA-REF DEST="EXCLUSIVE-AREA">/AUTOSAR_Eth_43_PFE/BswModuleDescriptions/Eth/InternalBehavior_0/ETH_EXCLUSIVE_AREA_85</CAN-ENTER-EXCLUSIVE-AREA-REF>
                        <CAN-ENTER-EXCLUSIVE-AREA-REF DEST="EXCLUSIVE-AREA">/AUTOSAR_Eth_43_PFE/BswModuleDescriptions/Eth/InternalBehavior_0/ETH_EXCLUSIVE_AREA_86</CAN-ENTER-EXCLUSIVE-AREA-REF>
                        <CAN-ENTER-EXCLUSIVE-AREA-REF DEST="EXCLUSIVE-AREA">/AUTOSAR_Eth_43_PFE/BswModuleDescriptions/Eth/InternalBehavior_0/ETH_EXCLUSIVE_AREA_88</CAN-ENTER-EXCLUSIVE-AREA-REF>
                        <CAN-ENTER-EXCLUSIVE-AREA-REF DEST="EXCLUSIVE-AREA">/AUTOSAR_Eth_43_PFE/BswModuleDescriptions/Eth/InternalBehavior_0/ETH_EXCLUSIVE_AREA_89</CAN-ENTER-EXCLUSIVE-AREA-REF>
                        <CAN-ENTER-EXCLUSIVE-AREA-REF DEST="EXCLUSIVE-AREA">/AUTOSAR_Eth_43_PFE/BswModuleDescriptions/Eth/InternalBehavior_0/ETH_EXCLUSIVE_AREA_90</CAN-ENTER-EXCLUSIVE-AREA-REF>
                        <CAN-ENTER-EXCLUSIVE-AREA-REF DEST="EXCLUSIVE-AREA">/AUTOSAR_Eth_43_PFE/BswModuleDescriptions/Eth/InternalBehavior_0/ETH_EXCLUSIVE_AREA_91</CAN-ENTER-EXCLUSIVE-AREA-REF>
                        <CAN-ENTER-EXCLUSIVE-AREA-REF DEST="EXCLUSIVE-AREA">/AUTOSAR_Eth_43_PFE/BswModuleDescriptions/Eth/InternalBehavior_0/ETH_EXCLUSIVE_AREA_92</CAN-ENTER-EXCLUSIVE-AREA-REF>
                        <CAN-ENTER-EXCLUSIVE-AREA-REF DEST="EXCLUSIVE-AREA">/AUTOSAR_Eth_43_PFE/BswModuleDescriptions/Eth/InternalBehavior_0/ETH_EXCLUSIVE_AREA_93</CAN-ENTER-EXCLUSIVE-AREA-REF>
                        <CAN-ENTER-EXCLUSIVE-AREA-REF DEST="EXCLUSIVE-AREA">/AUTOSAR_Eth_43_PFE/BswModuleDescriptions/Eth/InternalBehavior_0/ETH_EXCLUSIVE_AREA_94</CAN-ENTER-EXCLUSIVE-AREA-REF>
                        <CAN-ENTER-EXCLUSIVE-AREA-REF DEST="EXCLUSIVE-AREA">/AUTOSAR_Eth_43_PFE/BswModuleDescriptions/Eth/InternalBehavior_0/ETH_EXCLUSIVE_AREA_95</CAN-ENTER-EXCLUSIVE-AREA-REF>
                        <CAN-ENTER-EXCLUSIVE-AREA-REF DEST="EXCLUSIVE-AREA">/AUTOSAR_Eth_43_PFE/BswModuleDescriptions/Eth/InternalBehavior_0/ETH_EXCLUSIVE_AREA_97</CAN-ENTER-EXCLUSIVE-AREA-REF>
                        <CAN-ENTER-EXCLUSIVE-AREA-REF DEST="EXCLUSIVE-AREA">/AUTOSAR_Eth_43_PFE/BswModuleDescriptions/Eth/InternalBehavior_0/ETH_EXCLUSIVE_AREA_98</CAN-ENTER-EXCLUSIVE-AREA-REF>
                        <CAN-ENTER-EXCLUSIVE-AREA-REF DEST="EXCLUSIVE-AREA">/AUTOSAR_Eth_43_PFE/BswModuleDescriptions/Eth/InternalBehavior_0/ETH_EXCLUSIVE_AREA_99</CAN-ENTER-EXCLUSIVE-AREA-REF>
                        <CAN-ENTER-EXCLUSIVE-AREA-REF DEST="EXCLUSIVE-AREA">/AUTOSAR_Eth_43_PFE/BswModuleDescriptions/Eth/InternalBehavior_0/ETH_EXCLUSIVE_AREA_100</CAN-ENTER-EXCLUSIVE-AREA-REF>
                        <CAN-ENTER-EXCLUSIVE-AREA-REF DEST="EXCLUSIVE-AREA">/AUTOSAR_Eth_43_PFE/BswModuleDescriptions/Eth/InternalBehavior_0/ETH_EXCLUSIVE_AREA_101</CAN-ENTER-EXCLUSIVE-AREA-REF>
                        <CAN-ENTER-EXCLUSIVE-AREA-REF DEST="EXCLUSIVE-AREA">/AUTOSAR_Eth_43_PFE/BswModuleDescriptions/Eth/InternalBehavior_0/ETH_EXCLUSIVE_AREA_102</CAN-ENTER-EXCLUSIVE-AREA-REF>
                        <CAN-ENTER-EXCLUSIVE-AREA-REF DEST="EXCLUSIVE-AREA">/AUTOSAR_Eth_43_PFE/BswModuleDescriptions/Eth/InternalBehavior_0/ETH_EXCLUSIVE_AREA_103</CAN-ENTER-EXCLUSIVE-AREA-REF>
                        <CAN-ENTER-EXCLUSIVE-AREA-REF DEST="EXCLUSIVE-AREA">/AUTOSAR_Eth_43_PFE/BswModuleDescriptions/Eth/InternalBehavior_0/ETH_EXCLUSIVE_AREA_104</CAN-ENTER-EXCLUSIVE-AREA-REF>
                      </CAN-ENTER-EXCLUSIVE-AREA-REFS>
                      <MINIMUM-START-INTERVAL>0.0</MINIMUM-START-INTERVAL>
                      <IMPLEMENTED-ENTRY-REF DEST="BSW-MODULE-ENTRY">/AUTOSAR_Eth_43_PFE/BswModuleEntrys/Eth_DeInit</IMPLEMENTED-ENTRY-REF>
                    </BSW-CALLED-ENTITY>
                    [!IF "EthGeneral/EthGetPFEStatisticApi = 'true'"!][!//
                    <BSW-CALLED-ENTITY>
                      <SHORT-NAME>Eth_43_PFE_GetL2BridgeDomainStats</SHORT-NAME>
                      <CAN-ENTER-EXCLUSIVE-AREA-REFS>
                        <CAN-ENTER-EXCLUSIVE-AREA-REF DEST="EXCLUSIVE-AREA">/AUTOSAR_Eth_43_PFE/BswModuleDescriptions/Eth/InternalBehavior_0/ETH_EXCLUSIVE_AREA_23</CAN-ENTER-EXCLUSIVE-AREA-REF>
                        <CAN-ENTER-EXCLUSIVE-AREA-REF DEST="EXCLUSIVE-AREA">/AUTOSAR_Eth_43_PFE/BswModuleDescriptions/Eth/InternalBehavior_0/ETH_EXCLUSIVE_AREA_31</CAN-ENTER-EXCLUSIVE-AREA-REF>
                        <CAN-ENTER-EXCLUSIVE-AREA-REF DEST="EXCLUSIVE-AREA">/AUTOSAR_Eth_43_PFE/BswModuleDescriptions/Eth/InternalBehavior_0/ETH_EXCLUSIVE_AREA_95</CAN-ENTER-EXCLUSIVE-AREA-REF>
                        <CAN-ENTER-EXCLUSIVE-AREA-REF DEST="EXCLUSIVE-AREA">/AUTOSAR_Eth_43_PFE/BswModuleDescriptions/Eth/InternalBehavior_0/ETH_EXCLUSIVE_AREA_100</CAN-ENTER-EXCLUSIVE-AREA-REF>
                        <CAN-ENTER-EXCLUSIVE-AREA-REF DEST="EXCLUSIVE-AREA">/AUTOSAR_Eth_43_PFE/BswModuleDescriptions/Eth/InternalBehavior_0/ETH_EXCLUSIVE_AREA_101</CAN-ENTER-EXCLUSIVE-AREA-REF>
                      </CAN-ENTER-EXCLUSIVE-AREA-REFS>
                      <MINIMUM-START-INTERVAL>0.0</MINIMUM-START-INTERVAL>
                      <IMPLEMENTED-ENTRY-REF DEST="BSW-MODULE-ENTRY">/AUTOSAR_Eth_43_PFE/BswModuleEntrys/Eth_GetL2BridgeDomainStats</IMPLEMENTED-ENTRY-REF>
                    </BSW-CALLED-ENTITY>
                    <BSW-CALLED-ENTITY>
                      <SHORT-NAME>Eth_43_PFE_GetRtableStats</SHORT-NAME>
                      <CAN-ENTER-EXCLUSIVE-AREA-REFS>
                        <CAN-ENTER-EXCLUSIVE-AREA-REF DEST="EXCLUSIVE-AREA">/AUTOSAR_Eth_43_PFE/BswModuleDescriptions/Eth/InternalBehavior_0/ETH_EXCLUSIVE_AREA_23</CAN-ENTER-EXCLUSIVE-AREA-REF>
                        <CAN-ENTER-EXCLUSIVE-AREA-REF DEST="EXCLUSIVE-AREA">/AUTOSAR_Eth_43_PFE/BswModuleDescriptions/Eth/InternalBehavior_0/ETH_EXCLUSIVE_AREA_31</CAN-ENTER-EXCLUSIVE-AREA-REF>
                        <CAN-ENTER-EXCLUSIVE-AREA-REF DEST="EXCLUSIVE-AREA">/AUTOSAR_Eth_43_PFE/BswModuleDescriptions/Eth/InternalBehavior_0/ETH_EXCLUSIVE_AREA_95</CAN-ENTER-EXCLUSIVE-AREA-REF>
                        <CAN-ENTER-EXCLUSIVE-AREA-REF DEST="EXCLUSIVE-AREA">/AUTOSAR_Eth_43_PFE/BswModuleDescriptions/Eth/InternalBehavior_0/ETH_EXCLUSIVE_AREA_100</CAN-ENTER-EXCLUSIVE-AREA-REF>
                        <CAN-ENTER-EXCLUSIVE-AREA-REF DEST="EXCLUSIVE-AREA">/AUTOSAR_Eth_43_PFE/BswModuleDescriptions/Eth/InternalBehavior_0/ETH_EXCLUSIVE_AREA_101</CAN-ENTER-EXCLUSIVE-AREA-REF>
                      </CAN-ENTER-EXCLUSIVE-AREA-REFS>
                      <MINIMUM-START-INTERVAL>0.0</MINIMUM-START-INTERVAL>
                      <IMPLEMENTED-ENTRY-REF DEST="BSW-MODULE-ENTRY">/AUTOSAR_Eth_43_PFE/BswModuleEntrys/Eth_GetRtableStats</IMPLEMENTED-ENTRY-REF>
                    </BSW-CALLED-ENTITY>
                    <BSW-CALLED-ENTITY>
                      <SHORT-NAME>Eth_43_PFE_GetBmuStats</SHORT-NAME>
                      <CAN-ENTER-EXCLUSIVE-AREA-REFS>
                        <CAN-ENTER-EXCLUSIVE-AREA-REF DEST="EXCLUSIVE-AREA">/AUTOSAR_Eth_43_PFE/BswModuleDescriptions/Eth/InternalBehavior_0/ETH_EXCLUSIVE_AREA_95</CAN-ENTER-EXCLUSIVE-AREA-REF>
                        <CAN-ENTER-EXCLUSIVE-AREA-REF DEST="EXCLUSIVE-AREA">/AUTOSAR_Eth_43_PFE/BswModuleDescriptions/Eth/InternalBehavior_0/ETH_EXCLUSIVE_AREA_100</CAN-ENTER-EXCLUSIVE-AREA-REF>
                        <CAN-ENTER-EXCLUSIVE-AREA-REF DEST="EXCLUSIVE-AREA">/AUTOSAR_Eth_43_PFE/BswModuleDescriptions/Eth/InternalBehavior_0/ETH_EXCLUSIVE_AREA_101</CAN-ENTER-EXCLUSIVE-AREA-REF>
                      </CAN-ENTER-EXCLUSIVE-AREA-REFS>
                      <MINIMUM-START-INTERVAL>0.0</MINIMUM-START-INTERVAL>
                      <IMPLEMENTED-ENTRY-REF DEST="BSW-MODULE-ENTRY">/AUTOSAR_Eth_43_PFE/BswModuleEntrys/Eth_GetBmuStats</IMPLEMENTED-ENTRY-REF>
                    </BSW-CALLED-ENTITY>
                    <BSW-CALLED-ENTITY>
                      <SHORT-NAME>Eth_43_PFE_GetGpiStats</SHORT-NAME>
                      <CAN-ENTER-EXCLUSIVE-AREA-REFS>
                        <CAN-ENTER-EXCLUSIVE-AREA-REF DEST="EXCLUSIVE-AREA">/AUTOSAR_Eth_43_PFE/BswModuleDescriptions/Eth/InternalBehavior_0/ETH_EXCLUSIVE_AREA_95</CAN-ENTER-EXCLUSIVE-AREA-REF>
                        <CAN-ENTER-EXCLUSIVE-AREA-REF DEST="EXCLUSIVE-AREA">/AUTOSAR_Eth_43_PFE/BswModuleDescriptions/Eth/InternalBehavior_0/ETH_EXCLUSIVE_AREA_100</CAN-ENTER-EXCLUSIVE-AREA-REF>
                        <CAN-ENTER-EXCLUSIVE-AREA-REF DEST="EXCLUSIVE-AREA">/AUTOSAR_Eth_43_PFE/BswModuleDescriptions/Eth/InternalBehavior_0/ETH_EXCLUSIVE_AREA_101</CAN-ENTER-EXCLUSIVE-AREA-REF>
                      </CAN-ENTER-EXCLUSIVE-AREA-REFS>
                      <MINIMUM-START-INTERVAL>0.0</MINIMUM-START-INTERVAL>
                      <IMPLEMENTED-ENTRY-REF DEST="BSW-MODULE-ENTRY">/AUTOSAR_Eth_43_PFE/BswModuleEntrys/Eth_GetGpiStats</IMPLEMENTED-ENTRY-REF>
                    </BSW-CALLED-ENTITY>
                    <BSW-CALLED-ENTITY>
                      <SHORT-NAME>Eth_43_PFE_GetL2BridgeStats</SHORT-NAME>
                      <CAN-ENTER-EXCLUSIVE-AREA-REFS>
                        <CAN-ENTER-EXCLUSIVE-AREA-REF DEST="EXCLUSIVE-AREA">/AUTOSAR_Eth_43_PFE/BswModuleDescriptions/Eth/InternalBehavior_0/ETH_EXCLUSIVE_AREA_95</CAN-ENTER-EXCLUSIVE-AREA-REF>
                        <CAN-ENTER-EXCLUSIVE-AREA-REF DEST="EXCLUSIVE-AREA">/AUTOSAR_Eth_43_PFE/BswModuleDescriptions/Eth/InternalBehavior_0/ETH_EXCLUSIVE_AREA_100</CAN-ENTER-EXCLUSIVE-AREA-REF>
                        <CAN-ENTER-EXCLUSIVE-AREA-REF DEST="EXCLUSIVE-AREA">/AUTOSAR_Eth_43_PFE/BswModuleDescriptions/Eth/InternalBehavior_0/ETH_EXCLUSIVE_AREA_101</CAN-ENTER-EXCLUSIVE-AREA-REF>
                      </CAN-ENTER-EXCLUSIVE-AREA-REFS>
                      <MINIMUM-START-INTERVAL>0.0</MINIMUM-START-INTERVAL>
                      <IMPLEMENTED-ENTRY-REF DEST="BSW-MODULE-ENTRY">/AUTOSAR_Eth_43_PFE/BswModuleEntrys/Eth_GetL2BridgeStats</IMPLEMENTED-ENTRY-REF>
                    </BSW-CALLED-ENTITY>
                    <BSW-CALLED-ENTITY>
                      <SHORT-NAME>Eth_43_PFE_GetWdtStats</SHORT-NAME>
                      <CAN-ENTER-EXCLUSIVE-AREA-REFS>
                        <CAN-ENTER-EXCLUSIVE-AREA-REF DEST="EXCLUSIVE-AREA">/AUTOSAR_Eth_43_PFE/BswModuleDescriptions/Eth/InternalBehavior_0/ETH_EXCLUSIVE_AREA_95</CAN-ENTER-EXCLUSIVE-AREA-REF>
                        <CAN-ENTER-EXCLUSIVE-AREA-REF DEST="EXCLUSIVE-AREA">/AUTOSAR_Eth_43_PFE/BswModuleDescriptions/Eth/InternalBehavior_0/ETH_EXCLUSIVE_AREA_100</CAN-ENTER-EXCLUSIVE-AREA-REF>
                        <CAN-ENTER-EXCLUSIVE-AREA-REF DEST="EXCLUSIVE-AREA">/AUTOSAR_Eth_43_PFE/BswModuleDescriptions/Eth/InternalBehavior_0/ETH_EXCLUSIVE_AREA_101</CAN-ENTER-EXCLUSIVE-AREA-REF>
                      </CAN-ENTER-EXCLUSIVE-AREA-REFS>
                      <MINIMUM-START-INTERVAL>0.0</MINIMUM-START-INTERVAL>
                      <IMPLEMENTED-ENTRY-REF DEST="BSW-MODULE-ENTRY">/AUTOSAR_Eth_43_PFE/BswModuleEntrys/Eth_GetWdtStats</IMPLEMENTED-ENTRY-REF>
                    </BSW-CALLED-ENTITY>
                    <BSW-CALLED-ENTITY>
                      <SHORT-NAME>Eth_43_PFE_GetTmuStats</SHORT-NAME>
                      <CAN-ENTER-EXCLUSIVE-AREA-REFS>
                        <CAN-ENTER-EXCLUSIVE-AREA-REF DEST="EXCLUSIVE-AREA">/AUTOSAR_Eth_43_PFE/BswModuleDescriptions/Eth/InternalBehavior_0/ETH_EXCLUSIVE_AREA_95</CAN-ENTER-EXCLUSIVE-AREA-REF>
                        <CAN-ENTER-EXCLUSIVE-AREA-REF DEST="EXCLUSIVE-AREA">/AUTOSAR_Eth_43_PFE/BswModuleDescriptions/Eth/InternalBehavior_0/ETH_EXCLUSIVE_AREA_100</CAN-ENTER-EXCLUSIVE-AREA-REF>
                        <CAN-ENTER-EXCLUSIVE-AREA-REF DEST="EXCLUSIVE-AREA">/AUTOSAR_Eth_43_PFE/BswModuleDescriptions/Eth/InternalBehavior_0/ETH_EXCLUSIVE_AREA_101</CAN-ENTER-EXCLUSIVE-AREA-REF>
                      </CAN-ENTER-EXCLUSIVE-AREA-REFS>
                      <MINIMUM-START-INTERVAL>0.0</MINIMUM-START-INTERVAL>
                      <IMPLEMENTED-ENTRY-REF DEST="BSW-MODULE-ENTRY">/AUTOSAR_Eth_43_PFE/BswModuleEntrys/Eth_GetTmuStats</IMPLEMENTED-ENTRY-REF>
                    </BSW-CALLED-ENTITY>
                    [!ENDIF!][!//
                    [!IF "EthGeneral/EthVendorSpecific/PfeChannelBdFlushApi = 'true'"!][!//
                    <BSW-CALLED-ENTITY>
                      <SHORT-NAME>Eth_43_PFE_ChannelBdFlushRx</SHORT-NAME>
                      <CAN-ENTER-EXCLUSIVE-AREA-REFS>
                        <CAN-ENTER-EXCLUSIVE-AREA-REF DEST="EXCLUSIVE-AREA">/AUTOSAR_Eth_43_PFE/BswModuleDescriptions/Eth/InternalBehavior_0/ETH_EXCLUSIVE_AREA_22</CAN-ENTER-EXCLUSIVE-AREA-REF>
                        <CAN-ENTER-EXCLUSIVE-AREA-REF DEST="EXCLUSIVE-AREA">/AUTOSAR_Eth_43_PFE/BswModuleDescriptions/Eth/InternalBehavior_0/ETH_EXCLUSIVE_AREA_30</CAN-ENTER-EXCLUSIVE-AREA-REF>
                        <CAN-ENTER-EXCLUSIVE-AREA-REF DEST="EXCLUSIVE-AREA">/AUTOSAR_Eth_43_PFE/BswModuleDescriptions/Eth/InternalBehavior_0/ETH_EXCLUSIVE_AREA_38</CAN-ENTER-EXCLUSIVE-AREA-REF>
                        <CAN-ENTER-EXCLUSIVE-AREA-REF DEST="EXCLUSIVE-AREA">/AUTOSAR_Eth_43_PFE/BswModuleDescriptions/Eth/InternalBehavior_0/ETH_EXCLUSIVE_AREA_46</CAN-ENTER-EXCLUSIVE-AREA-REF>
                        <CAN-ENTER-EXCLUSIVE-AREA-REF DEST="EXCLUSIVE-AREA">/AUTOSAR_Eth_43_PFE/BswModuleDescriptions/Eth/InternalBehavior_0/ETH_EXCLUSIVE_AREA_48</CAN-ENTER-EXCLUSIVE-AREA-REF>
                        <CAN-ENTER-EXCLUSIVE-AREA-REF DEST="EXCLUSIVE-AREA">/AUTOSAR_Eth_43_PFE/BswModuleDescriptions/Eth/InternalBehavior_0/ETH_EXCLUSIVE_AREA_55</CAN-ENTER-EXCLUSIVE-AREA-REF>
                        <CAN-ENTER-EXCLUSIVE-AREA-REF DEST="EXCLUSIVE-AREA">/AUTOSAR_Eth_43_PFE/BswModuleDescriptions/Eth/InternalBehavior_0/ETH_EXCLUSIVE_AREA_56</CAN-ENTER-EXCLUSIVE-AREA-REF>
                        <CAN-ENTER-EXCLUSIVE-AREA-REF DEST="EXCLUSIVE-AREA">/AUTOSAR_Eth_43_PFE/BswModuleDescriptions/Eth/InternalBehavior_0/ETH_EXCLUSIVE_AREA_90</CAN-ENTER-EXCLUSIVE-AREA-REF>
                        <CAN-ENTER-EXCLUSIVE-AREA-REF DEST="EXCLUSIVE-AREA">/AUTOSAR_Eth_43_PFE/BswModuleDescriptions/Eth/InternalBehavior_0/ETH_EXCLUSIVE_AREA_91</CAN-ENTER-EXCLUSIVE-AREA-REF>
                        <CAN-ENTER-EXCLUSIVE-AREA-REF DEST="EXCLUSIVE-AREA">/AUTOSAR_Eth_43_PFE/BswModuleDescriptions/Eth/InternalBehavior_0/ETH_EXCLUSIVE_AREA_92</CAN-ENTER-EXCLUSIVE-AREA-REF>
                        <CAN-ENTER-EXCLUSIVE-AREA-REF DEST="EXCLUSIVE-AREA">/AUTOSAR_Eth_43_PFE/BswModuleDescriptions/Eth/InternalBehavior_0/ETH_EXCLUSIVE_AREA_93</CAN-ENTER-EXCLUSIVE-AREA-REF>
                        <CAN-ENTER-EXCLUSIVE-AREA-REF DEST="EXCLUSIVE-AREA">/AUTOSAR_Eth_43_PFE/BswModuleDescriptions/Eth/InternalBehavior_0/ETH_EXCLUSIVE_AREA_95</CAN-ENTER-EXCLUSIVE-AREA-REF>
                        <CAN-ENTER-EXCLUSIVE-AREA-REF DEST="EXCLUSIVE-AREA">/AUTOSAR_Eth_43_PFE/BswModuleDescriptions/Eth/InternalBehavior_0/ETH_EXCLUSIVE_AREA_100</CAN-ENTER-EXCLUSIVE-AREA-REF>
                        <CAN-ENTER-EXCLUSIVE-AREA-REF DEST="EXCLUSIVE-AREA">/AUTOSAR_Eth_43_PFE/BswModuleDescriptions/Eth/InternalBehavior_0/ETH_EXCLUSIVE_AREA_101</CAN-ENTER-EXCLUSIVE-AREA-REF>
                        <CAN-ENTER-EXCLUSIVE-AREA-REF DEST="EXCLUSIVE-AREA">/AUTOSAR_Eth_43_PFE/BswModuleDescriptions/Eth/InternalBehavior_0/ETH_EXCLUSIVE_AREA_102</CAN-ENTER-EXCLUSIVE-AREA-REF>
                      </CAN-ENTER-EXCLUSIVE-AREA-REFS>
                      <MINIMUM-START-INTERVAL>0.0</MINIMUM-START-INTERVAL>
                      <IMPLEMENTED-ENTRY-REF DEST="BSW-MODULE-ENTRY">/AUTOSAR_Eth_43_PFE/BswModuleEntrys/Eth_ChannelBdFlushRx</IMPLEMENTED-ENTRY-REF>
                    </BSW-CALLED-ENTITY>
                    [!ENDIF!][!//
                    <BSW-CALLED-ENTITY>
                      <SHORT-NAME>Eth_43_PFE_PreInit</SHORT-NAME>
                      <MINIMUM-START-INTERVAL>0.0</MINIMUM-START-INTERVAL>
                      <IMPLEMENTED-ENTRY-REF DEST="BSW-MODULE-ENTRY">/AUTOSAR_Eth_43_PFE/BswModuleEntrys/Eth_PreInit</IMPLEMENTED-ENTRY-REF>
                    </BSW-CALLED-ENTITY>
                    <BSW-CALLED-ENTITY>
                      <SHORT-NAME>Eth_43_PFE_GetPlatform</SHORT-NAME>
                      <MINIMUM-START-INTERVAL>0.0</MINIMUM-START-INTERVAL>
                      <IMPLEMENTED-ENTRY-REF DEST="BSW-MODULE-ENTRY">/AUTOSAR_Eth_43_PFE/BswModuleEntrys/Eth_GetPlatform</IMPLEMENTED-ENTRY-REF>
                    </BSW-CALLED-ENTITY>
                    <BSW-CALLED-ENTITY>
                      <SHORT-NAME>Eth_43_PFE_SetControllerMode</SHORT-NAME>
                      <CAN-ENTER-EXCLUSIVE-AREA-REFS>
                        <CAN-ENTER-EXCLUSIVE-AREA-REF DEST="EXCLUSIVE-AREA">/AUTOSAR_Eth_43_PFE/BswModuleDescriptions/Eth/InternalBehavior_0/ETH_EXCLUSIVE_AREA_01</CAN-ENTER-EXCLUSIVE-AREA-REF>
                        <CAN-ENTER-EXCLUSIVE-AREA-REF DEST="EXCLUSIVE-AREA">/AUTOSAR_Eth_43_PFE/BswModuleDescriptions/Eth/InternalBehavior_0/ETH_EXCLUSIVE_AREA_03</CAN-ENTER-EXCLUSIVE-AREA-REF>
                        <CAN-ENTER-EXCLUSIVE-AREA-REF DEST="EXCLUSIVE-AREA">/AUTOSAR_Eth_43_PFE/BswModuleDescriptions/Eth/InternalBehavior_0/ETH_EXCLUSIVE_AREA_04</CAN-ENTER-EXCLUSIVE-AREA-REF>
                        <CAN-ENTER-EXCLUSIVE-AREA-REF DEST="EXCLUSIVE-AREA">/AUTOSAR_Eth_43_PFE/BswModuleDescriptions/Eth/InternalBehavior_0/ETH_EXCLUSIVE_AREA_05</CAN-ENTER-EXCLUSIVE-AREA-REF>
                        <CAN-ENTER-EXCLUSIVE-AREA-REF DEST="EXCLUSIVE-AREA">/AUTOSAR_Eth_43_PFE/BswModuleDescriptions/Eth/InternalBehavior_0/ETH_EXCLUSIVE_AREA_07</CAN-ENTER-EXCLUSIVE-AREA-REF>
                        <CAN-ENTER-EXCLUSIVE-AREA-REF DEST="EXCLUSIVE-AREA">/AUTOSAR_Eth_43_PFE/BswModuleDescriptions/Eth/InternalBehavior_0/ETH_EXCLUSIVE_AREA_08</CAN-ENTER-EXCLUSIVE-AREA-REF>
                        <CAN-ENTER-EXCLUSIVE-AREA-REF DEST="EXCLUSIVE-AREA">/AUTOSAR_Eth_43_PFE/BswModuleDescriptions/Eth/InternalBehavior_0/ETH_EXCLUSIVE_AREA_09</CAN-ENTER-EXCLUSIVE-AREA-REF>
                        <CAN-ENTER-EXCLUSIVE-AREA-REF DEST="EXCLUSIVE-AREA">/AUTOSAR_Eth_43_PFE/BswModuleDescriptions/Eth/InternalBehavior_0/ETH_EXCLUSIVE_AREA_10</CAN-ENTER-EXCLUSIVE-AREA-REF>
                        <CAN-ENTER-EXCLUSIVE-AREA-REF DEST="EXCLUSIVE-AREA">/AUTOSAR_Eth_43_PFE/BswModuleDescriptions/Eth/InternalBehavior_0/ETH_EXCLUSIVE_AREA_13</CAN-ENTER-EXCLUSIVE-AREA-REF>
                        <CAN-ENTER-EXCLUSIVE-AREA-REF DEST="EXCLUSIVE-AREA">/AUTOSAR_Eth_43_PFE/BswModuleDescriptions/Eth/InternalBehavior_0/ETH_EXCLUSIVE_AREA_14</CAN-ENTER-EXCLUSIVE-AREA-REF>
                        <CAN-ENTER-EXCLUSIVE-AREA-REF DEST="EXCLUSIVE-AREA">/AUTOSAR_Eth_43_PFE/BswModuleDescriptions/Eth/InternalBehavior_0/ETH_EXCLUSIVE_AREA_15</CAN-ENTER-EXCLUSIVE-AREA-REF>
                        <CAN-ENTER-EXCLUSIVE-AREA-REF DEST="EXCLUSIVE-AREA">/AUTOSAR_Eth_43_PFE/BswModuleDescriptions/Eth/InternalBehavior_0/ETH_EXCLUSIVE_AREA_16</CAN-ENTER-EXCLUSIVE-AREA-REF>
                        <CAN-ENTER-EXCLUSIVE-AREA-REF DEST="EXCLUSIVE-AREA">/AUTOSAR_Eth_43_PFE/BswModuleDescriptions/Eth/InternalBehavior_0/ETH_EXCLUSIVE_AREA_18</CAN-ENTER-EXCLUSIVE-AREA-REF>
                        <CAN-ENTER-EXCLUSIVE-AREA-REF DEST="EXCLUSIVE-AREA">/AUTOSAR_Eth_43_PFE/BswModuleDescriptions/Eth/InternalBehavior_0/ETH_EXCLUSIVE_AREA_20</CAN-ENTER-EXCLUSIVE-AREA-REF>
                        <CAN-ENTER-EXCLUSIVE-AREA-REF DEST="EXCLUSIVE-AREA">/AUTOSAR_Eth_43_PFE/BswModuleDescriptions/Eth/InternalBehavior_0/ETH_EXCLUSIVE_AREA_21</CAN-ENTER-EXCLUSIVE-AREA-REF>
                        <CAN-ENTER-EXCLUSIVE-AREA-REF DEST="EXCLUSIVE-AREA">/AUTOSAR_Eth_43_PFE/BswModuleDescriptions/Eth/InternalBehavior_0/ETH_EXCLUSIVE_AREA_22</CAN-ENTER-EXCLUSIVE-AREA-REF>
                        <CAN-ENTER-EXCLUSIVE-AREA-REF DEST="EXCLUSIVE-AREA">/AUTOSAR_Eth_43_PFE/BswModuleDescriptions/Eth/InternalBehavior_0/ETH_EXCLUSIVE_AREA_23</CAN-ENTER-EXCLUSIVE-AREA-REF>
                        <CAN-ENTER-EXCLUSIVE-AREA-REF DEST="EXCLUSIVE-AREA">/AUTOSAR_Eth_43_PFE/BswModuleDescriptions/Eth/InternalBehavior_0/ETH_EXCLUSIVE_AREA_26</CAN-ENTER-EXCLUSIVE-AREA-REF>
                        <CAN-ENTER-EXCLUSIVE-AREA-REF DEST="EXCLUSIVE-AREA">/AUTOSAR_Eth_43_PFE/BswModuleDescriptions/Eth/InternalBehavior_0/ETH_EXCLUSIVE_AREA_28</CAN-ENTER-EXCLUSIVE-AREA-REF>
                        <CAN-ENTER-EXCLUSIVE-AREA-REF DEST="EXCLUSIVE-AREA">/AUTOSAR_Eth_43_PFE/BswModuleDescriptions/Eth/InternalBehavior_0/ETH_EXCLUSIVE_AREA_30</CAN-ENTER-EXCLUSIVE-AREA-REF>
                        <CAN-ENTER-EXCLUSIVE-AREA-REF DEST="EXCLUSIVE-AREA">/AUTOSAR_Eth_43_PFE/BswModuleDescriptions/Eth/InternalBehavior_0/ETH_EXCLUSIVE_AREA_31</CAN-ENTER-EXCLUSIVE-AREA-REF>
                        <CAN-ENTER-EXCLUSIVE-AREA-REF DEST="EXCLUSIVE-AREA">/AUTOSAR_Eth_43_PFE/BswModuleDescriptions/Eth/InternalBehavior_0/ETH_EXCLUSIVE_AREA_37</CAN-ENTER-EXCLUSIVE-AREA-REF>
                        <CAN-ENTER-EXCLUSIVE-AREA-REF DEST="EXCLUSIVE-AREA">/AUTOSAR_Eth_43_PFE/BswModuleDescriptions/Eth/InternalBehavior_0/ETH_EXCLUSIVE_AREA_38</CAN-ENTER-EXCLUSIVE-AREA-REF>
                        <CAN-ENTER-EXCLUSIVE-AREA-REF DEST="EXCLUSIVE-AREA">/AUTOSAR_Eth_43_PFE/BswModuleDescriptions/Eth/InternalBehavior_0/ETH_EXCLUSIVE_AREA_39</CAN-ENTER-EXCLUSIVE-AREA-REF>
                        <CAN-ENTER-EXCLUSIVE-AREA-REF DEST="EXCLUSIVE-AREA">/AUTOSAR_Eth_43_PFE/BswModuleDescriptions/Eth/InternalBehavior_0/ETH_EXCLUSIVE_AREA_40</CAN-ENTER-EXCLUSIVE-AREA-REF>
                        <CAN-ENTER-EXCLUSIVE-AREA-REF DEST="EXCLUSIVE-AREA">/AUTOSAR_Eth_43_PFE/BswModuleDescriptions/Eth/InternalBehavior_0/ETH_EXCLUSIVE_AREA_45</CAN-ENTER-EXCLUSIVE-AREA-REF>
                        <CAN-ENTER-EXCLUSIVE-AREA-REF DEST="EXCLUSIVE-AREA">/AUTOSAR_Eth_43_PFE/BswModuleDescriptions/Eth/InternalBehavior_0/ETH_EXCLUSIVE_AREA_46</CAN-ENTER-EXCLUSIVE-AREA-REF>
                        <CAN-ENTER-EXCLUSIVE-AREA-REF DEST="EXCLUSIVE-AREA">/AUTOSAR_Eth_43_PFE/BswModuleDescriptions/Eth/InternalBehavior_0/ETH_EXCLUSIVE_AREA_47</CAN-ENTER-EXCLUSIVE-AREA-REF>
                        <CAN-ENTER-EXCLUSIVE-AREA-REF DEST="EXCLUSIVE-AREA">/AUTOSAR_Eth_43_PFE/BswModuleDescriptions/Eth/InternalBehavior_0/ETH_EXCLUSIVE_AREA_48</CAN-ENTER-EXCLUSIVE-AREA-REF>
                        <CAN-ENTER-EXCLUSIVE-AREA-REF DEST="EXCLUSIVE-AREA">/AUTOSAR_Eth_43_PFE/BswModuleDescriptions/Eth/InternalBehavior_0/ETH_EXCLUSIVE_AREA_49</CAN-ENTER-EXCLUSIVE-AREA-REF>
                        <CAN-ENTER-EXCLUSIVE-AREA-REF DEST="EXCLUSIVE-AREA">/AUTOSAR_Eth_43_PFE/BswModuleDescriptions/Eth/InternalBehavior_0/ETH_EXCLUSIVE_AREA_50</CAN-ENTER-EXCLUSIVE-AREA-REF>
                        <CAN-ENTER-EXCLUSIVE-AREA-REF DEST="EXCLUSIVE-AREA">/AUTOSAR_Eth_43_PFE/BswModuleDescriptions/Eth/InternalBehavior_0/ETH_EXCLUSIVE_AREA_51</CAN-ENTER-EXCLUSIVE-AREA-REF>
                        <CAN-ENTER-EXCLUSIVE-AREA-REF DEST="EXCLUSIVE-AREA">/AUTOSAR_Eth_43_PFE/BswModuleDescriptions/Eth/InternalBehavior_0/ETH_EXCLUSIVE_AREA_52</CAN-ENTER-EXCLUSIVE-AREA-REF>
                        <CAN-ENTER-EXCLUSIVE-AREA-REF DEST="EXCLUSIVE-AREA">/AUTOSAR_Eth_43_PFE/BswModuleDescriptions/Eth/InternalBehavior_0/ETH_EXCLUSIVE_AREA_54</CAN-ENTER-EXCLUSIVE-AREA-REF>
                        <CAN-ENTER-EXCLUSIVE-AREA-REF DEST="EXCLUSIVE-AREA">/AUTOSAR_Eth_43_PFE/BswModuleDescriptions/Eth/InternalBehavior_0/ETH_EXCLUSIVE_AREA_55</CAN-ENTER-EXCLUSIVE-AREA-REF>
                        <CAN-ENTER-EXCLUSIVE-AREA-REF DEST="EXCLUSIVE-AREA">/AUTOSAR_Eth_43_PFE/BswModuleDescriptions/Eth/InternalBehavior_0/ETH_EXCLUSIVE_AREA_56</CAN-ENTER-EXCLUSIVE-AREA-REF>
                        <CAN-ENTER-EXCLUSIVE-AREA-REF DEST="EXCLUSIVE-AREA">/AUTOSAR_Eth_43_PFE/BswModuleDescriptions/Eth/InternalBehavior_0/ETH_EXCLUSIVE_AREA_57</CAN-ENTER-EXCLUSIVE-AREA-REF>
                        <CAN-ENTER-EXCLUSIVE-AREA-REF DEST="EXCLUSIVE-AREA">/AUTOSAR_Eth_43_PFE/BswModuleDescriptions/Eth/InternalBehavior_0/ETH_EXCLUSIVE_AREA_58</CAN-ENTER-EXCLUSIVE-AREA-REF>
                        <CAN-ENTER-EXCLUSIVE-AREA-REF DEST="EXCLUSIVE-AREA">/AUTOSAR_Eth_43_PFE/BswModuleDescriptions/Eth/InternalBehavior_0/ETH_EXCLUSIVE_AREA_59</CAN-ENTER-EXCLUSIVE-AREA-REF>
                        <CAN-ENTER-EXCLUSIVE-AREA-REF DEST="EXCLUSIVE-AREA">/AUTOSAR_Eth_43_PFE/BswModuleDescriptions/Eth/InternalBehavior_0/ETH_EXCLUSIVE_AREA_60</CAN-ENTER-EXCLUSIVE-AREA-REF>
                        <CAN-ENTER-EXCLUSIVE-AREA-REF DEST="EXCLUSIVE-AREA">/AUTOSAR_Eth_43_PFE/BswModuleDescriptions/Eth/InternalBehavior_0/ETH_EXCLUSIVE_AREA_65</CAN-ENTER-EXCLUSIVE-AREA-REF>
                        <CAN-ENTER-EXCLUSIVE-AREA-REF DEST="EXCLUSIVE-AREA">/AUTOSAR_Eth_43_PFE/BswModuleDescriptions/Eth/InternalBehavior_0/ETH_EXCLUSIVE_AREA_66</CAN-ENTER-EXCLUSIVE-AREA-REF>
                        <CAN-ENTER-EXCLUSIVE-AREA-REF DEST="EXCLUSIVE-AREA">/AUTOSAR_Eth_43_PFE/BswModuleDescriptions/Eth/InternalBehavior_0/ETH_EXCLUSIVE_AREA_67</CAN-ENTER-EXCLUSIVE-AREA-REF>
                        <CAN-ENTER-EXCLUSIVE-AREA-REF DEST="EXCLUSIVE-AREA">/AUTOSAR_Eth_43_PFE/BswModuleDescriptions/Eth/InternalBehavior_0/ETH_EXCLUSIVE_AREA_68</CAN-ENTER-EXCLUSIVE-AREA-REF>
                        <CAN-ENTER-EXCLUSIVE-AREA-REF DEST="EXCLUSIVE-AREA">/AUTOSAR_Eth_43_PFE/BswModuleDescriptions/Eth/InternalBehavior_0/ETH_EXCLUSIVE_AREA_69</CAN-ENTER-EXCLUSIVE-AREA-REF>
                        <CAN-ENTER-EXCLUSIVE-AREA-REF DEST="EXCLUSIVE-AREA">/AUTOSAR_Eth_43_PFE/BswModuleDescriptions/Eth/InternalBehavior_0/ETH_EXCLUSIVE_AREA_70</CAN-ENTER-EXCLUSIVE-AREA-REF>
                        <CAN-ENTER-EXCLUSIVE-AREA-REF DEST="EXCLUSIVE-AREA">/AUTOSAR_Eth_43_PFE/BswModuleDescriptions/Eth/InternalBehavior_0/ETH_EXCLUSIVE_AREA_71</CAN-ENTER-EXCLUSIVE-AREA-REF>
                        <CAN-ENTER-EXCLUSIVE-AREA-REF DEST="EXCLUSIVE-AREA">/AUTOSAR_Eth_43_PFE/BswModuleDescriptions/Eth/InternalBehavior_0/ETH_EXCLUSIVE_AREA_72</CAN-ENTER-EXCLUSIVE-AREA-REF>
                        <CAN-ENTER-EXCLUSIVE-AREA-REF DEST="EXCLUSIVE-AREA">/AUTOSAR_Eth_43_PFE/BswModuleDescriptions/Eth/InternalBehavior_0/ETH_EXCLUSIVE_AREA_73</CAN-ENTER-EXCLUSIVE-AREA-REF>
                        <CAN-ENTER-EXCLUSIVE-AREA-REF DEST="EXCLUSIVE-AREA">/AUTOSAR_Eth_43_PFE/BswModuleDescriptions/Eth/InternalBehavior_0/ETH_EXCLUSIVE_AREA_74</CAN-ENTER-EXCLUSIVE-AREA-REF>
                        <CAN-ENTER-EXCLUSIVE-AREA-REF DEST="EXCLUSIVE-AREA">/AUTOSAR_Eth_43_PFE/BswModuleDescriptions/Eth/InternalBehavior_0/ETH_EXCLUSIVE_AREA_77</CAN-ENTER-EXCLUSIVE-AREA-REF>
                        <CAN-ENTER-EXCLUSIVE-AREA-REF DEST="EXCLUSIVE-AREA">/AUTOSAR_Eth_43_PFE/BswModuleDescriptions/Eth/InternalBehavior_0/ETH_EXCLUSIVE_AREA_78</CAN-ENTER-EXCLUSIVE-AREA-REF>
                        <CAN-ENTER-EXCLUSIVE-AREA-REF DEST="EXCLUSIVE-AREA">/AUTOSAR_Eth_43_PFE/BswModuleDescriptions/Eth/InternalBehavior_0/ETH_EXCLUSIVE_AREA_79</CAN-ENTER-EXCLUSIVE-AREA-REF>
                        <CAN-ENTER-EXCLUSIVE-AREA-REF DEST="EXCLUSIVE-AREA">/AUTOSAR_Eth_43_PFE/BswModuleDescriptions/Eth/InternalBehavior_0/ETH_EXCLUSIVE_AREA_81</CAN-ENTER-EXCLUSIVE-AREA-REF>
                        <CAN-ENTER-EXCLUSIVE-AREA-REF DEST="EXCLUSIVE-AREA">/AUTOSAR_Eth_43_PFE/BswModuleDescriptions/Eth/InternalBehavior_0/ETH_EXCLUSIVE_AREA_82</CAN-ENTER-EXCLUSIVE-AREA-REF>
                        <CAN-ENTER-EXCLUSIVE-AREA-REF DEST="EXCLUSIVE-AREA">/AUTOSAR_Eth_43_PFE/BswModuleDescriptions/Eth/InternalBehavior_0/ETH_EXCLUSIVE_AREA_85</CAN-ENTER-EXCLUSIVE-AREA-REF>
                        <CAN-ENTER-EXCLUSIVE-AREA-REF DEST="EXCLUSIVE-AREA">/AUTOSAR_Eth_43_PFE/BswModuleDescriptions/Eth/InternalBehavior_0/ETH_EXCLUSIVE_AREA_86</CAN-ENTER-EXCLUSIVE-AREA-REF>
                        <CAN-ENTER-EXCLUSIVE-AREA-REF DEST="EXCLUSIVE-AREA">/AUTOSAR_Eth_43_PFE/BswModuleDescriptions/Eth/InternalBehavior_0/ETH_EXCLUSIVE_AREA_88</CAN-ENTER-EXCLUSIVE-AREA-REF>
                        <CAN-ENTER-EXCLUSIVE-AREA-REF DEST="EXCLUSIVE-AREA">/AUTOSAR_Eth_43_PFE/BswModuleDescriptions/Eth/InternalBehavior_0/ETH_EXCLUSIVE_AREA_89</CAN-ENTER-EXCLUSIVE-AREA-REF>
                        <CAN-ENTER-EXCLUSIVE-AREA-REF DEST="EXCLUSIVE-AREA">/AUTOSAR_Eth_43_PFE/BswModuleDescriptions/Eth/InternalBehavior_0/ETH_EXCLUSIVE_AREA_90</CAN-ENTER-EXCLUSIVE-AREA-REF>
                        <CAN-ENTER-EXCLUSIVE-AREA-REF DEST="EXCLUSIVE-AREA">/AUTOSAR_Eth_43_PFE/BswModuleDescriptions/Eth/InternalBehavior_0/ETH_EXCLUSIVE_AREA_91</CAN-ENTER-EXCLUSIVE-AREA-REF>
                        <CAN-ENTER-EXCLUSIVE-AREA-REF DEST="EXCLUSIVE-AREA">/AUTOSAR_Eth_43_PFE/BswModuleDescriptions/Eth/InternalBehavior_0/ETH_EXCLUSIVE_AREA_92</CAN-ENTER-EXCLUSIVE-AREA-REF>
                        <CAN-ENTER-EXCLUSIVE-AREA-REF DEST="EXCLUSIVE-AREA">/AUTOSAR_Eth_43_PFE/BswModuleDescriptions/Eth/InternalBehavior_0/ETH_EXCLUSIVE_AREA_93</CAN-ENTER-EXCLUSIVE-AREA-REF>
                        <CAN-ENTER-EXCLUSIVE-AREA-REF DEST="EXCLUSIVE-AREA">/AUTOSAR_Eth_43_PFE/BswModuleDescriptions/Eth/InternalBehavior_0/ETH_EXCLUSIVE_AREA_94</CAN-ENTER-EXCLUSIVE-AREA-REF>
                        <CAN-ENTER-EXCLUSIVE-AREA-REF DEST="EXCLUSIVE-AREA">/AUTOSAR_Eth_43_PFE/BswModuleDescriptions/Eth/InternalBehavior_0/ETH_EXCLUSIVE_AREA_95</CAN-ENTER-EXCLUSIVE-AREA-REF>
                        <CAN-ENTER-EXCLUSIVE-AREA-REF DEST="EXCLUSIVE-AREA">/AUTOSAR_Eth_43_PFE/BswModuleDescriptions/Eth/InternalBehavior_0/ETH_EXCLUSIVE_AREA_97</CAN-ENTER-EXCLUSIVE-AREA-REF>
                        <CAN-ENTER-EXCLUSIVE-AREA-REF DEST="EXCLUSIVE-AREA">/AUTOSAR_Eth_43_PFE/BswModuleDescriptions/Eth/InternalBehavior_0/ETH_EXCLUSIVE_AREA_99</CAN-ENTER-EXCLUSIVE-AREA-REF>
                        <CAN-ENTER-EXCLUSIVE-AREA-REF DEST="EXCLUSIVE-AREA">/AUTOSAR_Eth_43_PFE/BswModuleDescriptions/Eth/InternalBehavior_0/ETH_EXCLUSIVE_AREA_100</CAN-ENTER-EXCLUSIVE-AREA-REF>
                        <CAN-ENTER-EXCLUSIVE-AREA-REF DEST="EXCLUSIVE-AREA">/AUTOSAR_Eth_43_PFE/BswModuleDescriptions/Eth/InternalBehavior_0/ETH_EXCLUSIVE_AREA_101</CAN-ENTER-EXCLUSIVE-AREA-REF>
                        <CAN-ENTER-EXCLUSIVE-AREA-REF DEST="EXCLUSIVE-AREA">/AUTOSAR_Eth_43_PFE/BswModuleDescriptions/Eth/InternalBehavior_0/ETH_EXCLUSIVE_AREA_102</CAN-ENTER-EXCLUSIVE-AREA-REF>
                        <CAN-ENTER-EXCLUSIVE-AREA-REF DEST="EXCLUSIVE-AREA">/AUTOSAR_Eth_43_PFE/BswModuleDescriptions/Eth/InternalBehavior_0/ETH_EXCLUSIVE_AREA_103</CAN-ENTER-EXCLUSIVE-AREA-REF>
                        <CAN-ENTER-EXCLUSIVE-AREA-REF DEST="EXCLUSIVE-AREA">/AUTOSAR_Eth_43_PFE/BswModuleDescriptions/Eth/InternalBehavior_0/ETH_EXCLUSIVE_AREA_104</CAN-ENTER-EXCLUSIVE-AREA-REF>
                      </CAN-ENTER-EXCLUSIVE-AREA-REFS>
                      <MINIMUM-START-INTERVAL>0.0</MINIMUM-START-INTERVAL>
                      <IMPLEMENTED-ENTRY-REF DEST="BSW-MODULE-ENTRY">/AUTOSAR_Eth_43_PFE/BswModuleEntrys/Eth_SetControllerMode</IMPLEMENTED-ENTRY-REF>
                    </BSW-CALLED-ENTITY>
                    <BSW-CALLED-ENTITY>
                      <SHORT-NAME>Eth_43_PFE_GetControllerMode</SHORT-NAME>
                      <MINIMUM-START-INTERVAL>0.0</MINIMUM-START-INTERVAL>
                      <IMPLEMENTED-ENTRY-REF DEST="BSW-MODULE-ENTRY">/AUTOSAR_Eth_43_PFE/BswModuleEntrys/Eth_GetControllerMode</IMPLEMENTED-ENTRY-REF>
                    </BSW-CALLED-ENTITY>
                    <BSW-CALLED-ENTITY>
                      <SHORT-NAME>Eth_43_PFE_GetPhysAddr</SHORT-NAME>
                      <MINIMUM-START-INTERVAL>0.0</MINIMUM-START-INTERVAL>
                      <IMPLEMENTED-ENTRY-REF DEST="BSW-MODULE-ENTRY">/AUTOSAR_Eth_43_PFE/BswModuleEntrys/Eth_GetPhysAddr</IMPLEMENTED-ENTRY-REF>
                    </BSW-CALLED-ENTITY>
                    <BSW-CALLED-ENTITY>
                      <SHORT-NAME>Eth_43_PFE_SetPhysAddr</SHORT-NAME>
                      <CAN-ENTER-EXCLUSIVE-AREA-REFS>
                        <CAN-ENTER-EXCLUSIVE-AREA-REF DEST="EXCLUSIVE-AREA">/AUTOSAR_Eth_43_PFE/BswModuleDescriptions/Eth/InternalBehavior_0/ETH_EXCLUSIVE_AREA_18</CAN-ENTER-EXCLUSIVE-AREA-REF>
                        <CAN-ENTER-EXCLUSIVE-AREA-REF DEST="EXCLUSIVE-AREA">/AUTOSAR_Eth_43_PFE/BswModuleDescriptions/Eth/InternalBehavior_0/ETH_EXCLUSIVE_AREA_20</CAN-ENTER-EXCLUSIVE-AREA-REF>
                        <CAN-ENTER-EXCLUSIVE-AREA-REF DEST="EXCLUSIVE-AREA">/AUTOSAR_Eth_43_PFE/BswModuleDescriptions/Eth/InternalBehavior_0/ETH_EXCLUSIVE_AREA_21</CAN-ENTER-EXCLUSIVE-AREA-REF>
                        <CAN-ENTER-EXCLUSIVE-AREA-REF DEST="EXCLUSIVE-AREA">/AUTOSAR_Eth_43_PFE/BswModuleDescriptions/Eth/InternalBehavior_0/ETH_EXCLUSIVE_AREA_38</CAN-ENTER-EXCLUSIVE-AREA-REF>
                        <CAN-ENTER-EXCLUSIVE-AREA-REF DEST="EXCLUSIVE-AREA">/AUTOSAR_Eth_43_PFE/BswModuleDescriptions/Eth/InternalBehavior_0/ETH_EXCLUSIVE_AREA_39</CAN-ENTER-EXCLUSIVE-AREA-REF>
                        <CAN-ENTER-EXCLUSIVE-AREA-REF DEST="EXCLUSIVE-AREA">/AUTOSAR_Eth_43_PFE/BswModuleDescriptions/Eth/InternalBehavior_0/ETH_EXCLUSIVE_AREA_40</CAN-ENTER-EXCLUSIVE-AREA-REF>
                        <CAN-ENTER-EXCLUSIVE-AREA-REF DEST="EXCLUSIVE-AREA">/AUTOSAR_Eth_43_PFE/BswModuleDescriptions/Eth/InternalBehavior_0/ETH_EXCLUSIVE_AREA_54</CAN-ENTER-EXCLUSIVE-AREA-REF>
                        <CAN-ENTER-EXCLUSIVE-AREA-REF DEST="EXCLUSIVE-AREA">/AUTOSAR_Eth_43_PFE/BswModuleDescriptions/Eth/InternalBehavior_0/ETH_EXCLUSIVE_AREA_58</CAN-ENTER-EXCLUSIVE-AREA-REF>
                        <CAN-ENTER-EXCLUSIVE-AREA-REF DEST="EXCLUSIVE-AREA">/AUTOSAR_Eth_43_PFE/BswModuleDescriptions/Eth/InternalBehavior_0/ETH_EXCLUSIVE_AREA_59</CAN-ENTER-EXCLUSIVE-AREA-REF>
                        <CAN-ENTER-EXCLUSIVE-AREA-REF DEST="EXCLUSIVE-AREA">/AUTOSAR_Eth_43_PFE/BswModuleDescriptions/Eth/InternalBehavior_0/ETH_EXCLUSIVE_AREA_91</CAN-ENTER-EXCLUSIVE-AREA-REF>
                        <CAN-ENTER-EXCLUSIVE-AREA-REF DEST="EXCLUSIVE-AREA">/AUTOSAR_Eth_43_PFE/BswModuleDescriptions/Eth/InternalBehavior_0/ETH_EXCLUSIVE_AREA_92</CAN-ENTER-EXCLUSIVE-AREA-REF>
                        <CAN-ENTER-EXCLUSIVE-AREA-REF DEST="EXCLUSIVE-AREA">/AUTOSAR_Eth_43_PFE/BswModuleDescriptions/Eth/InternalBehavior_0/ETH_EXCLUSIVE_AREA_93</CAN-ENTER-EXCLUSIVE-AREA-REF>
                        <CAN-ENTER-EXCLUSIVE-AREA-REF DEST="EXCLUSIVE-AREA">/AUTOSAR_Eth_43_PFE/BswModuleDescriptions/Eth/InternalBehavior_0/ETH_EXCLUSIVE_AREA_95</CAN-ENTER-EXCLUSIVE-AREA-REF>
                        <CAN-ENTER-EXCLUSIVE-AREA-REF DEST="EXCLUSIVE-AREA">/AUTOSAR_Eth_43_PFE/BswModuleDescriptions/Eth/InternalBehavior_0/ETH_EXCLUSIVE_AREA_100</CAN-ENTER-EXCLUSIVE-AREA-REF>
                        <CAN-ENTER-EXCLUSIVE-AREA-REF DEST="EXCLUSIVE-AREA">/AUTOSAR_Eth_43_PFE/BswModuleDescriptions/Eth/InternalBehavior_0/ETH_EXCLUSIVE_AREA_101</CAN-ENTER-EXCLUSIVE-AREA-REF>
                      </CAN-ENTER-EXCLUSIVE-AREA-REFS>
                      <MINIMUM-START-INTERVAL>0.0</MINIMUM-START-INTERVAL>
                      <IMPLEMENTED-ENTRY-REF DEST="BSW-MODULE-ENTRY">/AUTOSAR_Eth_43_PFE/BswModuleEntrys/Eth_SetPhysAddr</IMPLEMENTED-ENTRY-REF>
                    </BSW-CALLED-ENTITY>
                    <BSW-CALLED-ENTITY>
                      <SHORT-NAME>Eth_43_PFE_ProvideTxBuffer</SHORT-NAME>
                      <CAN-ENTER-EXCLUSIVE-AREA-REFS>
                        <CAN-ENTER-EXCLUSIVE-AREA-REF DEST="EXCLUSIVE-AREA">/AUTOSAR_Eth_43_PFE/BswModuleDescriptions/Eth/InternalBehavior_0/ETH_EXCLUSIVE_AREA_19</CAN-ENTER-EXCLUSIVE-AREA-REF>
                        <CAN-ENTER-EXCLUSIVE-AREA-REF DEST="EXCLUSIVE-AREA">/AUTOSAR_Eth_43_PFE/BswModuleDescriptions/Eth/InternalBehavior_0/ETH_EXCLUSIVE_AREA_55</CAN-ENTER-EXCLUSIVE-AREA-REF>
                        <CAN-ENTER-EXCLUSIVE-AREA-REF DEST="EXCLUSIVE-AREA">/AUTOSAR_Eth_43_PFE/BswModuleDescriptions/Eth/InternalBehavior_0/ETH_EXCLUSIVE_AREA_95</CAN-ENTER-EXCLUSIVE-AREA-REF>
                        <CAN-ENTER-EXCLUSIVE-AREA-REF DEST="EXCLUSIVE-AREA">/AUTOSAR_Eth_43_PFE/BswModuleDescriptions/Eth/InternalBehavior_0/ETH_EXCLUSIVE_AREA_100</CAN-ENTER-EXCLUSIVE-AREA-REF>
                        <CAN-ENTER-EXCLUSIVE-AREA-REF DEST="EXCLUSIVE-AREA">/AUTOSAR_Eth_43_PFE/BswModuleDescriptions/Eth/InternalBehavior_0/ETH_EXCLUSIVE_AREA_101</CAN-ENTER-EXCLUSIVE-AREA-REF>
                      </CAN-ENTER-EXCLUSIVE-AREA-REFS>
                      <MINIMUM-START-INTERVAL>0.0</MINIMUM-START-INTERVAL>
                      <IMPLEMENTED-ENTRY-REF DEST="BSW-MODULE-ENTRY">/AUTOSAR_Eth_43_PFE/BswModuleEntrys/Eth_ProvideTxBuffer</IMPLEMENTED-ENTRY-REF>
                    </BSW-CALLED-ENTITY>
                    [!IF "EthGeneral/EthVendorSpecific/EthReleaseTxBufferApi = 'true'"!][!//
                    <BSW-CALLED-ENTITY>
                      <SHORT-NAME>Eth_43_PFE_ReleaseTxBuffer</SHORT-NAME>
                      <CAN-ENTER-EXCLUSIVE-AREA-REFS>
                        <CAN-ENTER-EXCLUSIVE-AREA-REF DEST="EXCLUSIVE-AREA">/AUTOSAR_Eth_43_PFE/BswModuleDescriptions/Eth/InternalBehavior_0/ETH_EXCLUSIVE_AREA_56</CAN-ENTER-EXCLUSIVE-AREA-REF>
                        <CAN-ENTER-EXCLUSIVE-AREA-REF DEST="EXCLUSIVE-AREA">/AUTOSAR_Eth_43_PFE/BswModuleDescriptions/Eth/InternalBehavior_0/ETH_EXCLUSIVE_AREA_95</CAN-ENTER-EXCLUSIVE-AREA-REF>
                        <CAN-ENTER-EXCLUSIVE-AREA-REF DEST="EXCLUSIVE-AREA">/AUTOSAR_Eth_43_PFE/BswModuleDescriptions/Eth/InternalBehavior_0/ETH_EXCLUSIVE_AREA_100</CAN-ENTER-EXCLUSIVE-AREA-REF>
                        <CAN-ENTER-EXCLUSIVE-AREA-REF DEST="EXCLUSIVE-AREA">/AUTOSAR_Eth_43_PFE/BswModuleDescriptions/Eth/InternalBehavior_0/ETH_EXCLUSIVE_AREA_101</CAN-ENTER-EXCLUSIVE-AREA-REF>
                      </CAN-ENTER-EXCLUSIVE-AREA-REFS>
                      <MINIMUM-START-INTERVAL>0.0</MINIMUM-START-INTERVAL>
                      <IMPLEMENTED-ENTRY-REF DEST="BSW-MODULE-ENTRY">/AUTOSAR_Eth_43_PFE/BswModuleEntrys/Eth_ReleaseTxBuffer</IMPLEMENTED-ENTRY-REF>
                    </BSW-CALLED-ENTITY>
                    [!ENDIF!][!//
                    <BSW-CALLED-ENTITY>
                      <SHORT-NAME>Eth_43_PFE_UpdatePhysAddrFilter</SHORT-NAME>
                      <CAN-ENTER-EXCLUSIVE-AREA-REFS>
                        <CAN-ENTER-EXCLUSIVE-AREA-REF DEST="EXCLUSIVE-AREA">/AUTOSAR_Eth_43_PFE/BswModuleDescriptions/Eth/InternalBehavior_0/ETH_EXCLUSIVE_AREA_18</CAN-ENTER-EXCLUSIVE-AREA-REF>
                        <CAN-ENTER-EXCLUSIVE-AREA-REF DEST="EXCLUSIVE-AREA">/AUTOSAR_Eth_43_PFE/BswModuleDescriptions/Eth/InternalBehavior_0/ETH_EXCLUSIVE_AREA_20</CAN-ENTER-EXCLUSIVE-AREA-REF>
                        <CAN-ENTER-EXCLUSIVE-AREA-REF DEST="EXCLUSIVE-AREA">/AUTOSAR_Eth_43_PFE/BswModuleDescriptions/Eth/InternalBehavior_0/ETH_EXCLUSIVE_AREA_21</CAN-ENTER-EXCLUSIVE-AREA-REF>
                        <CAN-ENTER-EXCLUSIVE-AREA-REF DEST="EXCLUSIVE-AREA">/AUTOSAR_Eth_43_PFE/BswModuleDescriptions/Eth/InternalBehavior_0/ETH_EXCLUSIVE_AREA_38</CAN-ENTER-EXCLUSIVE-AREA-REF>
                        <CAN-ENTER-EXCLUSIVE-AREA-REF DEST="EXCLUSIVE-AREA">/AUTOSAR_Eth_43_PFE/BswModuleDescriptions/Eth/InternalBehavior_0/ETH_EXCLUSIVE_AREA_39</CAN-ENTER-EXCLUSIVE-AREA-REF>
                        <CAN-ENTER-EXCLUSIVE-AREA-REF DEST="EXCLUSIVE-AREA">/AUTOSAR_Eth_43_PFE/BswModuleDescriptions/Eth/InternalBehavior_0/ETH_EXCLUSIVE_AREA_40</CAN-ENTER-EXCLUSIVE-AREA-REF>
                        <CAN-ENTER-EXCLUSIVE-AREA-REF DEST="EXCLUSIVE-AREA">/AUTOSAR_Eth_43_PFE/BswModuleDescriptions/Eth/InternalBehavior_0/ETH_EXCLUSIVE_AREA_54</CAN-ENTER-EXCLUSIVE-AREA-REF>
                        <CAN-ENTER-EXCLUSIVE-AREA-REF DEST="EXCLUSIVE-AREA">/AUTOSAR_Eth_43_PFE/BswModuleDescriptions/Eth/InternalBehavior_0/ETH_EXCLUSIVE_AREA_57</CAN-ENTER-EXCLUSIVE-AREA-REF>
                        <CAN-ENTER-EXCLUSIVE-AREA-REF DEST="EXCLUSIVE-AREA">/AUTOSAR_Eth_43_PFE/BswModuleDescriptions/Eth/InternalBehavior_0/ETH_EXCLUSIVE_AREA_58</CAN-ENTER-EXCLUSIVE-AREA-REF>
                        <CAN-ENTER-EXCLUSIVE-AREA-REF DEST="EXCLUSIVE-AREA">/AUTOSAR_Eth_43_PFE/BswModuleDescriptions/Eth/InternalBehavior_0/ETH_EXCLUSIVE_AREA_59</CAN-ENTER-EXCLUSIVE-AREA-REF>
                        <CAN-ENTER-EXCLUSIVE-AREA-REF DEST="EXCLUSIVE-AREA">/AUTOSAR_Eth_43_PFE/BswModuleDescriptions/Eth/InternalBehavior_0/ETH_EXCLUSIVE_AREA_91</CAN-ENTER-EXCLUSIVE-AREA-REF>
                        <CAN-ENTER-EXCLUSIVE-AREA-REF DEST="EXCLUSIVE-AREA">/AUTOSAR_Eth_43_PFE/BswModuleDescriptions/Eth/InternalBehavior_0/ETH_EXCLUSIVE_AREA_92</CAN-ENTER-EXCLUSIVE-AREA-REF>
                        <CAN-ENTER-EXCLUSIVE-AREA-REF DEST="EXCLUSIVE-AREA">/AUTOSAR_Eth_43_PFE/BswModuleDescriptions/Eth/InternalBehavior_0/ETH_EXCLUSIVE_AREA_93</CAN-ENTER-EXCLUSIVE-AREA-REF>
                        <CAN-ENTER-EXCLUSIVE-AREA-REF DEST="EXCLUSIVE-AREA">/AUTOSAR_Eth_43_PFE/BswModuleDescriptions/Eth/InternalBehavior_0/ETH_EXCLUSIVE_AREA_95</CAN-ENTER-EXCLUSIVE-AREA-REF>
                        <CAN-ENTER-EXCLUSIVE-AREA-REF DEST="EXCLUSIVE-AREA">/AUTOSAR_Eth_43_PFE/BswModuleDescriptions/Eth/InternalBehavior_0/ETH_EXCLUSIVE_AREA_100</CAN-ENTER-EXCLUSIVE-AREA-REF>
                        <CAN-ENTER-EXCLUSIVE-AREA-REF DEST="EXCLUSIVE-AREA">/AUTOSAR_Eth_43_PFE/BswModuleDescriptions/Eth/InternalBehavior_0/ETH_EXCLUSIVE_AREA_101</CAN-ENTER-EXCLUSIVE-AREA-REF>
                      </CAN-ENTER-EXCLUSIVE-AREA-REFS>
                      <MINIMUM-START-INTERVAL>0.0</MINIMUM-START-INTERVAL>
                      <IMPLEMENTED-ENTRY-REF DEST="BSW-MODULE-ENTRY">/AUTOSAR_Eth_43_PFE/BswModuleEntrys/Eth_UpdatePhysAddrFilter</IMPLEMENTED-ENTRY-REF>
                    </BSW-CALLED-ENTITY>
                    <BSW-CALLED-ENTITY>
                      <SHORT-NAME>Eth_43_PFE_Transmit</SHORT-NAME>
                      <CAN-ENTER-EXCLUSIVE-AREA-REFS>
                        <CAN-ENTER-EXCLUSIVE-AREA-REF DEST="EXCLUSIVE-AREA">/AUTOSAR_Eth_43_PFE/BswModuleDescriptions/Eth/InternalBehavior_0/ETH_EXCLUSIVE_AREA_17</CAN-ENTER-EXCLUSIVE-AREA-REF>
                        <CAN-ENTER-EXCLUSIVE-AREA-REF DEST="EXCLUSIVE-AREA">/AUTOSAR_Eth_43_PFE/BswModuleDescriptions/Eth/InternalBehavior_0/ETH_EXCLUSIVE_AREA_38</CAN-ENTER-EXCLUSIVE-AREA-REF>
                        <CAN-ENTER-EXCLUSIVE-AREA-REF DEST="EXCLUSIVE-AREA">/AUTOSAR_Eth_43_PFE/BswModuleDescriptions/Eth/InternalBehavior_0/ETH_EXCLUSIVE_AREA_42</CAN-ENTER-EXCLUSIVE-AREA-REF>
                        <CAN-ENTER-EXCLUSIVE-AREA-REF DEST="EXCLUSIVE-AREA">/AUTOSAR_Eth_43_PFE/BswModuleDescriptions/Eth/InternalBehavior_0/ETH_EXCLUSIVE_AREA_43</CAN-ENTER-EXCLUSIVE-AREA-REF>
                        <CAN-ENTER-EXCLUSIVE-AREA-REF DEST="EXCLUSIVE-AREA">/AUTOSAR_Eth_43_PFE/BswModuleDescriptions/Eth/InternalBehavior_0/ETH_EXCLUSIVE_AREA_56</CAN-ENTER-EXCLUSIVE-AREA-REF>
                        <CAN-ENTER-EXCLUSIVE-AREA-REF DEST="EXCLUSIVE-AREA">/AUTOSAR_Eth_43_PFE/BswModuleDescriptions/Eth/InternalBehavior_0/ETH_EXCLUSIVE_AREA_92</CAN-ENTER-EXCLUSIVE-AREA-REF>
                        <CAN-ENTER-EXCLUSIVE-AREA-REF DEST="EXCLUSIVE-AREA">/AUTOSAR_Eth_43_PFE/BswModuleDescriptions/Eth/InternalBehavior_0/ETH_EXCLUSIVE_AREA_93</CAN-ENTER-EXCLUSIVE-AREA-REF>
                        <CAN-ENTER-EXCLUSIVE-AREA-REF DEST="EXCLUSIVE-AREA">/AUTOSAR_Eth_43_PFE/BswModuleDescriptions/Eth/InternalBehavior_0/ETH_EXCLUSIVE_AREA_95</CAN-ENTER-EXCLUSIVE-AREA-REF>
                        <CAN-ENTER-EXCLUSIVE-AREA-REF DEST="EXCLUSIVE-AREA">/AUTOSAR_Eth_43_PFE/BswModuleDescriptions/Eth/InternalBehavior_0/ETH_EXCLUSIVE_AREA_100</CAN-ENTER-EXCLUSIVE-AREA-REF>
                        <CAN-ENTER-EXCLUSIVE-AREA-REF DEST="EXCLUSIVE-AREA">/AUTOSAR_Eth_43_PFE/BswModuleDescriptions/Eth/InternalBehavior_0/ETH_EXCLUSIVE_AREA_101</CAN-ENTER-EXCLUSIVE-AREA-REF>
                      </CAN-ENTER-EXCLUSIVE-AREA-REFS>
                      <MINIMUM-START-INTERVAL>0.0</MINIMUM-START-INTERVAL>
                      <IMPLEMENTED-ENTRY-REF DEST="BSW-MODULE-ENTRY">/AUTOSAR_Eth_43_PFE/BswModuleEntrys/Eth_Transmit</IMPLEMENTED-ENTRY-REF>
                    </BSW-CALLED-ENTITY>
                    <BSW-CALLED-ENTITY>
                      <SHORT-NAME>Eth_43_PFE_Receive</SHORT-NAME>
                      <CAN-ENTER-EXCLUSIVE-AREA-REFS>
                        <CAN-ENTER-EXCLUSIVE-AREA-REF DEST="EXCLUSIVE-AREA">/AUTOSAR_Eth_43_PFE/BswModuleDescriptions/Eth/InternalBehavior_0/ETH_EXCLUSIVE_AREA_01</CAN-ENTER-EXCLUSIVE-AREA-REF>
                        <CAN-ENTER-EXCLUSIVE-AREA-REF DEST="EXCLUSIVE-AREA">/AUTOSAR_Eth_43_PFE/BswModuleDescriptions/Eth/InternalBehavior_0/ETH_EXCLUSIVE_AREA_03</CAN-ENTER-EXCLUSIVE-AREA-REF>
                        <CAN-ENTER-EXCLUSIVE-AREA-REF DEST="EXCLUSIVE-AREA">/AUTOSAR_Eth_43_PFE/BswModuleDescriptions/Eth/InternalBehavior_0/ETH_EXCLUSIVE_AREA_04</CAN-ENTER-EXCLUSIVE-AREA-REF>
                        <CAN-ENTER-EXCLUSIVE-AREA-REF DEST="EXCLUSIVE-AREA">/AUTOSAR_Eth_43_PFE/BswModuleDescriptions/Eth/InternalBehavior_0/ETH_EXCLUSIVE_AREA_05</CAN-ENTER-EXCLUSIVE-AREA-REF>
                        <CAN-ENTER-EXCLUSIVE-AREA-REF DEST="EXCLUSIVE-AREA">/AUTOSAR_Eth_43_PFE/BswModuleDescriptions/Eth/InternalBehavior_0/ETH_EXCLUSIVE_AREA_07</CAN-ENTER-EXCLUSIVE-AREA-REF>
                        <CAN-ENTER-EXCLUSIVE-AREA-REF DEST="EXCLUSIVE-AREA">/AUTOSAR_Eth_43_PFE/BswModuleDescriptions/Eth/InternalBehavior_0/ETH_EXCLUSIVE_AREA_08</CAN-ENTER-EXCLUSIVE-AREA-REF>
                        <CAN-ENTER-EXCLUSIVE-AREA-REF DEST="EXCLUSIVE-AREA">/AUTOSAR_Eth_43_PFE/BswModuleDescriptions/Eth/InternalBehavior_0/ETH_EXCLUSIVE_AREA_09</CAN-ENTER-EXCLUSIVE-AREA-REF>
                        <CAN-ENTER-EXCLUSIVE-AREA-REF DEST="EXCLUSIVE-AREA">/AUTOSAR_Eth_43_PFE/BswModuleDescriptions/Eth/InternalBehavior_0/ETH_EXCLUSIVE_AREA_10</CAN-ENTER-EXCLUSIVE-AREA-REF>
                        <CAN-ENTER-EXCLUSIVE-AREA-REF DEST="EXCLUSIVE-AREA">/AUTOSAR_Eth_43_PFE/BswModuleDescriptions/Eth/InternalBehavior_0/ETH_EXCLUSIVE_AREA_13</CAN-ENTER-EXCLUSIVE-AREA-REF>
                        <CAN-ENTER-EXCLUSIVE-AREA-REF DEST="EXCLUSIVE-AREA">/AUTOSAR_Eth_43_PFE/BswModuleDescriptions/Eth/InternalBehavior_0/ETH_EXCLUSIVE_AREA_14</CAN-ENTER-EXCLUSIVE-AREA-REF>
                        <CAN-ENTER-EXCLUSIVE-AREA-REF DEST="EXCLUSIVE-AREA">/AUTOSAR_Eth_43_PFE/BswModuleDescriptions/Eth/InternalBehavior_0/ETH_EXCLUSIVE_AREA_15</CAN-ENTER-EXCLUSIVE-AREA-REF>
                        <CAN-ENTER-EXCLUSIVE-AREA-REF DEST="EXCLUSIVE-AREA">/AUTOSAR_Eth_43_PFE/BswModuleDescriptions/Eth/InternalBehavior_0/ETH_EXCLUSIVE_AREA_16</CAN-ENTER-EXCLUSIVE-AREA-REF>
                        <CAN-ENTER-EXCLUSIVE-AREA-REF DEST="EXCLUSIVE-AREA">/AUTOSAR_Eth_43_PFE/BswModuleDescriptions/Eth/InternalBehavior_0/ETH_EXCLUSIVE_AREA_18</CAN-ENTER-EXCLUSIVE-AREA-REF>
                        <CAN-ENTER-EXCLUSIVE-AREA-REF DEST="EXCLUSIVE-AREA">/AUTOSAR_Eth_43_PFE/BswModuleDescriptions/Eth/InternalBehavior_0/ETH_EXCLUSIVE_AREA_20</CAN-ENTER-EXCLUSIVE-AREA-REF>
                        <CAN-ENTER-EXCLUSIVE-AREA-REF DEST="EXCLUSIVE-AREA">/AUTOSAR_Eth_43_PFE/BswModuleDescriptions/Eth/InternalBehavior_0/ETH_EXCLUSIVE_AREA_21</CAN-ENTER-EXCLUSIVE-AREA-REF>
                        <CAN-ENTER-EXCLUSIVE-AREA-REF DEST="EXCLUSIVE-AREA">/AUTOSAR_Eth_43_PFE/BswModuleDescriptions/Eth/InternalBehavior_0/ETH_EXCLUSIVE_AREA_22</CAN-ENTER-EXCLUSIVE-AREA-REF>
                        <CAN-ENTER-EXCLUSIVE-AREA-REF DEST="EXCLUSIVE-AREA">/AUTOSAR_Eth_43_PFE/BswModuleDescriptions/Eth/InternalBehavior_0/ETH_EXCLUSIVE_AREA_23</CAN-ENTER-EXCLUSIVE-AREA-REF>
                        <CAN-ENTER-EXCLUSIVE-AREA-REF DEST="EXCLUSIVE-AREA">/AUTOSAR_Eth_43_PFE/BswModuleDescriptions/Eth/InternalBehavior_0/ETH_EXCLUSIVE_AREA_26</CAN-ENTER-EXCLUSIVE-AREA-REF>
                        <CAN-ENTER-EXCLUSIVE-AREA-REF DEST="EXCLUSIVE-AREA">/AUTOSAR_Eth_43_PFE/BswModuleDescriptions/Eth/InternalBehavior_0/ETH_EXCLUSIVE_AREA_28</CAN-ENTER-EXCLUSIVE-AREA-REF>
                        <CAN-ENTER-EXCLUSIVE-AREA-REF DEST="EXCLUSIVE-AREA">/AUTOSAR_Eth_43_PFE/BswModuleDescriptions/Eth/InternalBehavior_0/ETH_EXCLUSIVE_AREA_30</CAN-ENTER-EXCLUSIVE-AREA-REF>
                        <CAN-ENTER-EXCLUSIVE-AREA-REF DEST="EXCLUSIVE-AREA">/AUTOSAR_Eth_43_PFE/BswModuleDescriptions/Eth/InternalBehavior_0/ETH_EXCLUSIVE_AREA_31</CAN-ENTER-EXCLUSIVE-AREA-REF>
                        <CAN-ENTER-EXCLUSIVE-AREA-REF DEST="EXCLUSIVE-AREA">/AUTOSAR_Eth_43_PFE/BswModuleDescriptions/Eth/InternalBehavior_0/ETH_EXCLUSIVE_AREA_38</CAN-ENTER-EXCLUSIVE-AREA-REF>
                        <CAN-ENTER-EXCLUSIVE-AREA-REF DEST="EXCLUSIVE-AREA">/AUTOSAR_Eth_43_PFE/BswModuleDescriptions/Eth/InternalBehavior_0/ETH_EXCLUSIVE_AREA_39</CAN-ENTER-EXCLUSIVE-AREA-REF>
                        <CAN-ENTER-EXCLUSIVE-AREA-REF DEST="EXCLUSIVE-AREA">/AUTOSAR_Eth_43_PFE/BswModuleDescriptions/Eth/InternalBehavior_0/ETH_EXCLUSIVE_AREA_40</CAN-ENTER-EXCLUSIVE-AREA-REF>
                        <CAN-ENTER-EXCLUSIVE-AREA-REF DEST="EXCLUSIVE-AREA">/AUTOSAR_Eth_43_PFE/BswModuleDescriptions/Eth/InternalBehavior_0/ETH_EXCLUSIVE_AREA_45</CAN-ENTER-EXCLUSIVE-AREA-REF>
                        <CAN-ENTER-EXCLUSIVE-AREA-REF DEST="EXCLUSIVE-AREA">/AUTOSAR_Eth_43_PFE/BswModuleDescriptions/Eth/InternalBehavior_0/ETH_EXCLUSIVE_AREA_46</CAN-ENTER-EXCLUSIVE-AREA-REF>
                        <CAN-ENTER-EXCLUSIVE-AREA-REF DEST="EXCLUSIVE-AREA">/AUTOSAR_Eth_43_PFE/BswModuleDescriptions/Eth/InternalBehavior_0/ETH_EXCLUSIVE_AREA_47</CAN-ENTER-EXCLUSIVE-AREA-REF>
                        <CAN-ENTER-EXCLUSIVE-AREA-REF DEST="EXCLUSIVE-AREA">/AUTOSAR_Eth_43_PFE/BswModuleDescriptions/Eth/InternalBehavior_0/ETH_EXCLUSIVE_AREA_48</CAN-ENTER-EXCLUSIVE-AREA-REF>
                        <CAN-ENTER-EXCLUSIVE-AREA-REF DEST="EXCLUSIVE-AREA">/AUTOSAR_Eth_43_PFE/BswModuleDescriptions/Eth/InternalBehavior_0/ETH_EXCLUSIVE_AREA_54</CAN-ENTER-EXCLUSIVE-AREA-REF>
                        <CAN-ENTER-EXCLUSIVE-AREA-REF DEST="EXCLUSIVE-AREA">/AUTOSAR_Eth_43_PFE/BswModuleDescriptions/Eth/InternalBehavior_0/ETH_EXCLUSIVE_AREA_55</CAN-ENTER-EXCLUSIVE-AREA-REF>
                        <CAN-ENTER-EXCLUSIVE-AREA-REF DEST="EXCLUSIVE-AREA">/AUTOSAR_Eth_43_PFE/BswModuleDescriptions/Eth/InternalBehavior_0/ETH_EXCLUSIVE_AREA_56</CAN-ENTER-EXCLUSIVE-AREA-REF>
                        <CAN-ENTER-EXCLUSIVE-AREA-REF DEST="EXCLUSIVE-AREA">/AUTOSAR_Eth_43_PFE/BswModuleDescriptions/Eth/InternalBehavior_0/ETH_EXCLUSIVE_AREA_57</CAN-ENTER-EXCLUSIVE-AREA-REF>
                        <CAN-ENTER-EXCLUSIVE-AREA-REF DEST="EXCLUSIVE-AREA">/AUTOSAR_Eth_43_PFE/BswModuleDescriptions/Eth/InternalBehavior_0/ETH_EXCLUSIVE_AREA_58</CAN-ENTER-EXCLUSIVE-AREA-REF>
                        <CAN-ENTER-EXCLUSIVE-AREA-REF DEST="EXCLUSIVE-AREA">/AUTOSAR_Eth_43_PFE/BswModuleDescriptions/Eth/InternalBehavior_0/ETH_EXCLUSIVE_AREA_59</CAN-ENTER-EXCLUSIVE-AREA-REF>
                        <CAN-ENTER-EXCLUSIVE-AREA-REF DEST="EXCLUSIVE-AREA">/AUTOSAR_Eth_43_PFE/BswModuleDescriptions/Eth/InternalBehavior_0/ETH_EXCLUSIVE_AREA_60</CAN-ENTER-EXCLUSIVE-AREA-REF>
                        <CAN-ENTER-EXCLUSIVE-AREA-REF DEST="EXCLUSIVE-AREA">/AUTOSAR_Eth_43_PFE/BswModuleDescriptions/Eth/InternalBehavior_0/ETH_EXCLUSIVE_AREA_65</CAN-ENTER-EXCLUSIVE-AREA-REF>
                        <CAN-ENTER-EXCLUSIVE-AREA-REF DEST="EXCLUSIVE-AREA">/AUTOSAR_Eth_43_PFE/BswModuleDescriptions/Eth/InternalBehavior_0/ETH_EXCLUSIVE_AREA_66</CAN-ENTER-EXCLUSIVE-AREA-REF>
                        <CAN-ENTER-EXCLUSIVE-AREA-REF DEST="EXCLUSIVE-AREA">/AUTOSAR_Eth_43_PFE/BswModuleDescriptions/Eth/InternalBehavior_0/ETH_EXCLUSIVE_AREA_67</CAN-ENTER-EXCLUSIVE-AREA-REF>
                        <CAN-ENTER-EXCLUSIVE-AREA-REF DEST="EXCLUSIVE-AREA">/AUTOSAR_Eth_43_PFE/BswModuleDescriptions/Eth/InternalBehavior_0/ETH_EXCLUSIVE_AREA_68</CAN-ENTER-EXCLUSIVE-AREA-REF>
                        <CAN-ENTER-EXCLUSIVE-AREA-REF DEST="EXCLUSIVE-AREA">/AUTOSAR_Eth_43_PFE/BswModuleDescriptions/Eth/InternalBehavior_0/ETH_EXCLUSIVE_AREA_69</CAN-ENTER-EXCLUSIVE-AREA-REF>
                        <CAN-ENTER-EXCLUSIVE-AREA-REF DEST="EXCLUSIVE-AREA">/AUTOSAR_Eth_43_PFE/BswModuleDescriptions/Eth/InternalBehavior_0/ETH_EXCLUSIVE_AREA_70</CAN-ENTER-EXCLUSIVE-AREA-REF>
                        <CAN-ENTER-EXCLUSIVE-AREA-REF DEST="EXCLUSIVE-AREA">/AUTOSAR_Eth_43_PFE/BswModuleDescriptions/Eth/InternalBehavior_0/ETH_EXCLUSIVE_AREA_71</CAN-ENTER-EXCLUSIVE-AREA-REF>
                        <CAN-ENTER-EXCLUSIVE-AREA-REF DEST="EXCLUSIVE-AREA">/AUTOSAR_Eth_43_PFE/BswModuleDescriptions/Eth/InternalBehavior_0/ETH_EXCLUSIVE_AREA_72</CAN-ENTER-EXCLUSIVE-AREA-REF>
                        <CAN-ENTER-EXCLUSIVE-AREA-REF DEST="EXCLUSIVE-AREA">/AUTOSAR_Eth_43_PFE/BswModuleDescriptions/Eth/InternalBehavior_0/ETH_EXCLUSIVE_AREA_73</CAN-ENTER-EXCLUSIVE-AREA-REF>
                        <CAN-ENTER-EXCLUSIVE-AREA-REF DEST="EXCLUSIVE-AREA">/AUTOSAR_Eth_43_PFE/BswModuleDescriptions/Eth/InternalBehavior_0/ETH_EXCLUSIVE_AREA_74</CAN-ENTER-EXCLUSIVE-AREA-REF>
                        <CAN-ENTER-EXCLUSIVE-AREA-REF DEST="EXCLUSIVE-AREA">/AUTOSAR_Eth_43_PFE/BswModuleDescriptions/Eth/InternalBehavior_0/ETH_EXCLUSIVE_AREA_77</CAN-ENTER-EXCLUSIVE-AREA-REF>
                        <CAN-ENTER-EXCLUSIVE-AREA-REF DEST="EXCLUSIVE-AREA">/AUTOSAR_Eth_43_PFE/BswModuleDescriptions/Eth/InternalBehavior_0/ETH_EXCLUSIVE_AREA_78</CAN-ENTER-EXCLUSIVE-AREA-REF>
                        <CAN-ENTER-EXCLUSIVE-AREA-REF DEST="EXCLUSIVE-AREA">/AUTOSAR_Eth_43_PFE/BswModuleDescriptions/Eth/InternalBehavior_0/ETH_EXCLUSIVE_AREA_79</CAN-ENTER-EXCLUSIVE-AREA-REF>
                        <CAN-ENTER-EXCLUSIVE-AREA-REF DEST="EXCLUSIVE-AREA">/AUTOSAR_Eth_43_PFE/BswModuleDescriptions/Eth/InternalBehavior_0/ETH_EXCLUSIVE_AREA_81</CAN-ENTER-EXCLUSIVE-AREA-REF>
                        <CAN-ENTER-EXCLUSIVE-AREA-REF DEST="EXCLUSIVE-AREA">/AUTOSAR_Eth_43_PFE/BswModuleDescriptions/Eth/InternalBehavior_0/ETH_EXCLUSIVE_AREA_82</CAN-ENTER-EXCLUSIVE-AREA-REF>
                        <CAN-ENTER-EXCLUSIVE-AREA-REF DEST="EXCLUSIVE-AREA">/AUTOSAR_Eth_43_PFE/BswModuleDescriptions/Eth/InternalBehavior_0/ETH_EXCLUSIVE_AREA_85</CAN-ENTER-EXCLUSIVE-AREA-REF>
                        <CAN-ENTER-EXCLUSIVE-AREA-REF DEST="EXCLUSIVE-AREA">/AUTOSAR_Eth_43_PFE/BswModuleDescriptions/Eth/InternalBehavior_0/ETH_EXCLUSIVE_AREA_86</CAN-ENTER-EXCLUSIVE-AREA-REF>
                        <CAN-ENTER-EXCLUSIVE-AREA-REF DEST="EXCLUSIVE-AREA">/AUTOSAR_Eth_43_PFE/BswModuleDescriptions/Eth/InternalBehavior_0/ETH_EXCLUSIVE_AREA_88</CAN-ENTER-EXCLUSIVE-AREA-REF>
                        <CAN-ENTER-EXCLUSIVE-AREA-REF DEST="EXCLUSIVE-AREA">/AUTOSAR_Eth_43_PFE/BswModuleDescriptions/Eth/InternalBehavior_0/ETH_EXCLUSIVE_AREA_89</CAN-ENTER-EXCLUSIVE-AREA-REF>
                        <CAN-ENTER-EXCLUSIVE-AREA-REF DEST="EXCLUSIVE-AREA">/AUTOSAR_Eth_43_PFE/BswModuleDescriptions/Eth/InternalBehavior_0/ETH_EXCLUSIVE_AREA_90</CAN-ENTER-EXCLUSIVE-AREA-REF>
                        <CAN-ENTER-EXCLUSIVE-AREA-REF DEST="EXCLUSIVE-AREA">/AUTOSAR_Eth_43_PFE/BswModuleDescriptions/Eth/InternalBehavior_0/ETH_EXCLUSIVE_AREA_91</CAN-ENTER-EXCLUSIVE-AREA-REF>
                        <CAN-ENTER-EXCLUSIVE-AREA-REF DEST="EXCLUSIVE-AREA">/AUTOSAR_Eth_43_PFE/BswModuleDescriptions/Eth/InternalBehavior_0/ETH_EXCLUSIVE_AREA_92</CAN-ENTER-EXCLUSIVE-AREA-REF>
                        <CAN-ENTER-EXCLUSIVE-AREA-REF DEST="EXCLUSIVE-AREA">/AUTOSAR_Eth_43_PFE/BswModuleDescriptions/Eth/InternalBehavior_0/ETH_EXCLUSIVE_AREA_93</CAN-ENTER-EXCLUSIVE-AREA-REF>
                        <CAN-ENTER-EXCLUSIVE-AREA-REF DEST="EXCLUSIVE-AREA">/AUTOSAR_Eth_43_PFE/BswModuleDescriptions/Eth/InternalBehavior_0/ETH_EXCLUSIVE_AREA_95</CAN-ENTER-EXCLUSIVE-AREA-REF>
                        <CAN-ENTER-EXCLUSIVE-AREA-REF DEST="EXCLUSIVE-AREA">/AUTOSAR_Eth_43_PFE/BswModuleDescriptions/Eth/InternalBehavior_0/ETH_EXCLUSIVE_AREA_97</CAN-ENTER-EXCLUSIVE-AREA-REF>
                        <CAN-ENTER-EXCLUSIVE-AREA-REF DEST="EXCLUSIVE-AREA">/AUTOSAR_Eth_43_PFE/BswModuleDescriptions/Eth/InternalBehavior_0/ETH_EXCLUSIVE_AREA_99</CAN-ENTER-EXCLUSIVE-AREA-REF>
                        <CAN-ENTER-EXCLUSIVE-AREA-REF DEST="EXCLUSIVE-AREA">/AUTOSAR_Eth_43_PFE/BswModuleDescriptions/Eth/InternalBehavior_0/ETH_EXCLUSIVE_AREA_100</CAN-ENTER-EXCLUSIVE-AREA-REF>
                        <CAN-ENTER-EXCLUSIVE-AREA-REF DEST="EXCLUSIVE-AREA">/AUTOSAR_Eth_43_PFE/BswModuleDescriptions/Eth/InternalBehavior_0/ETH_EXCLUSIVE_AREA_101</CAN-ENTER-EXCLUSIVE-AREA-REF>
                        <CAN-ENTER-EXCLUSIVE-AREA-REF DEST="EXCLUSIVE-AREA">/AUTOSAR_Eth_43_PFE/BswModuleDescriptions/Eth/InternalBehavior_0/ETH_EXCLUSIVE_AREA_102</CAN-ENTER-EXCLUSIVE-AREA-REF>
                        <CAN-ENTER-EXCLUSIVE-AREA-REF DEST="EXCLUSIVE-AREA">/AUTOSAR_Eth_43_PFE/BswModuleDescriptions/Eth/InternalBehavior_0/ETH_EXCLUSIVE_AREA_103</CAN-ENTER-EXCLUSIVE-AREA-REF>
                        <CAN-ENTER-EXCLUSIVE-AREA-REF DEST="EXCLUSIVE-AREA">/AUTOSAR_Eth_43_PFE/BswModuleDescriptions/Eth/InternalBehavior_0/ETH_EXCLUSIVE_AREA_104</CAN-ENTER-EXCLUSIVE-AREA-REF>
                      </CAN-ENTER-EXCLUSIVE-AREA-REFS>
                      <MINIMUM-START-INTERVAL>0.0</MINIMUM-START-INTERVAL>
                      <IMPLEMENTED-ENTRY-REF DEST="BSW-MODULE-ENTRY">/AUTOSAR_Eth_43_PFE/BswModuleEntrys/Eth_Receive</IMPLEMENTED-ENTRY-REF>
                    </BSW-CALLED-ENTITY>
                    <BSW-CALLED-ENTITY>
                      <SHORT-NAME>Eth_43_PFE_TxConfirmation</SHORT-NAME>
                      <CAN-ENTER-EXCLUSIVE-AREA-REFS>
                        <CAN-ENTER-EXCLUSIVE-AREA-REF DEST="EXCLUSIVE-AREA">/AUTOSAR_Eth_43_PFE/BswModuleDescriptions/Eth/InternalBehavior_0/ETH_EXCLUSIVE_AREA_01</CAN-ENTER-EXCLUSIVE-AREA-REF>
                        <CAN-ENTER-EXCLUSIVE-AREA-REF DEST="EXCLUSIVE-AREA">/AUTOSAR_Eth_43_PFE/BswModuleDescriptions/Eth/InternalBehavior_0/ETH_EXCLUSIVE_AREA_03</CAN-ENTER-EXCLUSIVE-AREA-REF>
                        <CAN-ENTER-EXCLUSIVE-AREA-REF DEST="EXCLUSIVE-AREA">/AUTOSAR_Eth_43_PFE/BswModuleDescriptions/Eth/InternalBehavior_0/ETH_EXCLUSIVE_AREA_04</CAN-ENTER-EXCLUSIVE-AREA-REF>
                        <CAN-ENTER-EXCLUSIVE-AREA-REF DEST="EXCLUSIVE-AREA">/AUTOSAR_Eth_43_PFE/BswModuleDescriptions/Eth/InternalBehavior_0/ETH_EXCLUSIVE_AREA_05</CAN-ENTER-EXCLUSIVE-AREA-REF>
                        <CAN-ENTER-EXCLUSIVE-AREA-REF DEST="EXCLUSIVE-AREA">/AUTOSAR_Eth_43_PFE/BswModuleDescriptions/Eth/InternalBehavior_0/ETH_EXCLUSIVE_AREA_07</CAN-ENTER-EXCLUSIVE-AREA-REF>
                        <CAN-ENTER-EXCLUSIVE-AREA-REF DEST="EXCLUSIVE-AREA">/AUTOSAR_Eth_43_PFE/BswModuleDescriptions/Eth/InternalBehavior_0/ETH_EXCLUSIVE_AREA_08</CAN-ENTER-EXCLUSIVE-AREA-REF>
                        <CAN-ENTER-EXCLUSIVE-AREA-REF DEST="EXCLUSIVE-AREA">/AUTOSAR_Eth_43_PFE/BswModuleDescriptions/Eth/InternalBehavior_0/ETH_EXCLUSIVE_AREA_09</CAN-ENTER-EXCLUSIVE-AREA-REF>
                        <CAN-ENTER-EXCLUSIVE-AREA-REF DEST="EXCLUSIVE-AREA">/AUTOSAR_Eth_43_PFE/BswModuleDescriptions/Eth/InternalBehavior_0/ETH_EXCLUSIVE_AREA_10</CAN-ENTER-EXCLUSIVE-AREA-REF>
                        <CAN-ENTER-EXCLUSIVE-AREA-REF DEST="EXCLUSIVE-AREA">/AUTOSAR_Eth_43_PFE/BswModuleDescriptions/Eth/InternalBehavior_0/ETH_EXCLUSIVE_AREA_13</CAN-ENTER-EXCLUSIVE-AREA-REF>
                        <CAN-ENTER-EXCLUSIVE-AREA-REF DEST="EXCLUSIVE-AREA">/AUTOSAR_Eth_43_PFE/BswModuleDescriptions/Eth/InternalBehavior_0/ETH_EXCLUSIVE_AREA_14</CAN-ENTER-EXCLUSIVE-AREA-REF>
                        <CAN-ENTER-EXCLUSIVE-AREA-REF DEST="EXCLUSIVE-AREA">/AUTOSAR_Eth_43_PFE/BswModuleDescriptions/Eth/InternalBehavior_0/ETH_EXCLUSIVE_AREA_15</CAN-ENTER-EXCLUSIVE-AREA-REF>
                        <CAN-ENTER-EXCLUSIVE-AREA-REF DEST="EXCLUSIVE-AREA">/AUTOSAR_Eth_43_PFE/BswModuleDescriptions/Eth/InternalBehavior_0/ETH_EXCLUSIVE_AREA_16</CAN-ENTER-EXCLUSIVE-AREA-REF>
                        <CAN-ENTER-EXCLUSIVE-AREA-REF DEST="EXCLUSIVE-AREA">/AUTOSAR_Eth_43_PFE/BswModuleDescriptions/Eth/InternalBehavior_0/ETH_EXCLUSIVE_AREA_18</CAN-ENTER-EXCLUSIVE-AREA-REF>
                        <CAN-ENTER-EXCLUSIVE-AREA-REF DEST="EXCLUSIVE-AREA">/AUTOSAR_Eth_43_PFE/BswModuleDescriptions/Eth/InternalBehavior_0/ETH_EXCLUSIVE_AREA_20</CAN-ENTER-EXCLUSIVE-AREA-REF>
                        <CAN-ENTER-EXCLUSIVE-AREA-REF DEST="EXCLUSIVE-AREA">/AUTOSAR_Eth_43_PFE/BswModuleDescriptions/Eth/InternalBehavior_0/ETH_EXCLUSIVE_AREA_21</CAN-ENTER-EXCLUSIVE-AREA-REF>
                        <CAN-ENTER-EXCLUSIVE-AREA-REF DEST="EXCLUSIVE-AREA">/AUTOSAR_Eth_43_PFE/BswModuleDescriptions/Eth/InternalBehavior_0/ETH_EXCLUSIVE_AREA_22</CAN-ENTER-EXCLUSIVE-AREA-REF>
                        <CAN-ENTER-EXCLUSIVE-AREA-REF DEST="EXCLUSIVE-AREA">/AUTOSAR_Eth_43_PFE/BswModuleDescriptions/Eth/InternalBehavior_0/ETH_EXCLUSIVE_AREA_23</CAN-ENTER-EXCLUSIVE-AREA-REF>
                        <CAN-ENTER-EXCLUSIVE-AREA-REF DEST="EXCLUSIVE-AREA">/AUTOSAR_Eth_43_PFE/BswModuleDescriptions/Eth/InternalBehavior_0/ETH_EXCLUSIVE_AREA_26</CAN-ENTER-EXCLUSIVE-AREA-REF>
                        <CAN-ENTER-EXCLUSIVE-AREA-REF DEST="EXCLUSIVE-AREA">/AUTOSAR_Eth_43_PFE/BswModuleDescriptions/Eth/InternalBehavior_0/ETH_EXCLUSIVE_AREA_28</CAN-ENTER-EXCLUSIVE-AREA-REF>
                        <CAN-ENTER-EXCLUSIVE-AREA-REF DEST="EXCLUSIVE-AREA">/AUTOSAR_Eth_43_PFE/BswModuleDescriptions/Eth/InternalBehavior_0/ETH_EXCLUSIVE_AREA_30</CAN-ENTER-EXCLUSIVE-AREA-REF>
                        <CAN-ENTER-EXCLUSIVE-AREA-REF DEST="EXCLUSIVE-AREA">/AUTOSAR_Eth_43_PFE/BswModuleDescriptions/Eth/InternalBehavior_0/ETH_EXCLUSIVE_AREA_31</CAN-ENTER-EXCLUSIVE-AREA-REF>
                        <CAN-ENTER-EXCLUSIVE-AREA-REF DEST="EXCLUSIVE-AREA">/AUTOSAR_Eth_43_PFE/BswModuleDescriptions/Eth/InternalBehavior_0/ETH_EXCLUSIVE_AREA_38</CAN-ENTER-EXCLUSIVE-AREA-REF>
                        <CAN-ENTER-EXCLUSIVE-AREA-REF DEST="EXCLUSIVE-AREA">/AUTOSAR_Eth_43_PFE/BswModuleDescriptions/Eth/InternalBehavior_0/ETH_EXCLUSIVE_AREA_39</CAN-ENTER-EXCLUSIVE-AREA-REF>
                        <CAN-ENTER-EXCLUSIVE-AREA-REF DEST="EXCLUSIVE-AREA">/AUTOSAR_Eth_43_PFE/BswModuleDescriptions/Eth/InternalBehavior_0/ETH_EXCLUSIVE_AREA_40</CAN-ENTER-EXCLUSIVE-AREA-REF>
                        <CAN-ENTER-EXCLUSIVE-AREA-REF DEST="EXCLUSIVE-AREA">/AUTOSAR_Eth_43_PFE/BswModuleDescriptions/Eth/InternalBehavior_0/ETH_EXCLUSIVE_AREA_45</CAN-ENTER-EXCLUSIVE-AREA-REF>
                        <CAN-ENTER-EXCLUSIVE-AREA-REF DEST="EXCLUSIVE-AREA">/AUTOSAR_Eth_43_PFE/BswModuleDescriptions/Eth/InternalBehavior_0/ETH_EXCLUSIVE_AREA_46</CAN-ENTER-EXCLUSIVE-AREA-REF>
                        <CAN-ENTER-EXCLUSIVE-AREA-REF DEST="EXCLUSIVE-AREA">/AUTOSAR_Eth_43_PFE/BswModuleDescriptions/Eth/InternalBehavior_0/ETH_EXCLUSIVE_AREA_47</CAN-ENTER-EXCLUSIVE-AREA-REF>
                        <CAN-ENTER-EXCLUSIVE-AREA-REF DEST="EXCLUSIVE-AREA">/AUTOSAR_Eth_43_PFE/BswModuleDescriptions/Eth/InternalBehavior_0/ETH_EXCLUSIVE_AREA_48</CAN-ENTER-EXCLUSIVE-AREA-REF>
                        <CAN-ENTER-EXCLUSIVE-AREA-REF DEST="EXCLUSIVE-AREA">/AUTOSAR_Eth_43_PFE/BswModuleDescriptions/Eth/InternalBehavior_0/ETH_EXCLUSIVE_AREA_54</CAN-ENTER-EXCLUSIVE-AREA-REF>
                        <CAN-ENTER-EXCLUSIVE-AREA-REF DEST="EXCLUSIVE-AREA">/AUTOSAR_Eth_43_PFE/BswModuleDescriptions/Eth/InternalBehavior_0/ETH_EXCLUSIVE_AREA_55</CAN-ENTER-EXCLUSIVE-AREA-REF>
                        <CAN-ENTER-EXCLUSIVE-AREA-REF DEST="EXCLUSIVE-AREA">/AUTOSAR_Eth_43_PFE/BswModuleDescriptions/Eth/InternalBehavior_0/ETH_EXCLUSIVE_AREA_56</CAN-ENTER-EXCLUSIVE-AREA-REF>
                        <CAN-ENTER-EXCLUSIVE-AREA-REF DEST="EXCLUSIVE-AREA">/AUTOSAR_Eth_43_PFE/BswModuleDescriptions/Eth/InternalBehavior_0/ETH_EXCLUSIVE_AREA_57</CAN-ENTER-EXCLUSIVE-AREA-REF>
                        <CAN-ENTER-EXCLUSIVE-AREA-REF DEST="EXCLUSIVE-AREA">/AUTOSAR_Eth_43_PFE/BswModuleDescriptions/Eth/InternalBehavior_0/ETH_EXCLUSIVE_AREA_58</CAN-ENTER-EXCLUSIVE-AREA-REF>
                        <CAN-ENTER-EXCLUSIVE-AREA-REF DEST="EXCLUSIVE-AREA">/AUTOSAR_Eth_43_PFE/BswModuleDescriptions/Eth/InternalBehavior_0/ETH_EXCLUSIVE_AREA_59</CAN-ENTER-EXCLUSIVE-AREA-REF>
                        <CAN-ENTER-EXCLUSIVE-AREA-REF DEST="EXCLUSIVE-AREA">/AUTOSAR_Eth_43_PFE/BswModuleDescriptions/Eth/InternalBehavior_0/ETH_EXCLUSIVE_AREA_60</CAN-ENTER-EXCLUSIVE-AREA-REF>
                        <CAN-ENTER-EXCLUSIVE-AREA-REF DEST="EXCLUSIVE-AREA">/AUTOSAR_Eth_43_PFE/BswModuleDescriptions/Eth/InternalBehavior_0/ETH_EXCLUSIVE_AREA_65</CAN-ENTER-EXCLUSIVE-AREA-REF>
                        <CAN-ENTER-EXCLUSIVE-AREA-REF DEST="EXCLUSIVE-AREA">/AUTOSAR_Eth_43_PFE/BswModuleDescriptions/Eth/InternalBehavior_0/ETH_EXCLUSIVE_AREA_66</CAN-ENTER-EXCLUSIVE-AREA-REF>
                        <CAN-ENTER-EXCLUSIVE-AREA-REF DEST="EXCLUSIVE-AREA">/AUTOSAR_Eth_43_PFE/BswModuleDescriptions/Eth/InternalBehavior_0/ETH_EXCLUSIVE_AREA_67</CAN-ENTER-EXCLUSIVE-AREA-REF>
                        <CAN-ENTER-EXCLUSIVE-AREA-REF DEST="EXCLUSIVE-AREA">/AUTOSAR_Eth_43_PFE/BswModuleDescriptions/Eth/InternalBehavior_0/ETH_EXCLUSIVE_AREA_68</CAN-ENTER-EXCLUSIVE-AREA-REF>
                        <CAN-ENTER-EXCLUSIVE-AREA-REF DEST="EXCLUSIVE-AREA">/AUTOSAR_Eth_43_PFE/BswModuleDescriptions/Eth/InternalBehavior_0/ETH_EXCLUSIVE_AREA_69</CAN-ENTER-EXCLUSIVE-AREA-REF>
                        <CAN-ENTER-EXCLUSIVE-AREA-REF DEST="EXCLUSIVE-AREA">/AUTOSAR_Eth_43_PFE/BswModuleDescriptions/Eth/InternalBehavior_0/ETH_EXCLUSIVE_AREA_70</CAN-ENTER-EXCLUSIVE-AREA-REF>
                        <CAN-ENTER-EXCLUSIVE-AREA-REF DEST="EXCLUSIVE-AREA">/AUTOSAR_Eth_43_PFE/BswModuleDescriptions/Eth/InternalBehavior_0/ETH_EXCLUSIVE_AREA_71</CAN-ENTER-EXCLUSIVE-AREA-REF>
                        <CAN-ENTER-EXCLUSIVE-AREA-REF DEST="EXCLUSIVE-AREA">/AUTOSAR_Eth_43_PFE/BswModuleDescriptions/Eth/InternalBehavior_0/ETH_EXCLUSIVE_AREA_72</CAN-ENTER-EXCLUSIVE-AREA-REF>
                        <CAN-ENTER-EXCLUSIVE-AREA-REF DEST="EXCLUSIVE-AREA">/AUTOSAR_Eth_43_PFE/BswModuleDescriptions/Eth/InternalBehavior_0/ETH_EXCLUSIVE_AREA_73</CAN-ENTER-EXCLUSIVE-AREA-REF>
                        <CAN-ENTER-EXCLUSIVE-AREA-REF DEST="EXCLUSIVE-AREA">/AUTOSAR_Eth_43_PFE/BswModuleDescriptions/Eth/InternalBehavior_0/ETH_EXCLUSIVE_AREA_74</CAN-ENTER-EXCLUSIVE-AREA-REF>
                        <CAN-ENTER-EXCLUSIVE-AREA-REF DEST="EXCLUSIVE-AREA">/AUTOSAR_Eth_43_PFE/BswModuleDescriptions/Eth/InternalBehavior_0/ETH_EXCLUSIVE_AREA_77</CAN-ENTER-EXCLUSIVE-AREA-REF>
                        <CAN-ENTER-EXCLUSIVE-AREA-REF DEST="EXCLUSIVE-AREA">/AUTOSAR_Eth_43_PFE/BswModuleDescriptions/Eth/InternalBehavior_0/ETH_EXCLUSIVE_AREA_78</CAN-ENTER-EXCLUSIVE-AREA-REF>
                        <CAN-ENTER-EXCLUSIVE-AREA-REF DEST="EXCLUSIVE-AREA">/AUTOSAR_Eth_43_PFE/BswModuleDescriptions/Eth/InternalBehavior_0/ETH_EXCLUSIVE_AREA_79</CAN-ENTER-EXCLUSIVE-AREA-REF>
                        <CAN-ENTER-EXCLUSIVE-AREA-REF DEST="EXCLUSIVE-AREA">/AUTOSAR_Eth_43_PFE/BswModuleDescriptions/Eth/InternalBehavior_0/ETH_EXCLUSIVE_AREA_81</CAN-ENTER-EXCLUSIVE-AREA-REF>
                        <CAN-ENTER-EXCLUSIVE-AREA-REF DEST="EXCLUSIVE-AREA">/AUTOSAR_Eth_43_PFE/BswModuleDescriptions/Eth/InternalBehavior_0/ETH_EXCLUSIVE_AREA_82</CAN-ENTER-EXCLUSIVE-AREA-REF>
                        <CAN-ENTER-EXCLUSIVE-AREA-REF DEST="EXCLUSIVE-AREA">/AUTOSAR_Eth_43_PFE/BswModuleDescriptions/Eth/InternalBehavior_0/ETH_EXCLUSIVE_AREA_85</CAN-ENTER-EXCLUSIVE-AREA-REF>
                        <CAN-ENTER-EXCLUSIVE-AREA-REF DEST="EXCLUSIVE-AREA">/AUTOSAR_Eth_43_PFE/BswModuleDescriptions/Eth/InternalBehavior_0/ETH_EXCLUSIVE_AREA_86</CAN-ENTER-EXCLUSIVE-AREA-REF>
                        <CAN-ENTER-EXCLUSIVE-AREA-REF DEST="EXCLUSIVE-AREA">/AUTOSAR_Eth_43_PFE/BswModuleDescriptions/Eth/InternalBehavior_0/ETH_EXCLUSIVE_AREA_88</CAN-ENTER-EXCLUSIVE-AREA-REF>
                        <CAN-ENTER-EXCLUSIVE-AREA-REF DEST="EXCLUSIVE-AREA">/AUTOSAR_Eth_43_PFE/BswModuleDescriptions/Eth/InternalBehavior_0/ETH_EXCLUSIVE_AREA_89</CAN-ENTER-EXCLUSIVE-AREA-REF>
                        <CAN-ENTER-EXCLUSIVE-AREA-REF DEST="EXCLUSIVE-AREA">/AUTOSAR_Eth_43_PFE/BswModuleDescriptions/Eth/InternalBehavior_0/ETH_EXCLUSIVE_AREA_90</CAN-ENTER-EXCLUSIVE-AREA-REF>
                        <CAN-ENTER-EXCLUSIVE-AREA-REF DEST="EXCLUSIVE-AREA">/AUTOSAR_Eth_43_PFE/BswModuleDescriptions/Eth/InternalBehavior_0/ETH_EXCLUSIVE_AREA_91</CAN-ENTER-EXCLUSIVE-AREA-REF>
                        <CAN-ENTER-EXCLUSIVE-AREA-REF DEST="EXCLUSIVE-AREA">/AUTOSAR_Eth_43_PFE/BswModuleDescriptions/Eth/InternalBehavior_0/ETH_EXCLUSIVE_AREA_92</CAN-ENTER-EXCLUSIVE-AREA-REF>
                        <CAN-ENTER-EXCLUSIVE-AREA-REF DEST="EXCLUSIVE-AREA">/AUTOSAR_Eth_43_PFE/BswModuleDescriptions/Eth/InternalBehavior_0/ETH_EXCLUSIVE_AREA_93</CAN-ENTER-EXCLUSIVE-AREA-REF>
                        <CAN-ENTER-EXCLUSIVE-AREA-REF DEST="EXCLUSIVE-AREA">/AUTOSAR_Eth_43_PFE/BswModuleDescriptions/Eth/InternalBehavior_0/ETH_EXCLUSIVE_AREA_95</CAN-ENTER-EXCLUSIVE-AREA-REF>
                        <CAN-ENTER-EXCLUSIVE-AREA-REF DEST="EXCLUSIVE-AREA">/AUTOSAR_Eth_43_PFE/BswModuleDescriptions/Eth/InternalBehavior_0/ETH_EXCLUSIVE_AREA_97</CAN-ENTER-EXCLUSIVE-AREA-REF>
                        <CAN-ENTER-EXCLUSIVE-AREA-REF DEST="EXCLUSIVE-AREA">/AUTOSAR_Eth_43_PFE/BswModuleDescriptions/Eth/InternalBehavior_0/ETH_EXCLUSIVE_AREA_99</CAN-ENTER-EXCLUSIVE-AREA-REF>
                        <CAN-ENTER-EXCLUSIVE-AREA-REF DEST="EXCLUSIVE-AREA">/AUTOSAR_Eth_43_PFE/BswModuleDescriptions/Eth/InternalBehavior_0/ETH_EXCLUSIVE_AREA_100</CAN-ENTER-EXCLUSIVE-AREA-REF>
                        <CAN-ENTER-EXCLUSIVE-AREA-REF DEST="EXCLUSIVE-AREA">/AUTOSAR_Eth_43_PFE/BswModuleDescriptions/Eth/InternalBehavior_0/ETH_EXCLUSIVE_AREA_101</CAN-ENTER-EXCLUSIVE-AREA-REF>
                        <CAN-ENTER-EXCLUSIVE-AREA-REF DEST="EXCLUSIVE-AREA">/AUTOSAR_Eth_43_PFE/BswModuleDescriptions/Eth/InternalBehavior_0/ETH_EXCLUSIVE_AREA_102</CAN-ENTER-EXCLUSIVE-AREA-REF>
                        <CAN-ENTER-EXCLUSIVE-AREA-REF DEST="EXCLUSIVE-AREA">/AUTOSAR_Eth_43_PFE/BswModuleDescriptions/Eth/InternalBehavior_0/ETH_EXCLUSIVE_AREA_103</CAN-ENTER-EXCLUSIVE-AREA-REF>
                        <CAN-ENTER-EXCLUSIVE-AREA-REF DEST="EXCLUSIVE-AREA">/AUTOSAR_Eth_43_PFE/BswModuleDescriptions/Eth/InternalBehavior_0/ETH_EXCLUSIVE_AREA_104</CAN-ENTER-EXCLUSIVE-AREA-REF>
                      </CAN-ENTER-EXCLUSIVE-AREA-REFS>
                      <MINIMUM-START-INTERVAL>0.0</MINIMUM-START-INTERVAL>
                      <IMPLEMENTED-ENTRY-REF DEST="BSW-MODULE-ENTRY">/AUTOSAR_Eth_43_PFE/BswModuleEntrys/Eth_TxConfirmation</IMPLEMENTED-ENTRY-REF>
                    </BSW-CALLED-ENTITY>
                    [!IF "EthGeneral/EthVersionInfoApi = 'true'"!][!//
                    <BSW-CALLED-ENTITY>
                      <SHORT-NAME>Eth_43_PFE_GetVersionInfo</SHORT-NAME>
                      <MINIMUM-START-INTERVAL>0.0</MINIMUM-START-INTERVAL>
                      <IMPLEMENTED-ENTRY-REF DEST="BSW-MODULE-ENTRY">/AUTOSAR_Eth_43_PFE/BswModuleEntrys/Eth_GetVersionInfo</IMPLEMENTED-ENTRY-REF>
                    </BSW-CALLED-ENTITY>
                    [!ENDIF!][!//
                    [!IF "$AllMiiDisabled = 'false'"!][!//
                    <BSW-CALLED-ENTITY>
                      <SHORT-NAME>Eth_43_PFE_WriteMii</SHORT-NAME>
                      <CAN-ENTER-EXCLUSIVE-AREA-REFS>
                        <CAN-ENTER-EXCLUSIVE-AREA-REF DEST="EXCLUSIVE-AREA">/AUTOSAR_Eth_43_PFE/BswModuleDescriptions/Eth/InternalBehavior_0/ETH_EXCLUSIVE_AREA_60</CAN-ENTER-EXCLUSIVE-AREA-REF>
                        <CAN-ENTER-EXCLUSIVE-AREA-REF DEST="EXCLUSIVE-AREA">/AUTOSAR_Eth_43_PFE/BswModuleDescriptions/Eth/InternalBehavior_0/ETH_EXCLUSIVE_AREA_95</CAN-ENTER-EXCLUSIVE-AREA-REF>
                        <CAN-ENTER-EXCLUSIVE-AREA-REF DEST="EXCLUSIVE-AREA">/AUTOSAR_Eth_43_PFE/BswModuleDescriptions/Eth/InternalBehavior_0/ETH_EXCLUSIVE_AREA_100</CAN-ENTER-EXCLUSIVE-AREA-REF>
                        <CAN-ENTER-EXCLUSIVE-AREA-REF DEST="EXCLUSIVE-AREA">/AUTOSAR_Eth_43_PFE/BswModuleDescriptions/Eth/InternalBehavior_0/ETH_EXCLUSIVE_AREA_101</CAN-ENTER-EXCLUSIVE-AREA-REF>
                      </CAN-ENTER-EXCLUSIVE-AREA-REFS>
                      <MINIMUM-START-INTERVAL>0.0</MINIMUM-START-INTERVAL>
                      <IMPLEMENTED-ENTRY-REF DEST="BSW-MODULE-ENTRY">/AUTOSAR_Eth_43_PFE/BswModuleEntrys/Eth_WriteMii</IMPLEMENTED-ENTRY-REF>
                    </BSW-CALLED-ENTITY>
                    <BSW-CALLED-ENTITY>
                      <SHORT-NAME>Eth_43_PFE_ReadMii</SHORT-NAME>
                      <CAN-ENTER-EXCLUSIVE-AREA-REFS>
                        <CAN-ENTER-EXCLUSIVE-AREA-REF DEST="EXCLUSIVE-AREA">/AUTOSAR_Eth_43_PFE/BswModuleDescriptions/Eth/InternalBehavior_0/ETH_EXCLUSIVE_AREA_60</CAN-ENTER-EXCLUSIVE-AREA-REF>
                        <CAN-ENTER-EXCLUSIVE-AREA-REF DEST="EXCLUSIVE-AREA">/AUTOSAR_Eth_43_PFE/BswModuleDescriptions/Eth/InternalBehavior_0/ETH_EXCLUSIVE_AREA_95</CAN-ENTER-EXCLUSIVE-AREA-REF>
                        <CAN-ENTER-EXCLUSIVE-AREA-REF DEST="EXCLUSIVE-AREA">/AUTOSAR_Eth_43_PFE/BswModuleDescriptions/Eth/InternalBehavior_0/ETH_EXCLUSIVE_AREA_100</CAN-ENTER-EXCLUSIVE-AREA-REF>
                        <CAN-ENTER-EXCLUSIVE-AREA-REF DEST="EXCLUSIVE-AREA">/AUTOSAR_Eth_43_PFE/BswModuleDescriptions/Eth/InternalBehavior_0/ETH_EXCLUSIVE_AREA_101</CAN-ENTER-EXCLUSIVE-AREA-REF>
                      </CAN-ENTER-EXCLUSIVE-AREA-REFS>
                      <MINIMUM-START-INTERVAL>0.0</MINIMUM-START-INTERVAL>
                      <IMPLEMENTED-ENTRY-REF DEST="BSW-MODULE-ENTRY">/AUTOSAR_Eth_43_PFE/BswModuleEntrys/Eth_ReadMii</IMPLEMENTED-ENTRY-REF>
                    </BSW-CALLED-ENTITY>
                      [!IF "EthGeneral/EthVendorSpecific/EthEnableClause45API = 'true'"!][!//
                    <BSW-CALLED-ENTITY>
                      <SHORT-NAME>Eth_43_PFE_WriteMii45</SHORT-NAME>
                      <CAN-ENTER-EXCLUSIVE-AREA-REFS>
                        <CAN-ENTER-EXCLUSIVE-AREA-REF DEST="EXCLUSIVE-AREA">/AUTOSAR_Eth_43_PFE/BswModuleDescriptions/Eth/InternalBehavior_0/ETH_EXCLUSIVE_AREA_60</CAN-ENTER-EXCLUSIVE-AREA-REF>
                        <CAN-ENTER-EXCLUSIVE-AREA-REF DEST="EXCLUSIVE-AREA">/AUTOSAR_Eth_43_PFE/BswModuleDescriptions/Eth/InternalBehavior_0/ETH_EXCLUSIVE_AREA_95</CAN-ENTER-EXCLUSIVE-AREA-REF>
                        <CAN-ENTER-EXCLUSIVE-AREA-REF DEST="EXCLUSIVE-AREA">/AUTOSAR_Eth_43_PFE/BswModuleDescriptions/Eth/InternalBehavior_0/ETH_EXCLUSIVE_AREA_100</CAN-ENTER-EXCLUSIVE-AREA-REF>
                        <CAN-ENTER-EXCLUSIVE-AREA-REF DEST="EXCLUSIVE-AREA">/AUTOSAR_Eth_43_PFE/BswModuleDescriptions/Eth/InternalBehavior_0/ETH_EXCLUSIVE_AREA_101</CAN-ENTER-EXCLUSIVE-AREA-REF>
                      </CAN-ENTER-EXCLUSIVE-AREA-REFS>
                      <MINIMUM-START-INTERVAL>0.0</MINIMUM-START-INTERVAL>
                      <IMPLEMENTED-ENTRY-REF DEST="BSW-MODULE-ENTRY">/AUTOSAR_Eth_43_PFE/BswModuleEntrys/Eth_WriteMii45</IMPLEMENTED-ENTRY-REF>
                    </BSW-CALLED-ENTITY>
                    <BSW-CALLED-ENTITY>
                      <SHORT-NAME>Eth_43_PFE_ReadMii45</SHORT-NAME>
                      <CAN-ENTER-EXCLUSIVE-AREA-REFS>
                        <CAN-ENTER-EXCLUSIVE-AREA-REF DEST="EXCLUSIVE-AREA">/AUTOSAR_Eth_43_PFE/BswModuleDescriptions/Eth/InternalBehavior_0/ETH_EXCLUSIVE_AREA_60</CAN-ENTER-EXCLUSIVE-AREA-REF>
                        <CAN-ENTER-EXCLUSIVE-AREA-REF DEST="EXCLUSIVE-AREA">/AUTOSAR_Eth_43_PFE/BswModuleDescriptions/Eth/InternalBehavior_0/ETH_EXCLUSIVE_AREA_95</CAN-ENTER-EXCLUSIVE-AREA-REF>
                        <CAN-ENTER-EXCLUSIVE-AREA-REF DEST="EXCLUSIVE-AREA">/AUTOSAR_Eth_43_PFE/BswModuleDescriptions/Eth/InternalBehavior_0/ETH_EXCLUSIVE_AREA_100</CAN-ENTER-EXCLUSIVE-AREA-REF>
                        <CAN-ENTER-EXCLUSIVE-AREA-REF DEST="EXCLUSIVE-AREA">/AUTOSAR_Eth_43_PFE/BswModuleDescriptions/Eth/InternalBehavior_0/ETH_EXCLUSIVE_AREA_101</CAN-ENTER-EXCLUSIVE-AREA-REF>
                      </CAN-ENTER-EXCLUSIVE-AREA-REFS>
                      <MINIMUM-START-INTERVAL>0.0</MINIMUM-START-INTERVAL>
                      <IMPLEMENTED-ENTRY-REF DEST="BSW-MODULE-ENTRY">/AUTOSAR_Eth_43_PFE/BswModuleEntrys/Eth_ReadMii45</IMPLEMENTED-ENTRY-REF>
                    </BSW-CALLED-ENTITY>
                      [!ENDIF!][!//
                    [!ENDIF!][!//
                    [!IF "EthGeneral/EthGetCounterValuesApi = 'true'"!][!//
                    <BSW-CALLED-ENTITY>
                      <SHORT-NAME>Eth_43_PFE_GetCounterValues</SHORT-NAME>
                      <CAN-ENTER-EXCLUSIVE-AREA-REFS>
                        <CAN-ENTER-EXCLUSIVE-AREA-REF DEST="EXCLUSIVE-AREA">/AUTOSAR_Eth_43_PFE/BswModuleDescriptions/Eth/InternalBehavior_0/ETH_EXCLUSIVE_AREA_95</CAN-ENTER-EXCLUSIVE-AREA-REF>
                        <CAN-ENTER-EXCLUSIVE-AREA-REF DEST="EXCLUSIVE-AREA">/AUTOSAR_Eth_43_PFE/BswModuleDescriptions/Eth/InternalBehavior_0/ETH_EXCLUSIVE_AREA_100</CAN-ENTER-EXCLUSIVE-AREA-REF>
                        <CAN-ENTER-EXCLUSIVE-AREA-REF DEST="EXCLUSIVE-AREA">/AUTOSAR_Eth_43_PFE/BswModuleDescriptions/Eth/InternalBehavior_0/ETH_EXCLUSIVE_AREA_101</CAN-ENTER-EXCLUSIVE-AREA-REF>
                      </CAN-ENTER-EXCLUSIVE-AREA-REFS>
                      <MINIMUM-START-INTERVAL>0.0</MINIMUM-START-INTERVAL>
                      <IMPLEMENTED-ENTRY-REF DEST="BSW-MODULE-ENTRY">/AUTOSAR_Eth_43_PFE/BswModuleEntrys/Eth_GetCounterValues</IMPLEMENTED-ENTRY-REF>
                    </BSW-CALLED-ENTITY>
                    [!ENDIF!][!//
                    [!IF "EthGeneral/EthGetClassStatisticApi = 'true'"!][!//
                    <BSW-CALLED-ENTITY>
                      <SHORT-NAME>Eth_43_PFE_GetClassStats</SHORT-NAME>
                      <CAN-ENTER-EXCLUSIVE-AREA-REFS>
                        <CAN-ENTER-EXCLUSIVE-AREA-REF DEST="EXCLUSIVE-AREA">/AUTOSAR_Eth_43_PFE/BswModuleDescriptions/Eth/InternalBehavior_0/ETH_EXCLUSIVE_AREA_28</CAN-ENTER-EXCLUSIVE-AREA-REF>
                        <CAN-ENTER-EXCLUSIVE-AREA-REF DEST="EXCLUSIVE-AREA">/AUTOSAR_Eth_43_PFE/BswModuleDescriptions/Eth/InternalBehavior_0/ETH_EXCLUSIVE_AREA_95</CAN-ENTER-EXCLUSIVE-AREA-REF>
                        <CAN-ENTER-EXCLUSIVE-AREA-REF DEST="EXCLUSIVE-AREA">/AUTOSAR_Eth_43_PFE/BswModuleDescriptions/Eth/InternalBehavior_0/ETH_EXCLUSIVE_AREA_100</CAN-ENTER-EXCLUSIVE-AREA-REF>
                        <CAN-ENTER-EXCLUSIVE-AREA-REF DEST="EXCLUSIVE-AREA">/AUTOSAR_Eth_43_PFE/BswModuleDescriptions/Eth/InternalBehavior_0/ETH_EXCLUSIVE_AREA_101</CAN-ENTER-EXCLUSIVE-AREA-REF>
                      </CAN-ENTER-EXCLUSIVE-AREA-REFS>
                      <MINIMUM-START-INTERVAL>0.0</MINIMUM-START-INTERVAL>
                      <IMPLEMENTED-ENTRY-REF DEST="BSW-MODULE-ENTRY">/AUTOSAR_Eth_43_PFE/BswModuleEntrys/Eth_GetClassStats</IMPLEMENTED-ENTRY-REF>
                    </BSW-CALLED-ENTITY>
                    [!ENDIF!][!//
                    [!IF "EthGeneral/EthGetRxStatsApi = 'true'"!][!//
                    <BSW-CALLED-ENTITY>
                      <SHORT-NAME>Eth_43_PFE_GetRxStats</SHORT-NAME>
                      <CAN-ENTER-EXCLUSIVE-AREA-REFS>
                        <CAN-ENTER-EXCLUSIVE-AREA-REF DEST="EXCLUSIVE-AREA">/AUTOSAR_Eth_43_PFE/BswModuleDescriptions/Eth/InternalBehavior_0/ETH_EXCLUSIVE_AREA_95</CAN-ENTER-EXCLUSIVE-AREA-REF>
                        <CAN-ENTER-EXCLUSIVE-AREA-REF DEST="EXCLUSIVE-AREA">/AUTOSAR_Eth_43_PFE/BswModuleDescriptions/Eth/InternalBehavior_0/ETH_EXCLUSIVE_AREA_100</CAN-ENTER-EXCLUSIVE-AREA-REF>
                        <CAN-ENTER-EXCLUSIVE-AREA-REF DEST="EXCLUSIVE-AREA">/AUTOSAR_Eth_43_PFE/BswModuleDescriptions/Eth/InternalBehavior_0/ETH_EXCLUSIVE_AREA_101</CAN-ENTER-EXCLUSIVE-AREA-REF>
                      </CAN-ENTER-EXCLUSIVE-AREA-REFS>
                      <MINIMUM-START-INTERVAL>0.0</MINIMUM-START-INTERVAL>
                      <IMPLEMENTED-ENTRY-REF DEST="BSW-MODULE-ENTRY">/AUTOSAR_Eth_43_PFE/BswModuleEntrys/Eth_GetRxStats</IMPLEMENTED-ENTRY-REF>
                    </BSW-CALLED-ENTITY>
                    [!ENDIF!][!//
                    [!IF "EthGeneral/EthGetTxStatsApi = 'true'"!][!//
                    <BSW-CALLED-ENTITY>
                      <SHORT-NAME>Eth_43_PFE_GetTxStats</SHORT-NAME>
                      <CAN-ENTER-EXCLUSIVE-AREA-REFS>
                        <CAN-ENTER-EXCLUSIVE-AREA-REF DEST="EXCLUSIVE-AREA">/AUTOSAR_Eth_43_PFE/BswModuleDescriptions/Eth/InternalBehavior_0/ETH_EXCLUSIVE_AREA_95</CAN-ENTER-EXCLUSIVE-AREA-REF>
                        <CAN-ENTER-EXCLUSIVE-AREA-REF DEST="EXCLUSIVE-AREA">/AUTOSAR_Eth_43_PFE/BswModuleDescriptions/Eth/InternalBehavior_0/ETH_EXCLUSIVE_AREA_100</CAN-ENTER-EXCLUSIVE-AREA-REF>
                        <CAN-ENTER-EXCLUSIVE-AREA-REF DEST="EXCLUSIVE-AREA">/AUTOSAR_Eth_43_PFE/BswModuleDescriptions/Eth/InternalBehavior_0/ETH_EXCLUSIVE_AREA_101</CAN-ENTER-EXCLUSIVE-AREA-REF>
                      </CAN-ENTER-EXCLUSIVE-AREA-REFS>
                      <MINIMUM-START-INTERVAL>0.0</MINIMUM-START-INTERVAL>
                      <IMPLEMENTED-ENTRY-REF DEST="BSW-MODULE-ENTRY">/AUTOSAR_Eth_43_PFE/BswModuleEntrys/Eth_GetTxStats</IMPLEMENTED-ENTRY-REF>
                    </BSW-CALLED-ENTITY>
                    [!ENDIF!][!//
                    [!IF "EthGeneral/EthGetTxErrorCounterValuesApi = 'true'"!][!//
                    <BSW-CALLED-ENTITY>
                      <SHORT-NAME>Eth_43_PFE_GetTxErrorCounterValues</SHORT-NAME>
                      <CAN-ENTER-EXCLUSIVE-AREA-REFS>
                        <CAN-ENTER-EXCLUSIVE-AREA-REF DEST="EXCLUSIVE-AREA">/AUTOSAR_Eth_43_PFE/BswModuleDescriptions/Eth/InternalBehavior_0/ETH_EXCLUSIVE_AREA_95</CAN-ENTER-EXCLUSIVE-AREA-REF>
                        <CAN-ENTER-EXCLUSIVE-AREA-REF DEST="EXCLUSIVE-AREA">/AUTOSAR_Eth_43_PFE/BswModuleDescriptions/Eth/InternalBehavior_0/ETH_EXCLUSIVE_AREA_100</CAN-ENTER-EXCLUSIVE-AREA-REF>
                        <CAN-ENTER-EXCLUSIVE-AREA-REF DEST="EXCLUSIVE-AREA">/AUTOSAR_Eth_43_PFE/BswModuleDescriptions/Eth/InternalBehavior_0/ETH_EXCLUSIVE_AREA_101</CAN-ENTER-EXCLUSIVE-AREA-REF>
                      </CAN-ENTER-EXCLUSIVE-AREA-REFS>
                      <MINIMUM-START-INTERVAL>0.0</MINIMUM-START-INTERVAL>
                      <IMPLEMENTED-ENTRY-REF DEST="BSW-MODULE-ENTRY">/AUTOSAR_Eth_43_PFE/BswModuleEntrys/Eth_GetTxErrorCounterValues</IMPLEMENTED-ENTRY-REF>
                    </BSW-CALLED-ENTITY>
                    [!ENDIF!][!//
                    [!IF "EthGeneral/EthGlobalTimeSupport = 'true'"!][!//
                    <BSW-CALLED-ENTITY>
                      <SHORT-NAME>Eth_43_PFE_GetEgressTimeStamp</SHORT-NAME>
                      <MINIMUM-START-INTERVAL>0.0</MINIMUM-START-INTERVAL>
                      <IMPLEMENTED-ENTRY-REF DEST="BSW-MODULE-ENTRY">/AUTOSAR_Eth_43_PFE/BswModuleEntrys/Eth_GetEgressTimeStamp</IMPLEMENTED-ENTRY-REF>
                    </BSW-CALLED-ENTITY>
                    <BSW-CALLED-ENTITY>
                      <SHORT-NAME>Eth_43_PFE_GetIngressTimeStamp</SHORT-NAME>
                      <CAN-ENTER-EXCLUSIVE-AREA-REFS>
                        <CAN-ENTER-EXCLUSIVE-AREA-REF DEST="EXCLUSIVE-AREA">/AUTOSAR_Eth_43_PFE/BswModuleDescriptions/Eth/InternalBehavior_0/ETH_EXCLUSIVE_AREA_40</CAN-ENTER-EXCLUSIVE-AREA-REF>
                        <CAN-ENTER-EXCLUSIVE-AREA-REF DEST="EXCLUSIVE-AREA">/AUTOSAR_Eth_43_PFE/BswModuleDescriptions/Eth/InternalBehavior_0/ETH_EXCLUSIVE_AREA_95</CAN-ENTER-EXCLUSIVE-AREA-REF>
                        <CAN-ENTER-EXCLUSIVE-AREA-REF DEST="EXCLUSIVE-AREA">/AUTOSAR_Eth_43_PFE/BswModuleDescriptions/Eth/InternalBehavior_0/ETH_EXCLUSIVE_AREA_100</CAN-ENTER-EXCLUSIVE-AREA-REF>
                        <CAN-ENTER-EXCLUSIVE-AREA-REF DEST="EXCLUSIVE-AREA">/AUTOSAR_Eth_43_PFE/BswModuleDescriptions/Eth/InternalBehavior_0/ETH_EXCLUSIVE_AREA_101</CAN-ENTER-EXCLUSIVE-AREA-REF>
                      </CAN-ENTER-EXCLUSIVE-AREA-REFS>
                      <MINIMUM-START-INTERVAL>0.0</MINIMUM-START-INTERVAL>
                      <IMPLEMENTED-ENTRY-REF DEST="BSW-MODULE-ENTRY">/AUTOSAR_Eth_43_PFE/BswModuleEntrys/Eth_GetIngressTimeStamp</IMPLEMENTED-ENTRY-REF>
                    </BSW-CALLED-ENTITY>
                    <BSW-CALLED-ENTITY>
                      <SHORT-NAME>Eth_43_PFE_GetCurrentTime</SHORT-NAME>
                      <CAN-ENTER-EXCLUSIVE-AREA-REFS>
                        <CAN-ENTER-EXCLUSIVE-AREA-REF DEST="EXCLUSIVE-AREA">/AUTOSAR_Eth_43_PFE/BswModuleDescriptions/Eth/InternalBehavior_0/ETH_EXCLUSIVE_AREA_95</CAN-ENTER-EXCLUSIVE-AREA-REF>
                        <CAN-ENTER-EXCLUSIVE-AREA-REF DEST="EXCLUSIVE-AREA">/AUTOSAR_Eth_43_PFE/BswModuleDescriptions/Eth/InternalBehavior_0/ETH_EXCLUSIVE_AREA_100</CAN-ENTER-EXCLUSIVE-AREA-REF>
                        <CAN-ENTER-EXCLUSIVE-AREA-REF DEST="EXCLUSIVE-AREA">/AUTOSAR_Eth_43_PFE/BswModuleDescriptions/Eth/InternalBehavior_0/ETH_EXCLUSIVE_AREA_101</CAN-ENTER-EXCLUSIVE-AREA-REF>
                      </CAN-ENTER-EXCLUSIVE-AREA-REFS>
                      <MINIMUM-START-INTERVAL>0.0</MINIMUM-START-INTERVAL>
                      <IMPLEMENTED-ENTRY-REF DEST="BSW-MODULE-ENTRY">/AUTOSAR_Eth_43_PFE/BswModuleEntrys/Eth_GetCurrentTime</IMPLEMENTED-ENTRY-REF>
                    </BSW-CALLED-ENTITY>
                      [!IF "EthGeneral/EthVendorSpecific/EthPfeMultiInstance = 'false' or EthGeneral/EthVendorSpecific/EthPfeSlaveMode = 'false'"!][!//
                    <BSW-CALLED-ENTITY>
                      <SHORT-NAME>Eth_43_PFE_SetGlobalTime</SHORT-NAME>
                      <CAN-ENTER-EXCLUSIVE-AREA-REFS>
                        <CAN-ENTER-EXCLUSIVE-AREA-REF DEST="EXCLUSIVE-AREA">/AUTOSAR_Eth_43_PFE/BswModuleDescriptions/Eth/InternalBehavior_0/ETH_EXCLUSIVE_AREA_64</CAN-ENTER-EXCLUSIVE-AREA-REF>
                        <CAN-ENTER-EXCLUSIVE-AREA-REF DEST="EXCLUSIVE-AREA">/AUTOSAR_Eth_43_PFE/BswModuleDescriptions/Eth/InternalBehavior_0/ETH_EXCLUSIVE_AREA_95</CAN-ENTER-EXCLUSIVE-AREA-REF>
                        <CAN-ENTER-EXCLUSIVE-AREA-REF DEST="EXCLUSIVE-AREA">/AUTOSAR_Eth_43_PFE/BswModuleDescriptions/Eth/InternalBehavior_0/ETH_EXCLUSIVE_AREA_100</CAN-ENTER-EXCLUSIVE-AREA-REF>
                        <CAN-ENTER-EXCLUSIVE-AREA-REF DEST="EXCLUSIVE-AREA">/AUTOSAR_Eth_43_PFE/BswModuleDescriptions/Eth/InternalBehavior_0/ETH_EXCLUSIVE_AREA_101</CAN-ENTER-EXCLUSIVE-AREA-REF>
                      </CAN-ENTER-EXCLUSIVE-AREA-REFS>
                      <MINIMUM-START-INTERVAL>0.0</MINIMUM-START-INTERVAL>
                      <IMPLEMENTED-ENTRY-REF DEST="BSW-MODULE-ENTRY">/AUTOSAR_Eth_43_PFE/BswModuleEntrys/Eth_SetGlobalTime</IMPLEMENTED-ENTRY-REF>
                    </BSW-CALLED-ENTITY>
                    <BSW-CALLED-ENTITY>
                      <SHORT-NAME>Eth_43_PFE_SetCorrectionTime</SHORT-NAME>
                      <CAN-ENTER-EXCLUSIVE-AREA-REFS>
                        <CAN-ENTER-EXCLUSIVE-AREA-REF DEST="EXCLUSIVE-AREA">/AUTOSAR_Eth_43_PFE/BswModuleDescriptions/Eth/InternalBehavior_0/ETH_EXCLUSIVE_AREA_62</CAN-ENTER-EXCLUSIVE-AREA-REF>
                        <CAN-ENTER-EXCLUSIVE-AREA-REF DEST="EXCLUSIVE-AREA">/AUTOSAR_Eth_43_PFE/BswModuleDescriptions/Eth/InternalBehavior_0/ETH_EXCLUSIVE_AREA_63</CAN-ENTER-EXCLUSIVE-AREA-REF>
                        <CAN-ENTER-EXCLUSIVE-AREA-REF DEST="EXCLUSIVE-AREA">/AUTOSAR_Eth_43_PFE/BswModuleDescriptions/Eth/InternalBehavior_0/ETH_EXCLUSIVE_AREA_95</CAN-ENTER-EXCLUSIVE-AREA-REF>
                        <CAN-ENTER-EXCLUSIVE-AREA-REF DEST="EXCLUSIVE-AREA">/AUTOSAR_Eth_43_PFE/BswModuleDescriptions/Eth/InternalBehavior_0/ETH_EXCLUSIVE_AREA_100</CAN-ENTER-EXCLUSIVE-AREA-REF>
                        <CAN-ENTER-EXCLUSIVE-AREA-REF DEST="EXCLUSIVE-AREA">/AUTOSAR_Eth_43_PFE/BswModuleDescriptions/Eth/InternalBehavior_0/ETH_EXCLUSIVE_AREA_101</CAN-ENTER-EXCLUSIVE-AREA-REF>
                      </CAN-ENTER-EXCLUSIVE-AREA-REFS>
                      <MINIMUM-START-INTERVAL>0.0</MINIMUM-START-INTERVAL>
                      <IMPLEMENTED-ENTRY-REF DEST="BSW-MODULE-ENTRY">/AUTOSAR_Eth_43_PFE/BswModuleEntrys/Eth_SetCorrectionTime</IMPLEMENTED-ENTRY-REF>
                    </BSW-CALLED-ENTITY>
                      [!ENDIF!][!//
                    <BSW-CALLED-ENTITY>
                      <SHORT-NAME>Eth_43_PFE_EnableEgressTimeStamp</SHORT-NAME>
                      <MINIMUM-START-INTERVAL>0.0</MINIMUM-START-INTERVAL>
                      <IMPLEMENTED-ENTRY-REF DEST="BSW-MODULE-ENTRY">/AUTOSAR_Eth_43_PFE/BswModuleEntrys/Eth_EnableEgressTimeStamp</IMPLEMENTED-ENTRY-REF>
                    </BSW-CALLED-ENTITY>
                    [!ENDIF!][!//
                    [!IF "EthGeneral/EthVendorSpecific/PfeEnableFCI = 'true'"!][!//
                    <BSW-CALLED-ENTITY>
                      <SHORT-NAME>fci_open</SHORT-NAME>
                      <MINIMUM-START-INTERVAL>0.0</MINIMUM-START-INTERVAL>
                      <IMPLEMENTED-ENTRY-REF DEST="BSW-MODULE-ENTRY">/AUTOSAR_Eth_43_PFE/BswModuleEntrys/fci_open</IMPLEMENTED-ENTRY-REF>
                    </BSW-CALLED-ENTITY>
                    <BSW-CALLED-ENTITY>
                      <SHORT-NAME>fci_close</SHORT-NAME>
                      <CAN-ENTER-EXCLUSIVE-AREA-REFS>
                        <CAN-ENTER-EXCLUSIVE-AREA-REF DEST="EXCLUSIVE-AREA">/AUTOSAR_Eth_43_PFE/BswModuleDescriptions/Eth/InternalBehavior_0/ETH_EXCLUSIVE_AREA_95</CAN-ENTER-EXCLUSIVE-AREA-REF>
                        <CAN-ENTER-EXCLUSIVE-AREA-REF DEST="EXCLUSIVE-AREA">/AUTOSAR_Eth_43_PFE/BswModuleDescriptions/Eth/InternalBehavior_0/ETH_EXCLUSIVE_AREA_101</CAN-ENTER-EXCLUSIVE-AREA-REF>
                      </CAN-ENTER-EXCLUSIVE-AREA-REFS>
                      <MINIMUM-START-INTERVAL>0.0</MINIMUM-START-INTERVAL>
                      <IMPLEMENTED-ENTRY-REF DEST="BSW-MODULE-ENTRY">/AUTOSAR_Eth_43_PFE/BswModuleEntrys/fci_close</IMPLEMENTED-ENTRY-REF>
                    </BSW-CALLED-ENTITY>
                    <BSW-CALLED-ENTITY>
                      <SHORT-NAME>fci_catch</SHORT-NAME>
                      <CAN-ENTER-EXCLUSIVE-AREA-REFS>
                        <CAN-ENTER-EXCLUSIVE-AREA-REF DEST="EXCLUSIVE-AREA">/AUTOSAR_Eth_43_PFE/BswModuleDescriptions/Eth/InternalBehavior_0/ETH_EXCLUSIVE_AREA_95</CAN-ENTER-EXCLUSIVE-AREA-REF>
                        <CAN-ENTER-EXCLUSIVE-AREA-REF DEST="EXCLUSIVE-AREA">/AUTOSAR_Eth_43_PFE/BswModuleDescriptions/Eth/InternalBehavior_0/ETH_EXCLUSIVE_AREA_96</CAN-ENTER-EXCLUSIVE-AREA-REF>
                        <CAN-ENTER-EXCLUSIVE-AREA-REF DEST="EXCLUSIVE-AREA">/AUTOSAR_Eth_43_PFE/BswModuleDescriptions/Eth/InternalBehavior_0/ETH_EXCLUSIVE_AREA_100</CAN-ENTER-EXCLUSIVE-AREA-REF>
                        <CAN-ENTER-EXCLUSIVE-AREA-REF DEST="EXCLUSIVE-AREA">/AUTOSAR_Eth_43_PFE/BswModuleDescriptions/Eth/InternalBehavior_0/ETH_EXCLUSIVE_AREA_101</CAN-ENTER-EXCLUSIVE-AREA-REF>
                      </CAN-ENTER-EXCLUSIVE-AREA-REFS>
                      <MINIMUM-START-INTERVAL>0.0</MINIMUM-START-INTERVAL>
                      <IMPLEMENTED-ENTRY-REF DEST="BSW-MODULE-ENTRY">/AUTOSAR_Eth_43_PFE/BswModuleEntrys/fci_catch</IMPLEMENTED-ENTRY-REF>
                    </BSW-CALLED-ENTITY>
                    <BSW-CALLED-ENTITY>
                      <SHORT-NAME>fci_cmd</SHORT-NAME>
                      <CAN-ENTER-EXCLUSIVE-AREA-REFS>
                        <CAN-ENTER-EXCLUSIVE-AREA-REF DEST="EXCLUSIVE-AREA">/AUTOSAR_Eth_43_PFE/BswModuleDescriptions/Eth/InternalBehavior_0/ETH_EXCLUSIVE_AREA_01</CAN-ENTER-EXCLUSIVE-AREA-REF>
                        <CAN-ENTER-EXCLUSIVE-AREA-REF DEST="EXCLUSIVE-AREA">/AUTOSAR_Eth_43_PFE/BswModuleDescriptions/Eth/InternalBehavior_0/ETH_EXCLUSIVE_AREA_03</CAN-ENTER-EXCLUSIVE-AREA-REF>
                        <CAN-ENTER-EXCLUSIVE-AREA-REF DEST="EXCLUSIVE-AREA">/AUTOSAR_Eth_43_PFE/BswModuleDescriptions/Eth/InternalBehavior_0/ETH_EXCLUSIVE_AREA_04</CAN-ENTER-EXCLUSIVE-AREA-REF>
                        <CAN-ENTER-EXCLUSIVE-AREA-REF DEST="EXCLUSIVE-AREA">/AUTOSAR_Eth_43_PFE/BswModuleDescriptions/Eth/InternalBehavior_0/ETH_EXCLUSIVE_AREA_05</CAN-ENTER-EXCLUSIVE-AREA-REF>
                        <CAN-ENTER-EXCLUSIVE-AREA-REF DEST="EXCLUSIVE-AREA">/AUTOSAR_Eth_43_PFE/BswModuleDescriptions/Eth/InternalBehavior_0/ETH_EXCLUSIVE_AREA_07</CAN-ENTER-EXCLUSIVE-AREA-REF>
                        <CAN-ENTER-EXCLUSIVE-AREA-REF DEST="EXCLUSIVE-AREA">/AUTOSAR_Eth_43_PFE/BswModuleDescriptions/Eth/InternalBehavior_0/ETH_EXCLUSIVE_AREA_08</CAN-ENTER-EXCLUSIVE-AREA-REF>
                        <CAN-ENTER-EXCLUSIVE-AREA-REF DEST="EXCLUSIVE-AREA">/AUTOSAR_Eth_43_PFE/BswModuleDescriptions/Eth/InternalBehavior_0/ETH_EXCLUSIVE_AREA_09</CAN-ENTER-EXCLUSIVE-AREA-REF>
                        <CAN-ENTER-EXCLUSIVE-AREA-REF DEST="EXCLUSIVE-AREA">/AUTOSAR_Eth_43_PFE/BswModuleDescriptions/Eth/InternalBehavior_0/ETH_EXCLUSIVE_AREA_10</CAN-ENTER-EXCLUSIVE-AREA-REF>
                        <CAN-ENTER-EXCLUSIVE-AREA-REF DEST="EXCLUSIVE-AREA">/AUTOSAR_Eth_43_PFE/BswModuleDescriptions/Eth/InternalBehavior_0/ETH_EXCLUSIVE_AREA_13</CAN-ENTER-EXCLUSIVE-AREA-REF>
                        <CAN-ENTER-EXCLUSIVE-AREA-REF DEST="EXCLUSIVE-AREA">/AUTOSAR_Eth_43_PFE/BswModuleDescriptions/Eth/InternalBehavior_0/ETH_EXCLUSIVE_AREA_14</CAN-ENTER-EXCLUSIVE-AREA-REF>
                        <CAN-ENTER-EXCLUSIVE-AREA-REF DEST="EXCLUSIVE-AREA">/AUTOSAR_Eth_43_PFE/BswModuleDescriptions/Eth/InternalBehavior_0/ETH_EXCLUSIVE_AREA_15</CAN-ENTER-EXCLUSIVE-AREA-REF>
                        <CAN-ENTER-EXCLUSIVE-AREA-REF DEST="EXCLUSIVE-AREA">/AUTOSAR_Eth_43_PFE/BswModuleDescriptions/Eth/InternalBehavior_0/ETH_EXCLUSIVE_AREA_16</CAN-ENTER-EXCLUSIVE-AREA-REF>
                        <CAN-ENTER-EXCLUSIVE-AREA-REF DEST="EXCLUSIVE-AREA">/AUTOSAR_Eth_43_PFE/BswModuleDescriptions/Eth/InternalBehavior_0/ETH_EXCLUSIVE_AREA_18</CAN-ENTER-EXCLUSIVE-AREA-REF>
                        <CAN-ENTER-EXCLUSIVE-AREA-REF DEST="EXCLUSIVE-AREA">/AUTOSAR_Eth_43_PFE/BswModuleDescriptions/Eth/InternalBehavior_0/ETH_EXCLUSIVE_AREA_20</CAN-ENTER-EXCLUSIVE-AREA-REF>
                        <CAN-ENTER-EXCLUSIVE-AREA-REF DEST="EXCLUSIVE-AREA">/AUTOSAR_Eth_43_PFE/BswModuleDescriptions/Eth/InternalBehavior_0/ETH_EXCLUSIVE_AREA_21</CAN-ENTER-EXCLUSIVE-AREA-REF>
                        <CAN-ENTER-EXCLUSIVE-AREA-REF DEST="EXCLUSIVE-AREA">/AUTOSAR_Eth_43_PFE/BswModuleDescriptions/Eth/InternalBehavior_0/ETH_EXCLUSIVE_AREA_22</CAN-ENTER-EXCLUSIVE-AREA-REF>
                        <CAN-ENTER-EXCLUSIVE-AREA-REF DEST="EXCLUSIVE-AREA">/AUTOSAR_Eth_43_PFE/BswModuleDescriptions/Eth/InternalBehavior_0/ETH_EXCLUSIVE_AREA_23</CAN-ENTER-EXCLUSIVE-AREA-REF>
                        <CAN-ENTER-EXCLUSIVE-AREA-REF DEST="EXCLUSIVE-AREA">/AUTOSAR_Eth_43_PFE/BswModuleDescriptions/Eth/InternalBehavior_0/ETH_EXCLUSIVE_AREA_26</CAN-ENTER-EXCLUSIVE-AREA-REF>
                        <CAN-ENTER-EXCLUSIVE-AREA-REF DEST="EXCLUSIVE-AREA">/AUTOSAR_Eth_43_PFE/BswModuleDescriptions/Eth/InternalBehavior_0/ETH_EXCLUSIVE_AREA_28</CAN-ENTER-EXCLUSIVE-AREA-REF>
                        <CAN-ENTER-EXCLUSIVE-AREA-REF DEST="EXCLUSIVE-AREA">/AUTOSAR_Eth_43_PFE/BswModuleDescriptions/Eth/InternalBehavior_0/ETH_EXCLUSIVE_AREA_30</CAN-ENTER-EXCLUSIVE-AREA-REF>
                        <CAN-ENTER-EXCLUSIVE-AREA-REF DEST="EXCLUSIVE-AREA">/AUTOSAR_Eth_43_PFE/BswModuleDescriptions/Eth/InternalBehavior_0/ETH_EXCLUSIVE_AREA_31</CAN-ENTER-EXCLUSIVE-AREA-REF>
                        <CAN-ENTER-EXCLUSIVE-AREA-REF DEST="EXCLUSIVE-AREA">/AUTOSAR_Eth_43_PFE/BswModuleDescriptions/Eth/InternalBehavior_0/ETH_EXCLUSIVE_AREA_38</CAN-ENTER-EXCLUSIVE-AREA-REF>
                        <CAN-ENTER-EXCLUSIVE-AREA-REF DEST="EXCLUSIVE-AREA">/AUTOSAR_Eth_43_PFE/BswModuleDescriptions/Eth/InternalBehavior_0/ETH_EXCLUSIVE_AREA_39</CAN-ENTER-EXCLUSIVE-AREA-REF>
                        <CAN-ENTER-EXCLUSIVE-AREA-REF DEST="EXCLUSIVE-AREA">/AUTOSAR_Eth_43_PFE/BswModuleDescriptions/Eth/InternalBehavior_0/ETH_EXCLUSIVE_AREA_40</CAN-ENTER-EXCLUSIVE-AREA-REF>
                        <CAN-ENTER-EXCLUSIVE-AREA-REF DEST="EXCLUSIVE-AREA">/AUTOSAR_Eth_43_PFE/BswModuleDescriptions/Eth/InternalBehavior_0/ETH_EXCLUSIVE_AREA_45</CAN-ENTER-EXCLUSIVE-AREA-REF>
                        <CAN-ENTER-EXCLUSIVE-AREA-REF DEST="EXCLUSIVE-AREA">/AUTOSAR_Eth_43_PFE/BswModuleDescriptions/Eth/InternalBehavior_0/ETH_EXCLUSIVE_AREA_46</CAN-ENTER-EXCLUSIVE-AREA-REF>
                        <CAN-ENTER-EXCLUSIVE-AREA-REF DEST="EXCLUSIVE-AREA">/AUTOSAR_Eth_43_PFE/BswModuleDescriptions/Eth/InternalBehavior_0/ETH_EXCLUSIVE_AREA_47</CAN-ENTER-EXCLUSIVE-AREA-REF>
                        <CAN-ENTER-EXCLUSIVE-AREA-REF DEST="EXCLUSIVE-AREA">/AUTOSAR_Eth_43_PFE/BswModuleDescriptions/Eth/InternalBehavior_0/ETH_EXCLUSIVE_AREA_48</CAN-ENTER-EXCLUSIVE-AREA-REF>
                        <CAN-ENTER-EXCLUSIVE-AREA-REF DEST="EXCLUSIVE-AREA">/AUTOSAR_Eth_43_PFE/BswModuleDescriptions/Eth/InternalBehavior_0/ETH_EXCLUSIVE_AREA_54</CAN-ENTER-EXCLUSIVE-AREA-REF>
                        <CAN-ENTER-EXCLUSIVE-AREA-REF DEST="EXCLUSIVE-AREA">/AUTOSAR_Eth_43_PFE/BswModuleDescriptions/Eth/InternalBehavior_0/ETH_EXCLUSIVE_AREA_58</CAN-ENTER-EXCLUSIVE-AREA-REF>
                        <CAN-ENTER-EXCLUSIVE-AREA-REF DEST="EXCLUSIVE-AREA">/AUTOSAR_Eth_43_PFE/BswModuleDescriptions/Eth/InternalBehavior_0/ETH_EXCLUSIVE_AREA_59</CAN-ENTER-EXCLUSIVE-AREA-REF>
                        <CAN-ENTER-EXCLUSIVE-AREA-REF DEST="EXCLUSIVE-AREA">/AUTOSAR_Eth_43_PFE/BswModuleDescriptions/Eth/InternalBehavior_0/ETH_EXCLUSIVE_AREA_65</CAN-ENTER-EXCLUSIVE-AREA-REF>
                        <CAN-ENTER-EXCLUSIVE-AREA-REF DEST="EXCLUSIVE-AREA">/AUTOSAR_Eth_43_PFE/BswModuleDescriptions/Eth/InternalBehavior_0/ETH_EXCLUSIVE_AREA_66</CAN-ENTER-EXCLUSIVE-AREA-REF>
                        <CAN-ENTER-EXCLUSIVE-AREA-REF DEST="EXCLUSIVE-AREA">/AUTOSAR_Eth_43_PFE/BswModuleDescriptions/Eth/InternalBehavior_0/ETH_EXCLUSIVE_AREA_67</CAN-ENTER-EXCLUSIVE-AREA-REF>
                        <CAN-ENTER-EXCLUSIVE-AREA-REF DEST="EXCLUSIVE-AREA">/AUTOSAR_Eth_43_PFE/BswModuleDescriptions/Eth/InternalBehavior_0/ETH_EXCLUSIVE_AREA_68</CAN-ENTER-EXCLUSIVE-AREA-REF>
                        <CAN-ENTER-EXCLUSIVE-AREA-REF DEST="EXCLUSIVE-AREA">/AUTOSAR_Eth_43_PFE/BswModuleDescriptions/Eth/InternalBehavior_0/ETH_EXCLUSIVE_AREA_69</CAN-ENTER-EXCLUSIVE-AREA-REF>
                        <CAN-ENTER-EXCLUSIVE-AREA-REF DEST="EXCLUSIVE-AREA">/AUTOSAR_Eth_43_PFE/BswModuleDescriptions/Eth/InternalBehavior_0/ETH_EXCLUSIVE_AREA_70</CAN-ENTER-EXCLUSIVE-AREA-REF>
                        <CAN-ENTER-EXCLUSIVE-AREA-REF DEST="EXCLUSIVE-AREA">/AUTOSAR_Eth_43_PFE/BswModuleDescriptions/Eth/InternalBehavior_0/ETH_EXCLUSIVE_AREA_71</CAN-ENTER-EXCLUSIVE-AREA-REF>
                        <CAN-ENTER-EXCLUSIVE-AREA-REF DEST="EXCLUSIVE-AREA">/AUTOSAR_Eth_43_PFE/BswModuleDescriptions/Eth/InternalBehavior_0/ETH_EXCLUSIVE_AREA_72</CAN-ENTER-EXCLUSIVE-AREA-REF>
                        <CAN-ENTER-EXCLUSIVE-AREA-REF DEST="EXCLUSIVE-AREA">/AUTOSAR_Eth_43_PFE/BswModuleDescriptions/Eth/InternalBehavior_0/ETH_EXCLUSIVE_AREA_73</CAN-ENTER-EXCLUSIVE-AREA-REF>
                        <CAN-ENTER-EXCLUSIVE-AREA-REF DEST="EXCLUSIVE-AREA">/AUTOSAR_Eth_43_PFE/BswModuleDescriptions/Eth/InternalBehavior_0/ETH_EXCLUSIVE_AREA_74</CAN-ENTER-EXCLUSIVE-AREA-REF>
                        <CAN-ENTER-EXCLUSIVE-AREA-REF DEST="EXCLUSIVE-AREA">/AUTOSAR_Eth_43_PFE/BswModuleDescriptions/Eth/InternalBehavior_0/ETH_EXCLUSIVE_AREA_77</CAN-ENTER-EXCLUSIVE-AREA-REF>
                        <CAN-ENTER-EXCLUSIVE-AREA-REF DEST="EXCLUSIVE-AREA">/AUTOSAR_Eth_43_PFE/BswModuleDescriptions/Eth/InternalBehavior_0/ETH_EXCLUSIVE_AREA_78</CAN-ENTER-EXCLUSIVE-AREA-REF>
                        <CAN-ENTER-EXCLUSIVE-AREA-REF DEST="EXCLUSIVE-AREA">/AUTOSAR_Eth_43_PFE/BswModuleDescriptions/Eth/InternalBehavior_0/ETH_EXCLUSIVE_AREA_79</CAN-ENTER-EXCLUSIVE-AREA-REF>
                        <CAN-ENTER-EXCLUSIVE-AREA-REF DEST="EXCLUSIVE-AREA">/AUTOSAR_Eth_43_PFE/BswModuleDescriptions/Eth/InternalBehavior_0/ETH_EXCLUSIVE_AREA_81</CAN-ENTER-EXCLUSIVE-AREA-REF>
                        <CAN-ENTER-EXCLUSIVE-AREA-REF DEST="EXCLUSIVE-AREA">/AUTOSAR_Eth_43_PFE/BswModuleDescriptions/Eth/InternalBehavior_0/ETH_EXCLUSIVE_AREA_82</CAN-ENTER-EXCLUSIVE-AREA-REF>
                        <CAN-ENTER-EXCLUSIVE-AREA-REF DEST="EXCLUSIVE-AREA">/AUTOSAR_Eth_43_PFE/BswModuleDescriptions/Eth/InternalBehavior_0/ETH_EXCLUSIVE_AREA_85</CAN-ENTER-EXCLUSIVE-AREA-REF>
                        <CAN-ENTER-EXCLUSIVE-AREA-REF DEST="EXCLUSIVE-AREA">/AUTOSAR_Eth_43_PFE/BswModuleDescriptions/Eth/InternalBehavior_0/ETH_EXCLUSIVE_AREA_86</CAN-ENTER-EXCLUSIVE-AREA-REF>
                        <CAN-ENTER-EXCLUSIVE-AREA-REF DEST="EXCLUSIVE-AREA">/AUTOSAR_Eth_43_PFE/BswModuleDescriptions/Eth/InternalBehavior_0/ETH_EXCLUSIVE_AREA_88</CAN-ENTER-EXCLUSIVE-AREA-REF>
                        <CAN-ENTER-EXCLUSIVE-AREA-REF DEST="EXCLUSIVE-AREA">/AUTOSAR_Eth_43_PFE/BswModuleDescriptions/Eth/InternalBehavior_0/ETH_EXCLUSIVE_AREA_90</CAN-ENTER-EXCLUSIVE-AREA-REF>
                        <CAN-ENTER-EXCLUSIVE-AREA-REF DEST="EXCLUSIVE-AREA">/AUTOSAR_Eth_43_PFE/BswModuleDescriptions/Eth/InternalBehavior_0/ETH_EXCLUSIVE_AREA_91</CAN-ENTER-EXCLUSIVE-AREA-REF>
                        <CAN-ENTER-EXCLUSIVE-AREA-REF DEST="EXCLUSIVE-AREA">/AUTOSAR_Eth_43_PFE/BswModuleDescriptions/Eth/InternalBehavior_0/ETH_EXCLUSIVE_AREA_92</CAN-ENTER-EXCLUSIVE-AREA-REF>
                        <CAN-ENTER-EXCLUSIVE-AREA-REF DEST="EXCLUSIVE-AREA">/AUTOSAR_Eth_43_PFE/BswModuleDescriptions/Eth/InternalBehavior_0/ETH_EXCLUSIVE_AREA_93</CAN-ENTER-EXCLUSIVE-AREA-REF>
                        <CAN-ENTER-EXCLUSIVE-AREA-REF DEST="EXCLUSIVE-AREA">/AUTOSAR_Eth_43_PFE/BswModuleDescriptions/Eth/InternalBehavior_0/ETH_EXCLUSIVE_AREA_95</CAN-ENTER-EXCLUSIVE-AREA-REF>
                        <CAN-ENTER-EXCLUSIVE-AREA-REF DEST="EXCLUSIVE-AREA">/AUTOSAR_Eth_43_PFE/BswModuleDescriptions/Eth/InternalBehavior_0/ETH_EXCLUSIVE_AREA_97</CAN-ENTER-EXCLUSIVE-AREA-REF>
                        <CAN-ENTER-EXCLUSIVE-AREA-REF DEST="EXCLUSIVE-AREA">/AUTOSAR_Eth_43_PFE/BswModuleDescriptions/Eth/InternalBehavior_0/ETH_EXCLUSIVE_AREA_99</CAN-ENTER-EXCLUSIVE-AREA-REF>
                        <CAN-ENTER-EXCLUSIVE-AREA-REF DEST="EXCLUSIVE-AREA">/AUTOSAR_Eth_43_PFE/BswModuleDescriptions/Eth/InternalBehavior_0/ETH_EXCLUSIVE_AREA_100</CAN-ENTER-EXCLUSIVE-AREA-REF>
                        <CAN-ENTER-EXCLUSIVE-AREA-REF DEST="EXCLUSIVE-AREA">/AUTOSAR_Eth_43_PFE/BswModuleDescriptions/Eth/InternalBehavior_0/ETH_EXCLUSIVE_AREA_101</CAN-ENTER-EXCLUSIVE-AREA-REF>
                        <CAN-ENTER-EXCLUSIVE-AREA-REF DEST="EXCLUSIVE-AREA">/AUTOSAR_Eth_43_PFE/BswModuleDescriptions/Eth/InternalBehavior_0/ETH_EXCLUSIVE_AREA_102</CAN-ENTER-EXCLUSIVE-AREA-REF>
                        <CAN-ENTER-EXCLUSIVE-AREA-REF DEST="EXCLUSIVE-AREA">/AUTOSAR_Eth_43_PFE/BswModuleDescriptions/Eth/InternalBehavior_0/ETH_EXCLUSIVE_AREA_103</CAN-ENTER-EXCLUSIVE-AREA-REF>
                        <CAN-ENTER-EXCLUSIVE-AREA-REF DEST="EXCLUSIVE-AREA">/AUTOSAR_Eth_43_PFE/BswModuleDescriptions/Eth/InternalBehavior_0/ETH_EXCLUSIVE_AREA_104</CAN-ENTER-EXCLUSIVE-AREA-REF>
                      </CAN-ENTER-EXCLUSIVE-AREA-REFS>
                      <MINIMUM-START-INTERVAL>0.0</MINIMUM-START-INTERVAL>
                      <IMPLEMENTED-ENTRY-REF DEST="BSW-MODULE-ENTRY">/AUTOSAR_Eth_43_PFE/BswModuleEntrys/fci_cmd</IMPLEMENTED-ENTRY-REF>
                    </BSW-CALLED-ENTITY>
                    <BSW-CALLED-ENTITY>
                      <SHORT-NAME>fci_query</SHORT-NAME>
                      <CAN-ENTER-EXCLUSIVE-AREA-REFS>
                        <CAN-ENTER-EXCLUSIVE-AREA-REF DEST="EXCLUSIVE-AREA">/AUTOSAR_Eth_43_PFE/BswModuleDescriptions/Eth/InternalBehavior_0/ETH_EXCLUSIVE_AREA_01</CAN-ENTER-EXCLUSIVE-AREA-REF>
                        <CAN-ENTER-EXCLUSIVE-AREA-REF DEST="EXCLUSIVE-AREA">/AUTOSAR_Eth_43_PFE/BswModuleDescriptions/Eth/InternalBehavior_0/ETH_EXCLUSIVE_AREA_03</CAN-ENTER-EXCLUSIVE-AREA-REF>
                        <CAN-ENTER-EXCLUSIVE-AREA-REF DEST="EXCLUSIVE-AREA">/AUTOSAR_Eth_43_PFE/BswModuleDescriptions/Eth/InternalBehavior_0/ETH_EXCLUSIVE_AREA_04</CAN-ENTER-EXCLUSIVE-AREA-REF>
                        <CAN-ENTER-EXCLUSIVE-AREA-REF DEST="EXCLUSIVE-AREA">/AUTOSAR_Eth_43_PFE/BswModuleDescriptions/Eth/InternalBehavior_0/ETH_EXCLUSIVE_AREA_05</CAN-ENTER-EXCLUSIVE-AREA-REF>
                        <CAN-ENTER-EXCLUSIVE-AREA-REF DEST="EXCLUSIVE-AREA">/AUTOSAR_Eth_43_PFE/BswModuleDescriptions/Eth/InternalBehavior_0/ETH_EXCLUSIVE_AREA_07</CAN-ENTER-EXCLUSIVE-AREA-REF>
                        <CAN-ENTER-EXCLUSIVE-AREA-REF DEST="EXCLUSIVE-AREA">/AUTOSAR_Eth_43_PFE/BswModuleDescriptions/Eth/InternalBehavior_0/ETH_EXCLUSIVE_AREA_08</CAN-ENTER-EXCLUSIVE-AREA-REF>
                        <CAN-ENTER-EXCLUSIVE-AREA-REF DEST="EXCLUSIVE-AREA">/AUTOSAR_Eth_43_PFE/BswModuleDescriptions/Eth/InternalBehavior_0/ETH_EXCLUSIVE_AREA_09</CAN-ENTER-EXCLUSIVE-AREA-REF>
                        <CAN-ENTER-EXCLUSIVE-AREA-REF DEST="EXCLUSIVE-AREA">/AUTOSAR_Eth_43_PFE/BswModuleDescriptions/Eth/InternalBehavior_0/ETH_EXCLUSIVE_AREA_10</CAN-ENTER-EXCLUSIVE-AREA-REF>
                        <CAN-ENTER-EXCLUSIVE-AREA-REF DEST="EXCLUSIVE-AREA">/AUTOSAR_Eth_43_PFE/BswModuleDescriptions/Eth/InternalBehavior_0/ETH_EXCLUSIVE_AREA_13</CAN-ENTER-EXCLUSIVE-AREA-REF>
                        <CAN-ENTER-EXCLUSIVE-AREA-REF DEST="EXCLUSIVE-AREA">/AUTOSAR_Eth_43_PFE/BswModuleDescriptions/Eth/InternalBehavior_0/ETH_EXCLUSIVE_AREA_14</CAN-ENTER-EXCLUSIVE-AREA-REF>
                        <CAN-ENTER-EXCLUSIVE-AREA-REF DEST="EXCLUSIVE-AREA">/AUTOSAR_Eth_43_PFE/BswModuleDescriptions/Eth/InternalBehavior_0/ETH_EXCLUSIVE_AREA_15</CAN-ENTER-EXCLUSIVE-AREA-REF>
                        <CAN-ENTER-EXCLUSIVE-AREA-REF DEST="EXCLUSIVE-AREA">/AUTOSAR_Eth_43_PFE/BswModuleDescriptions/Eth/InternalBehavior_0/ETH_EXCLUSIVE_AREA_16</CAN-ENTER-EXCLUSIVE-AREA-REF>
                        <CAN-ENTER-EXCLUSIVE-AREA-REF DEST="EXCLUSIVE-AREA">/AUTOSAR_Eth_43_PFE/BswModuleDescriptions/Eth/InternalBehavior_0/ETH_EXCLUSIVE_AREA_18</CAN-ENTER-EXCLUSIVE-AREA-REF>
                        <CAN-ENTER-EXCLUSIVE-AREA-REF DEST="EXCLUSIVE-AREA">/AUTOSAR_Eth_43_PFE/BswModuleDescriptions/Eth/InternalBehavior_0/ETH_EXCLUSIVE_AREA_20</CAN-ENTER-EXCLUSIVE-AREA-REF>
                        <CAN-ENTER-EXCLUSIVE-AREA-REF DEST="EXCLUSIVE-AREA">/AUTOSAR_Eth_43_PFE/BswModuleDescriptions/Eth/InternalBehavior_0/ETH_EXCLUSIVE_AREA_21</CAN-ENTER-EXCLUSIVE-AREA-REF>
                        <CAN-ENTER-EXCLUSIVE-AREA-REF DEST="EXCLUSIVE-AREA">/AUTOSAR_Eth_43_PFE/BswModuleDescriptions/Eth/InternalBehavior_0/ETH_EXCLUSIVE_AREA_22</CAN-ENTER-EXCLUSIVE-AREA-REF>
                        <CAN-ENTER-EXCLUSIVE-AREA-REF DEST="EXCLUSIVE-AREA">/AUTOSAR_Eth_43_PFE/BswModuleDescriptions/Eth/InternalBehavior_0/ETH_EXCLUSIVE_AREA_23</CAN-ENTER-EXCLUSIVE-AREA-REF>
                        <CAN-ENTER-EXCLUSIVE-AREA-REF DEST="EXCLUSIVE-AREA">/AUTOSAR_Eth_43_PFE/BswModuleDescriptions/Eth/InternalBehavior_0/ETH_EXCLUSIVE_AREA_26</CAN-ENTER-EXCLUSIVE-AREA-REF>
                        <CAN-ENTER-EXCLUSIVE-AREA-REF DEST="EXCLUSIVE-AREA">/AUTOSAR_Eth_43_PFE/BswModuleDescriptions/Eth/InternalBehavior_0/ETH_EXCLUSIVE_AREA_28</CAN-ENTER-EXCLUSIVE-AREA-REF>
                        <CAN-ENTER-EXCLUSIVE-AREA-REF DEST="EXCLUSIVE-AREA">/AUTOSAR_Eth_43_PFE/BswModuleDescriptions/Eth/InternalBehavior_0/ETH_EXCLUSIVE_AREA_30</CAN-ENTER-EXCLUSIVE-AREA-REF>
                        <CAN-ENTER-EXCLUSIVE-AREA-REF DEST="EXCLUSIVE-AREA">/AUTOSAR_Eth_43_PFE/BswModuleDescriptions/Eth/InternalBehavior_0/ETH_EXCLUSIVE_AREA_31</CAN-ENTER-EXCLUSIVE-AREA-REF>
                        <CAN-ENTER-EXCLUSIVE-AREA-REF DEST="EXCLUSIVE-AREA">/AUTOSAR_Eth_43_PFE/BswModuleDescriptions/Eth/InternalBehavior_0/ETH_EXCLUSIVE_AREA_38</CAN-ENTER-EXCLUSIVE-AREA-REF>
                        <CAN-ENTER-EXCLUSIVE-AREA-REF DEST="EXCLUSIVE-AREA">/AUTOSAR_Eth_43_PFE/BswModuleDescriptions/Eth/InternalBehavior_0/ETH_EXCLUSIVE_AREA_39</CAN-ENTER-EXCLUSIVE-AREA-REF>
                        <CAN-ENTER-EXCLUSIVE-AREA-REF DEST="EXCLUSIVE-AREA">/AUTOSAR_Eth_43_PFE/BswModuleDescriptions/Eth/InternalBehavior_0/ETH_EXCLUSIVE_AREA_40</CAN-ENTER-EXCLUSIVE-AREA-REF>
                        <CAN-ENTER-EXCLUSIVE-AREA-REF DEST="EXCLUSIVE-AREA">/AUTOSAR_Eth_43_PFE/BswModuleDescriptions/Eth/InternalBehavior_0/ETH_EXCLUSIVE_AREA_45</CAN-ENTER-EXCLUSIVE-AREA-REF>
                        <CAN-ENTER-EXCLUSIVE-AREA-REF DEST="EXCLUSIVE-AREA">/AUTOSAR_Eth_43_PFE/BswModuleDescriptions/Eth/InternalBehavior_0/ETH_EXCLUSIVE_AREA_46</CAN-ENTER-EXCLUSIVE-AREA-REF>
                        <CAN-ENTER-EXCLUSIVE-AREA-REF DEST="EXCLUSIVE-AREA">/AUTOSAR_Eth_43_PFE/BswModuleDescriptions/Eth/InternalBehavior_0/ETH_EXCLUSIVE_AREA_47</CAN-ENTER-EXCLUSIVE-AREA-REF>
                        <CAN-ENTER-EXCLUSIVE-AREA-REF DEST="EXCLUSIVE-AREA">/AUTOSAR_Eth_43_PFE/BswModuleDescriptions/Eth/InternalBehavior_0/ETH_EXCLUSIVE_AREA_48</CAN-ENTER-EXCLUSIVE-AREA-REF>
                        <CAN-ENTER-EXCLUSIVE-AREA-REF DEST="EXCLUSIVE-AREA">/AUTOSAR_Eth_43_PFE/BswModuleDescriptions/Eth/InternalBehavior_0/ETH_EXCLUSIVE_AREA_54</CAN-ENTER-EXCLUSIVE-AREA-REF>
                        <CAN-ENTER-EXCLUSIVE-AREA-REF DEST="EXCLUSIVE-AREA">/AUTOSAR_Eth_43_PFE/BswModuleDescriptions/Eth/InternalBehavior_0/ETH_EXCLUSIVE_AREA_58</CAN-ENTER-EXCLUSIVE-AREA-REF>
                        <CAN-ENTER-EXCLUSIVE-AREA-REF DEST="EXCLUSIVE-AREA">/AUTOSAR_Eth_43_PFE/BswModuleDescriptions/Eth/InternalBehavior_0/ETH_EXCLUSIVE_AREA_59</CAN-ENTER-EXCLUSIVE-AREA-REF>
                        <CAN-ENTER-EXCLUSIVE-AREA-REF DEST="EXCLUSIVE-AREA">/AUTOSAR_Eth_43_PFE/BswModuleDescriptions/Eth/InternalBehavior_0/ETH_EXCLUSIVE_AREA_65</CAN-ENTER-EXCLUSIVE-AREA-REF>
                        <CAN-ENTER-EXCLUSIVE-AREA-REF DEST="EXCLUSIVE-AREA">/AUTOSAR_Eth_43_PFE/BswModuleDescriptions/Eth/InternalBehavior_0/ETH_EXCLUSIVE_AREA_66</CAN-ENTER-EXCLUSIVE-AREA-REF>
                        <CAN-ENTER-EXCLUSIVE-AREA-REF DEST="EXCLUSIVE-AREA">/AUTOSAR_Eth_43_PFE/BswModuleDescriptions/Eth/InternalBehavior_0/ETH_EXCLUSIVE_AREA_67</CAN-ENTER-EXCLUSIVE-AREA-REF>
                        <CAN-ENTER-EXCLUSIVE-AREA-REF DEST="EXCLUSIVE-AREA">/AUTOSAR_Eth_43_PFE/BswModuleDescriptions/Eth/InternalBehavior_0/ETH_EXCLUSIVE_AREA_68</CAN-ENTER-EXCLUSIVE-AREA-REF>
                        <CAN-ENTER-EXCLUSIVE-AREA-REF DEST="EXCLUSIVE-AREA">/AUTOSAR_Eth_43_PFE/BswModuleDescriptions/Eth/InternalBehavior_0/ETH_EXCLUSIVE_AREA_69</CAN-ENTER-EXCLUSIVE-AREA-REF>
                        <CAN-ENTER-EXCLUSIVE-AREA-REF DEST="EXCLUSIVE-AREA">/AUTOSAR_Eth_43_PFE/BswModuleDescriptions/Eth/InternalBehavior_0/ETH_EXCLUSIVE_AREA_70</CAN-ENTER-EXCLUSIVE-AREA-REF>
                        <CAN-ENTER-EXCLUSIVE-AREA-REF DEST="EXCLUSIVE-AREA">/AUTOSAR_Eth_43_PFE/BswModuleDescriptions/Eth/InternalBehavior_0/ETH_EXCLUSIVE_AREA_71</CAN-ENTER-EXCLUSIVE-AREA-REF>
                        <CAN-ENTER-EXCLUSIVE-AREA-REF DEST="EXCLUSIVE-AREA">/AUTOSAR_Eth_43_PFE/BswModuleDescriptions/Eth/InternalBehavior_0/ETH_EXCLUSIVE_AREA_72</CAN-ENTER-EXCLUSIVE-AREA-REF>
                        <CAN-ENTER-EXCLUSIVE-AREA-REF DEST="EXCLUSIVE-AREA">/AUTOSAR_Eth_43_PFE/BswModuleDescriptions/Eth/InternalBehavior_0/ETH_EXCLUSIVE_AREA_73</CAN-ENTER-EXCLUSIVE-AREA-REF>
                        <CAN-ENTER-EXCLUSIVE-AREA-REF DEST="EXCLUSIVE-AREA">/AUTOSAR_Eth_43_PFE/BswModuleDescriptions/Eth/InternalBehavior_0/ETH_EXCLUSIVE_AREA_74</CAN-ENTER-EXCLUSIVE-AREA-REF>
                        <CAN-ENTER-EXCLUSIVE-AREA-REF DEST="EXCLUSIVE-AREA">/AUTOSAR_Eth_43_PFE/BswModuleDescriptions/Eth/InternalBehavior_0/ETH_EXCLUSIVE_AREA_77</CAN-ENTER-EXCLUSIVE-AREA-REF>
                        <CAN-ENTER-EXCLUSIVE-AREA-REF DEST="EXCLUSIVE-AREA">/AUTOSAR_Eth_43_PFE/BswModuleDescriptions/Eth/InternalBehavior_0/ETH_EXCLUSIVE_AREA_78</CAN-ENTER-EXCLUSIVE-AREA-REF>
                        <CAN-ENTER-EXCLUSIVE-AREA-REF DEST="EXCLUSIVE-AREA">/AUTOSAR_Eth_43_PFE/BswModuleDescriptions/Eth/InternalBehavior_0/ETH_EXCLUSIVE_AREA_79</CAN-ENTER-EXCLUSIVE-AREA-REF>
                        <CAN-ENTER-EXCLUSIVE-AREA-REF DEST="EXCLUSIVE-AREA">/AUTOSAR_Eth_43_PFE/BswModuleDescriptions/Eth/InternalBehavior_0/ETH_EXCLUSIVE_AREA_81</CAN-ENTER-EXCLUSIVE-AREA-REF>
                        <CAN-ENTER-EXCLUSIVE-AREA-REF DEST="EXCLUSIVE-AREA">/AUTOSAR_Eth_43_PFE/BswModuleDescriptions/Eth/InternalBehavior_0/ETH_EXCLUSIVE_AREA_82</CAN-ENTER-EXCLUSIVE-AREA-REF>
                        <CAN-ENTER-EXCLUSIVE-AREA-REF DEST="EXCLUSIVE-AREA">/AUTOSAR_Eth_43_PFE/BswModuleDescriptions/Eth/InternalBehavior_0/ETH_EXCLUSIVE_AREA_85</CAN-ENTER-EXCLUSIVE-AREA-REF>
                        <CAN-ENTER-EXCLUSIVE-AREA-REF DEST="EXCLUSIVE-AREA">/AUTOSAR_Eth_43_PFE/BswModuleDescriptions/Eth/InternalBehavior_0/ETH_EXCLUSIVE_AREA_86</CAN-ENTER-EXCLUSIVE-AREA-REF>
                        <CAN-ENTER-EXCLUSIVE-AREA-REF DEST="EXCLUSIVE-AREA">/AUTOSAR_Eth_43_PFE/BswModuleDescriptions/Eth/InternalBehavior_0/ETH_EXCLUSIVE_AREA_88</CAN-ENTER-EXCLUSIVE-AREA-REF>
                        <CAN-ENTER-EXCLUSIVE-AREA-REF DEST="EXCLUSIVE-AREA">/AUTOSAR_Eth_43_PFE/BswModuleDescriptions/Eth/InternalBehavior_0/ETH_EXCLUSIVE_AREA_90</CAN-ENTER-EXCLUSIVE-AREA-REF>
                        <CAN-ENTER-EXCLUSIVE-AREA-REF DEST="EXCLUSIVE-AREA">/AUTOSAR_Eth_43_PFE/BswModuleDescriptions/Eth/InternalBehavior_0/ETH_EXCLUSIVE_AREA_91</CAN-ENTER-EXCLUSIVE-AREA-REF>
                        <CAN-ENTER-EXCLUSIVE-AREA-REF DEST="EXCLUSIVE-AREA">/AUTOSAR_Eth_43_PFE/BswModuleDescriptions/Eth/InternalBehavior_0/ETH_EXCLUSIVE_AREA_92</CAN-ENTER-EXCLUSIVE-AREA-REF>
                        <CAN-ENTER-EXCLUSIVE-AREA-REF DEST="EXCLUSIVE-AREA">/AUTOSAR_Eth_43_PFE/BswModuleDescriptions/Eth/InternalBehavior_0/ETH_EXCLUSIVE_AREA_93</CAN-ENTER-EXCLUSIVE-AREA-REF>
                        <CAN-ENTER-EXCLUSIVE-AREA-REF DEST="EXCLUSIVE-AREA">/AUTOSAR_Eth_43_PFE/BswModuleDescriptions/Eth/InternalBehavior_0/ETH_EXCLUSIVE_AREA_95</CAN-ENTER-EXCLUSIVE-AREA-REF>
                        <CAN-ENTER-EXCLUSIVE-AREA-REF DEST="EXCLUSIVE-AREA">/AUTOSAR_Eth_43_PFE/BswModuleDescriptions/Eth/InternalBehavior_0/ETH_EXCLUSIVE_AREA_97</CAN-ENTER-EXCLUSIVE-AREA-REF>
                        <CAN-ENTER-EXCLUSIVE-AREA-REF DEST="EXCLUSIVE-AREA">/AUTOSAR_Eth_43_PFE/BswModuleDescriptions/Eth/InternalBehavior_0/ETH_EXCLUSIVE_AREA_99</CAN-ENTER-EXCLUSIVE-AREA-REF>
                        <CAN-ENTER-EXCLUSIVE-AREA-REF DEST="EXCLUSIVE-AREA">/AUTOSAR_Eth_43_PFE/BswModuleDescriptions/Eth/InternalBehavior_0/ETH_EXCLUSIVE_AREA_100</CAN-ENTER-EXCLUSIVE-AREA-REF>
                        <CAN-ENTER-EXCLUSIVE-AREA-REF DEST="EXCLUSIVE-AREA">/AUTOSAR_Eth_43_PFE/BswModuleDescriptions/Eth/InternalBehavior_0/ETH_EXCLUSIVE_AREA_101</CAN-ENTER-EXCLUSIVE-AREA-REF>
                        <CAN-ENTER-EXCLUSIVE-AREA-REF DEST="EXCLUSIVE-AREA">/AUTOSAR_Eth_43_PFE/BswModuleDescriptions/Eth/InternalBehavior_0/ETH_EXCLUSIVE_AREA_102</CAN-ENTER-EXCLUSIVE-AREA-REF>
                        <CAN-ENTER-EXCLUSIVE-AREA-REF DEST="EXCLUSIVE-AREA">/AUTOSAR_Eth_43_PFE/BswModuleDescriptions/Eth/InternalBehavior_0/ETH_EXCLUSIVE_AREA_103</CAN-ENTER-EXCLUSIVE-AREA-REF>
                        <CAN-ENTER-EXCLUSIVE-AREA-REF DEST="EXCLUSIVE-AREA">/AUTOSAR_Eth_43_PFE/BswModuleDescriptions/Eth/InternalBehavior_0/ETH_EXCLUSIVE_AREA_104</CAN-ENTER-EXCLUSIVE-AREA-REF>
                      </CAN-ENTER-EXCLUSIVE-AREA-REFS>
                      <MINIMUM-START-INTERVAL>0.0</MINIMUM-START-INTERVAL>
                      <IMPLEMENTED-ENTRY-REF DEST="BSW-MODULE-ENTRY">/AUTOSAR_Eth_43_PFE/BswModuleEntrys/fci_query</IMPLEMENTED-ENTRY-REF>
                    </BSW-CALLED-ENTITY>
                    <BSW-CALLED-ENTITY>
                      <SHORT-NAME>fci_write</SHORT-NAME>
                      <CAN-ENTER-EXCLUSIVE-AREA-REFS>
                        <CAN-ENTER-EXCLUSIVE-AREA-REF DEST="EXCLUSIVE-AREA">/AUTOSAR_Eth_43_PFE/BswModuleDescriptions/Eth/InternalBehavior_0/ETH_EXCLUSIVE_AREA_01</CAN-ENTER-EXCLUSIVE-AREA-REF>
                        <CAN-ENTER-EXCLUSIVE-AREA-REF DEST="EXCLUSIVE-AREA">/AUTOSAR_Eth_43_PFE/BswModuleDescriptions/Eth/InternalBehavior_0/ETH_EXCLUSIVE_AREA_03</CAN-ENTER-EXCLUSIVE-AREA-REF>
                        <CAN-ENTER-EXCLUSIVE-AREA-REF DEST="EXCLUSIVE-AREA">/AUTOSAR_Eth_43_PFE/BswModuleDescriptions/Eth/InternalBehavior_0/ETH_EXCLUSIVE_AREA_04</CAN-ENTER-EXCLUSIVE-AREA-REF>
                        <CAN-ENTER-EXCLUSIVE-AREA-REF DEST="EXCLUSIVE-AREA">/AUTOSAR_Eth_43_PFE/BswModuleDescriptions/Eth/InternalBehavior_0/ETH_EXCLUSIVE_AREA_05</CAN-ENTER-EXCLUSIVE-AREA-REF>
                        <CAN-ENTER-EXCLUSIVE-AREA-REF DEST="EXCLUSIVE-AREA">/AUTOSAR_Eth_43_PFE/BswModuleDescriptions/Eth/InternalBehavior_0/ETH_EXCLUSIVE_AREA_07</CAN-ENTER-EXCLUSIVE-AREA-REF>
                        <CAN-ENTER-EXCLUSIVE-AREA-REF DEST="EXCLUSIVE-AREA">/AUTOSAR_Eth_43_PFE/BswModuleDescriptions/Eth/InternalBehavior_0/ETH_EXCLUSIVE_AREA_08</CAN-ENTER-EXCLUSIVE-AREA-REF>
                        <CAN-ENTER-EXCLUSIVE-AREA-REF DEST="EXCLUSIVE-AREA">/AUTOSAR_Eth_43_PFE/BswModuleDescriptions/Eth/InternalBehavior_0/ETH_EXCLUSIVE_AREA_09</CAN-ENTER-EXCLUSIVE-AREA-REF>
                        <CAN-ENTER-EXCLUSIVE-AREA-REF DEST="EXCLUSIVE-AREA">/AUTOSAR_Eth_43_PFE/BswModuleDescriptions/Eth/InternalBehavior_0/ETH_EXCLUSIVE_AREA_10</CAN-ENTER-EXCLUSIVE-AREA-REF>
                        <CAN-ENTER-EXCLUSIVE-AREA-REF DEST="EXCLUSIVE-AREA">/AUTOSAR_Eth_43_PFE/BswModuleDescriptions/Eth/InternalBehavior_0/ETH_EXCLUSIVE_AREA_13</CAN-ENTER-EXCLUSIVE-AREA-REF>
                        <CAN-ENTER-EXCLUSIVE-AREA-REF DEST="EXCLUSIVE-AREA">/AUTOSAR_Eth_43_PFE/BswModuleDescriptions/Eth/InternalBehavior_0/ETH_EXCLUSIVE_AREA_14</CAN-ENTER-EXCLUSIVE-AREA-REF>
                        <CAN-ENTER-EXCLUSIVE-AREA-REF DEST="EXCLUSIVE-AREA">/AUTOSAR_Eth_43_PFE/BswModuleDescriptions/Eth/InternalBehavior_0/ETH_EXCLUSIVE_AREA_15</CAN-ENTER-EXCLUSIVE-AREA-REF>
                        <CAN-ENTER-EXCLUSIVE-AREA-REF DEST="EXCLUSIVE-AREA">/AUTOSAR_Eth_43_PFE/BswModuleDescriptions/Eth/InternalBehavior_0/ETH_EXCLUSIVE_AREA_16</CAN-ENTER-EXCLUSIVE-AREA-REF>
                        <CAN-ENTER-EXCLUSIVE-AREA-REF DEST="EXCLUSIVE-AREA">/AUTOSAR_Eth_43_PFE/BswModuleDescriptions/Eth/InternalBehavior_0/ETH_EXCLUSIVE_AREA_18</CAN-ENTER-EXCLUSIVE-AREA-REF>
                        <CAN-ENTER-EXCLUSIVE-AREA-REF DEST="EXCLUSIVE-AREA">/AUTOSAR_Eth_43_PFE/BswModuleDescriptions/Eth/InternalBehavior_0/ETH_EXCLUSIVE_AREA_20</CAN-ENTER-EXCLUSIVE-AREA-REF>
                        <CAN-ENTER-EXCLUSIVE-AREA-REF DEST="EXCLUSIVE-AREA">/AUTOSAR_Eth_43_PFE/BswModuleDescriptions/Eth/InternalBehavior_0/ETH_EXCLUSIVE_AREA_21</CAN-ENTER-EXCLUSIVE-AREA-REF>
                        <CAN-ENTER-EXCLUSIVE-AREA-REF DEST="EXCLUSIVE-AREA">/AUTOSAR_Eth_43_PFE/BswModuleDescriptions/Eth/InternalBehavior_0/ETH_EXCLUSIVE_AREA_22</CAN-ENTER-EXCLUSIVE-AREA-REF>
                        <CAN-ENTER-EXCLUSIVE-AREA-REF DEST="EXCLUSIVE-AREA">/AUTOSAR_Eth_43_PFE/BswModuleDescriptions/Eth/InternalBehavior_0/ETH_EXCLUSIVE_AREA_23</CAN-ENTER-EXCLUSIVE-AREA-REF>
                        <CAN-ENTER-EXCLUSIVE-AREA-REF DEST="EXCLUSIVE-AREA">/AUTOSAR_Eth_43_PFE/BswModuleDescriptions/Eth/InternalBehavior_0/ETH_EXCLUSIVE_AREA_26</CAN-ENTER-EXCLUSIVE-AREA-REF>
                        <CAN-ENTER-EXCLUSIVE-AREA-REF DEST="EXCLUSIVE-AREA">/AUTOSAR_Eth_43_PFE/BswModuleDescriptions/Eth/InternalBehavior_0/ETH_EXCLUSIVE_AREA_28</CAN-ENTER-EXCLUSIVE-AREA-REF>
                        <CAN-ENTER-EXCLUSIVE-AREA-REF DEST="EXCLUSIVE-AREA">/AUTOSAR_Eth_43_PFE/BswModuleDescriptions/Eth/InternalBehavior_0/ETH_EXCLUSIVE_AREA_30</CAN-ENTER-EXCLUSIVE-AREA-REF>
                        <CAN-ENTER-EXCLUSIVE-AREA-REF DEST="EXCLUSIVE-AREA">/AUTOSAR_Eth_43_PFE/BswModuleDescriptions/Eth/InternalBehavior_0/ETH_EXCLUSIVE_AREA_31</CAN-ENTER-EXCLUSIVE-AREA-REF>
                        <CAN-ENTER-EXCLUSIVE-AREA-REF DEST="EXCLUSIVE-AREA">/AUTOSAR_Eth_43_PFE/BswModuleDescriptions/Eth/InternalBehavior_0/ETH_EXCLUSIVE_AREA_38</CAN-ENTER-EXCLUSIVE-AREA-REF>
                        <CAN-ENTER-EXCLUSIVE-AREA-REF DEST="EXCLUSIVE-AREA">/AUTOSAR_Eth_43_PFE/BswModuleDescriptions/Eth/InternalBehavior_0/ETH_EXCLUSIVE_AREA_39</CAN-ENTER-EXCLUSIVE-AREA-REF>
                        <CAN-ENTER-EXCLUSIVE-AREA-REF DEST="EXCLUSIVE-AREA">/AUTOSAR_Eth_43_PFE/BswModuleDescriptions/Eth/InternalBehavior_0/ETH_EXCLUSIVE_AREA_40</CAN-ENTER-EXCLUSIVE-AREA-REF>
                        <CAN-ENTER-EXCLUSIVE-AREA-REF DEST="EXCLUSIVE-AREA">/AUTOSAR_Eth_43_PFE/BswModuleDescriptions/Eth/InternalBehavior_0/ETH_EXCLUSIVE_AREA_45</CAN-ENTER-EXCLUSIVE-AREA-REF>
                        <CAN-ENTER-EXCLUSIVE-AREA-REF DEST="EXCLUSIVE-AREA">/AUTOSAR_Eth_43_PFE/BswModuleDescriptions/Eth/InternalBehavior_0/ETH_EXCLUSIVE_AREA_46</CAN-ENTER-EXCLUSIVE-AREA-REF>
                        <CAN-ENTER-EXCLUSIVE-AREA-REF DEST="EXCLUSIVE-AREA">/AUTOSAR_Eth_43_PFE/BswModuleDescriptions/Eth/InternalBehavior_0/ETH_EXCLUSIVE_AREA_47</CAN-ENTER-EXCLUSIVE-AREA-REF>
                        <CAN-ENTER-EXCLUSIVE-AREA-REF DEST="EXCLUSIVE-AREA">/AUTOSAR_Eth_43_PFE/BswModuleDescriptions/Eth/InternalBehavior_0/ETH_EXCLUSIVE_AREA_48</CAN-ENTER-EXCLUSIVE-AREA-REF>
                        <CAN-ENTER-EXCLUSIVE-AREA-REF DEST="EXCLUSIVE-AREA">/AUTOSAR_Eth_43_PFE/BswModuleDescriptions/Eth/InternalBehavior_0/ETH_EXCLUSIVE_AREA_54</CAN-ENTER-EXCLUSIVE-AREA-REF>
                        <CAN-ENTER-EXCLUSIVE-AREA-REF DEST="EXCLUSIVE-AREA">/AUTOSAR_Eth_43_PFE/BswModuleDescriptions/Eth/InternalBehavior_0/ETH_EXCLUSIVE_AREA_58</CAN-ENTER-EXCLUSIVE-AREA-REF>
                        <CAN-ENTER-EXCLUSIVE-AREA-REF DEST="EXCLUSIVE-AREA">/AUTOSAR_Eth_43_PFE/BswModuleDescriptions/Eth/InternalBehavior_0/ETH_EXCLUSIVE_AREA_59</CAN-ENTER-EXCLUSIVE-AREA-REF>
                        <CAN-ENTER-EXCLUSIVE-AREA-REF DEST="EXCLUSIVE-AREA">/AUTOSAR_Eth_43_PFE/BswModuleDescriptions/Eth/InternalBehavior_0/ETH_EXCLUSIVE_AREA_65</CAN-ENTER-EXCLUSIVE-AREA-REF>
                        <CAN-ENTER-EXCLUSIVE-AREA-REF DEST="EXCLUSIVE-AREA">/AUTOSAR_Eth_43_PFE/BswModuleDescriptions/Eth/InternalBehavior_0/ETH_EXCLUSIVE_AREA_66</CAN-ENTER-EXCLUSIVE-AREA-REF>
                        <CAN-ENTER-EXCLUSIVE-AREA-REF DEST="EXCLUSIVE-AREA">/AUTOSAR_Eth_43_PFE/BswModuleDescriptions/Eth/InternalBehavior_0/ETH_EXCLUSIVE_AREA_67</CAN-ENTER-EXCLUSIVE-AREA-REF>
                        <CAN-ENTER-EXCLUSIVE-AREA-REF DEST="EXCLUSIVE-AREA">/AUTOSAR_Eth_43_PFE/BswModuleDescriptions/Eth/InternalBehavior_0/ETH_EXCLUSIVE_AREA_68</CAN-ENTER-EXCLUSIVE-AREA-REF>
                        <CAN-ENTER-EXCLUSIVE-AREA-REF DEST="EXCLUSIVE-AREA">/AUTOSAR_Eth_43_PFE/BswModuleDescriptions/Eth/InternalBehavior_0/ETH_EXCLUSIVE_AREA_69</CAN-ENTER-EXCLUSIVE-AREA-REF>
                        <CAN-ENTER-EXCLUSIVE-AREA-REF DEST="EXCLUSIVE-AREA">/AUTOSAR_Eth_43_PFE/BswModuleDescriptions/Eth/InternalBehavior_0/ETH_EXCLUSIVE_AREA_70</CAN-ENTER-EXCLUSIVE-AREA-REF>
                        <CAN-ENTER-EXCLUSIVE-AREA-REF DEST="EXCLUSIVE-AREA">/AUTOSAR_Eth_43_PFE/BswModuleDescriptions/Eth/InternalBehavior_0/ETH_EXCLUSIVE_AREA_71</CAN-ENTER-EXCLUSIVE-AREA-REF>
                        <CAN-ENTER-EXCLUSIVE-AREA-REF DEST="EXCLUSIVE-AREA">/AUTOSAR_Eth_43_PFE/BswModuleDescriptions/Eth/InternalBehavior_0/ETH_EXCLUSIVE_AREA_72</CAN-ENTER-EXCLUSIVE-AREA-REF>
                        <CAN-ENTER-EXCLUSIVE-AREA-REF DEST="EXCLUSIVE-AREA">/AUTOSAR_Eth_43_PFE/BswModuleDescriptions/Eth/InternalBehavior_0/ETH_EXCLUSIVE_AREA_73</CAN-ENTER-EXCLUSIVE-AREA-REF>
                        <CAN-ENTER-EXCLUSIVE-AREA-REF DEST="EXCLUSIVE-AREA">/AUTOSAR_Eth_43_PFE/BswModuleDescriptions/Eth/InternalBehavior_0/ETH_EXCLUSIVE_AREA_74</CAN-ENTER-EXCLUSIVE-AREA-REF>
                        <CAN-ENTER-EXCLUSIVE-AREA-REF DEST="EXCLUSIVE-AREA">/AUTOSAR_Eth_43_PFE/BswModuleDescriptions/Eth/InternalBehavior_0/ETH_EXCLUSIVE_AREA_77</CAN-ENTER-EXCLUSIVE-AREA-REF>
                        <CAN-ENTER-EXCLUSIVE-AREA-REF DEST="EXCLUSIVE-AREA">/AUTOSAR_Eth_43_PFE/BswModuleDescriptions/Eth/InternalBehavior_0/ETH_EXCLUSIVE_AREA_78</CAN-ENTER-EXCLUSIVE-AREA-REF>
                        <CAN-ENTER-EXCLUSIVE-AREA-REF DEST="EXCLUSIVE-AREA">/AUTOSAR_Eth_43_PFE/BswModuleDescriptions/Eth/InternalBehavior_0/ETH_EXCLUSIVE_AREA_79</CAN-ENTER-EXCLUSIVE-AREA-REF>
                        <CAN-ENTER-EXCLUSIVE-AREA-REF DEST="EXCLUSIVE-AREA">/AUTOSAR_Eth_43_PFE/BswModuleDescriptions/Eth/InternalBehavior_0/ETH_EXCLUSIVE_AREA_81</CAN-ENTER-EXCLUSIVE-AREA-REF>
                        <CAN-ENTER-EXCLUSIVE-AREA-REF DEST="EXCLUSIVE-AREA">/AUTOSAR_Eth_43_PFE/BswModuleDescriptions/Eth/InternalBehavior_0/ETH_EXCLUSIVE_AREA_82</CAN-ENTER-EXCLUSIVE-AREA-REF>
                        <CAN-ENTER-EXCLUSIVE-AREA-REF DEST="EXCLUSIVE-AREA">/AUTOSAR_Eth_43_PFE/BswModuleDescriptions/Eth/InternalBehavior_0/ETH_EXCLUSIVE_AREA_85</CAN-ENTER-EXCLUSIVE-AREA-REF>
                        <CAN-ENTER-EXCLUSIVE-AREA-REF DEST="EXCLUSIVE-AREA">/AUTOSAR_Eth_43_PFE/BswModuleDescriptions/Eth/InternalBehavior_0/ETH_EXCLUSIVE_AREA_86</CAN-ENTER-EXCLUSIVE-AREA-REF>
                        <CAN-ENTER-EXCLUSIVE-AREA-REF DEST="EXCLUSIVE-AREA">/AUTOSAR_Eth_43_PFE/BswModuleDescriptions/Eth/InternalBehavior_0/ETH_EXCLUSIVE_AREA_88</CAN-ENTER-EXCLUSIVE-AREA-REF>
                        <CAN-ENTER-EXCLUSIVE-AREA-REF DEST="EXCLUSIVE-AREA">/AUTOSAR_Eth_43_PFE/BswModuleDescriptions/Eth/InternalBehavior_0/ETH_EXCLUSIVE_AREA_90</CAN-ENTER-EXCLUSIVE-AREA-REF>
                        <CAN-ENTER-EXCLUSIVE-AREA-REF DEST="EXCLUSIVE-AREA">/AUTOSAR_Eth_43_PFE/BswModuleDescriptions/Eth/InternalBehavior_0/ETH_EXCLUSIVE_AREA_91</CAN-ENTER-EXCLUSIVE-AREA-REF>
                        <CAN-ENTER-EXCLUSIVE-AREA-REF DEST="EXCLUSIVE-AREA">/AUTOSAR_Eth_43_PFE/BswModuleDescriptions/Eth/InternalBehavior_0/ETH_EXCLUSIVE_AREA_92</CAN-ENTER-EXCLUSIVE-AREA-REF>
                        <CAN-ENTER-EXCLUSIVE-AREA-REF DEST="EXCLUSIVE-AREA">/AUTOSAR_Eth_43_PFE/BswModuleDescriptions/Eth/InternalBehavior_0/ETH_EXCLUSIVE_AREA_93</CAN-ENTER-EXCLUSIVE-AREA-REF>
                        <CAN-ENTER-EXCLUSIVE-AREA-REF DEST="EXCLUSIVE-AREA">/AUTOSAR_Eth_43_PFE/BswModuleDescriptions/Eth/InternalBehavior_0/ETH_EXCLUSIVE_AREA_95</CAN-ENTER-EXCLUSIVE-AREA-REF>
                        <CAN-ENTER-EXCLUSIVE-AREA-REF DEST="EXCLUSIVE-AREA">/AUTOSAR_Eth_43_PFE/BswModuleDescriptions/Eth/InternalBehavior_0/ETH_EXCLUSIVE_AREA_97</CAN-ENTER-EXCLUSIVE-AREA-REF>
                        <CAN-ENTER-EXCLUSIVE-AREA-REF DEST="EXCLUSIVE-AREA">/AUTOSAR_Eth_43_PFE/BswModuleDescriptions/Eth/InternalBehavior_0/ETH_EXCLUSIVE_AREA_99</CAN-ENTER-EXCLUSIVE-AREA-REF>
                        <CAN-ENTER-EXCLUSIVE-AREA-REF DEST="EXCLUSIVE-AREA">/AUTOSAR_Eth_43_PFE/BswModuleDescriptions/Eth/InternalBehavior_0/ETH_EXCLUSIVE_AREA_100</CAN-ENTER-EXCLUSIVE-AREA-REF>
                        <CAN-ENTER-EXCLUSIVE-AREA-REF DEST="EXCLUSIVE-AREA">/AUTOSAR_Eth_43_PFE/BswModuleDescriptions/Eth/InternalBehavior_0/ETH_EXCLUSIVE_AREA_101</CAN-ENTER-EXCLUSIVE-AREA-REF>
                        <CAN-ENTER-EXCLUSIVE-AREA-REF DEST="EXCLUSIVE-AREA">/AUTOSAR_Eth_43_PFE/BswModuleDescriptions/Eth/InternalBehavior_0/ETH_EXCLUSIVE_AREA_102</CAN-ENTER-EXCLUSIVE-AREA-REF>
                        <CAN-ENTER-EXCLUSIVE-AREA-REF DEST="EXCLUSIVE-AREA">/AUTOSAR_Eth_43_PFE/BswModuleDescriptions/Eth/InternalBehavior_0/ETH_EXCLUSIVE_AREA_103</CAN-ENTER-EXCLUSIVE-AREA-REF>
                        <CAN-ENTER-EXCLUSIVE-AREA-REF DEST="EXCLUSIVE-AREA">/AUTOSAR_Eth_43_PFE/BswModuleDescriptions/Eth/InternalBehavior_0/ETH_EXCLUSIVE_AREA_104</CAN-ENTER-EXCLUSIVE-AREA-REF>
                      </CAN-ENTER-EXCLUSIVE-AREA-REFS>
                      <MINIMUM-START-INTERVAL>0.0</MINIMUM-START-INTERVAL>
                      <IMPLEMENTED-ENTRY-REF DEST="BSW-MODULE-ENTRY">/AUTOSAR_Eth_43_PFE/BswModuleEntrys/fci_write</IMPLEMENTED-ENTRY-REF>
                    </BSW-CALLED-ENTITY>
                    <BSW-CALLED-ENTITY>
                      <SHORT-NAME>fci_register_cb</SHORT-NAME>
                      <MINIMUM-START-INTERVAL>0.0</MINIMUM-START-INTERVAL>
                      <IMPLEMENTED-ENTRY-REF DEST="BSW-MODULE-ENTRY">/AUTOSAR_Eth_43_PFE/BswModuleEntrys/fci_register_cb</IMPLEMENTED-ENTRY-REF>
                    </BSW-CALLED-ENTITY>
                    <BSW-CALLED-ENTITY>
                      <SHORT-NAME>fci_fd</SHORT-NAME>
                      <MINIMUM-START-INTERVAL>0.0</MINIMUM-START-INTERVAL>
                      <IMPLEMENTED-ENTRY-REF DEST="BSW-MODULE-ENTRY">/AUTOSAR_Eth_43_PFE/BswModuleEntrys/fci_fd</IMPLEMENTED-ENTRY-REF>
                    </BSW-CALLED-ENTITY>
                    [!ENDIF!][!//
                    <BSW-SCHEDULABLE-ENTITY>
                      <SHORT-NAME>Eth_43_PFE_MainFunction</SHORT-NAME>
                      <CAN-ENTER-EXCLUSIVE-AREA-REFS>
                        <CAN-ENTER-EXCLUSIVE-AREA-REF DEST="EXCLUSIVE-AREA">/AUTOSAR_Eth_43_PFE/BswModuleDescriptions/Eth/InternalBehavior_0/ETH_EXCLUSIVE_AREA_01</CAN-ENTER-EXCLUSIVE-AREA-REF>
                        <CAN-ENTER-EXCLUSIVE-AREA-REF DEST="EXCLUSIVE-AREA">/AUTOSAR_Eth_43_PFE/BswModuleDescriptions/Eth/InternalBehavior_0/ETH_EXCLUSIVE_AREA_03</CAN-ENTER-EXCLUSIVE-AREA-REF>
                        <CAN-ENTER-EXCLUSIVE-AREA-REF DEST="EXCLUSIVE-AREA">/AUTOSAR_Eth_43_PFE/BswModuleDescriptions/Eth/InternalBehavior_0/ETH_EXCLUSIVE_AREA_04</CAN-ENTER-EXCLUSIVE-AREA-REF>
                        <CAN-ENTER-EXCLUSIVE-AREA-REF DEST="EXCLUSIVE-AREA">/AUTOSAR_Eth_43_PFE/BswModuleDescriptions/Eth/InternalBehavior_0/ETH_EXCLUSIVE_AREA_05</CAN-ENTER-EXCLUSIVE-AREA-REF>
                        <CAN-ENTER-EXCLUSIVE-AREA-REF DEST="EXCLUSIVE-AREA">/AUTOSAR_Eth_43_PFE/BswModuleDescriptions/Eth/InternalBehavior_0/ETH_EXCLUSIVE_AREA_07</CAN-ENTER-EXCLUSIVE-AREA-REF>
                        <CAN-ENTER-EXCLUSIVE-AREA-REF DEST="EXCLUSIVE-AREA">/AUTOSAR_Eth_43_PFE/BswModuleDescriptions/Eth/InternalBehavior_0/ETH_EXCLUSIVE_AREA_08</CAN-ENTER-EXCLUSIVE-AREA-REF>
                        <CAN-ENTER-EXCLUSIVE-AREA-REF DEST="EXCLUSIVE-AREA">/AUTOSAR_Eth_43_PFE/BswModuleDescriptions/Eth/InternalBehavior_0/ETH_EXCLUSIVE_AREA_09</CAN-ENTER-EXCLUSIVE-AREA-REF>
                        <CAN-ENTER-EXCLUSIVE-AREA-REF DEST="EXCLUSIVE-AREA">/AUTOSAR_Eth_43_PFE/BswModuleDescriptions/Eth/InternalBehavior_0/ETH_EXCLUSIVE_AREA_10</CAN-ENTER-EXCLUSIVE-AREA-REF>
                        <CAN-ENTER-EXCLUSIVE-AREA-REF DEST="EXCLUSIVE-AREA">/AUTOSAR_Eth_43_PFE/BswModuleDescriptions/Eth/InternalBehavior_0/ETH_EXCLUSIVE_AREA_13</CAN-ENTER-EXCLUSIVE-AREA-REF>
                        <CAN-ENTER-EXCLUSIVE-AREA-REF DEST="EXCLUSIVE-AREA">/AUTOSAR_Eth_43_PFE/BswModuleDescriptions/Eth/InternalBehavior_0/ETH_EXCLUSIVE_AREA_14</CAN-ENTER-EXCLUSIVE-AREA-REF>
                        <CAN-ENTER-EXCLUSIVE-AREA-REF DEST="EXCLUSIVE-AREA">/AUTOSAR_Eth_43_PFE/BswModuleDescriptions/Eth/InternalBehavior_0/ETH_EXCLUSIVE_AREA_15</CAN-ENTER-EXCLUSIVE-AREA-REF>
                        <CAN-ENTER-EXCLUSIVE-AREA-REF DEST="EXCLUSIVE-AREA">/AUTOSAR_Eth_43_PFE/BswModuleDescriptions/Eth/InternalBehavior_0/ETH_EXCLUSIVE_AREA_16</CAN-ENTER-EXCLUSIVE-AREA-REF>
                        <CAN-ENTER-EXCLUSIVE-AREA-REF DEST="EXCLUSIVE-AREA">/AUTOSAR_Eth_43_PFE/BswModuleDescriptions/Eth/InternalBehavior_0/ETH_EXCLUSIVE_AREA_18</CAN-ENTER-EXCLUSIVE-AREA-REF>
                        <CAN-ENTER-EXCLUSIVE-AREA-REF DEST="EXCLUSIVE-AREA">/AUTOSAR_Eth_43_PFE/BswModuleDescriptions/Eth/InternalBehavior_0/ETH_EXCLUSIVE_AREA_20</CAN-ENTER-EXCLUSIVE-AREA-REF>
                        <CAN-ENTER-EXCLUSIVE-AREA-REF DEST="EXCLUSIVE-AREA">/AUTOSAR_Eth_43_PFE/BswModuleDescriptions/Eth/InternalBehavior_0/ETH_EXCLUSIVE_AREA_21</CAN-ENTER-EXCLUSIVE-AREA-REF>
                        <CAN-ENTER-EXCLUSIVE-AREA-REF DEST="EXCLUSIVE-AREA">/AUTOSAR_Eth_43_PFE/BswModuleDescriptions/Eth/InternalBehavior_0/ETH_EXCLUSIVE_AREA_22</CAN-ENTER-EXCLUSIVE-AREA-REF>
                        <CAN-ENTER-EXCLUSIVE-AREA-REF DEST="EXCLUSIVE-AREA">/AUTOSAR_Eth_43_PFE/BswModuleDescriptions/Eth/InternalBehavior_0/ETH_EXCLUSIVE_AREA_23</CAN-ENTER-EXCLUSIVE-AREA-REF>
                        <CAN-ENTER-EXCLUSIVE-AREA-REF DEST="EXCLUSIVE-AREA">/AUTOSAR_Eth_43_PFE/BswModuleDescriptions/Eth/InternalBehavior_0/ETH_EXCLUSIVE_AREA_25</CAN-ENTER-EXCLUSIVE-AREA-REF>
                        <CAN-ENTER-EXCLUSIVE-AREA-REF DEST="EXCLUSIVE-AREA">/AUTOSAR_Eth_43_PFE/BswModuleDescriptions/Eth/InternalBehavior_0/ETH_EXCLUSIVE_AREA_26</CAN-ENTER-EXCLUSIVE-AREA-REF>
                        <CAN-ENTER-EXCLUSIVE-AREA-REF DEST="EXCLUSIVE-AREA">/AUTOSAR_Eth_43_PFE/BswModuleDescriptions/Eth/InternalBehavior_0/ETH_EXCLUSIVE_AREA_28</CAN-ENTER-EXCLUSIVE-AREA-REF>
                        <CAN-ENTER-EXCLUSIVE-AREA-REF DEST="EXCLUSIVE-AREA">/AUTOSAR_Eth_43_PFE/BswModuleDescriptions/Eth/InternalBehavior_0/ETH_EXCLUSIVE_AREA_30</CAN-ENTER-EXCLUSIVE-AREA-REF>
                        <CAN-ENTER-EXCLUSIVE-AREA-REF DEST="EXCLUSIVE-AREA">/AUTOSAR_Eth_43_PFE/BswModuleDescriptions/Eth/InternalBehavior_0/ETH_EXCLUSIVE_AREA_31</CAN-ENTER-EXCLUSIVE-AREA-REF>
                        <CAN-ENTER-EXCLUSIVE-AREA-REF DEST="EXCLUSIVE-AREA">/AUTOSAR_Eth_43_PFE/BswModuleDescriptions/Eth/InternalBehavior_0/ETH_EXCLUSIVE_AREA_35</CAN-ENTER-EXCLUSIVE-AREA-REF>
                        <CAN-ENTER-EXCLUSIVE-AREA-REF DEST="EXCLUSIVE-AREA">/AUTOSAR_Eth_43_PFE/BswModuleDescriptions/Eth/InternalBehavior_0/ETH_EXCLUSIVE_AREA_36</CAN-ENTER-EXCLUSIVE-AREA-REF>
                        <CAN-ENTER-EXCLUSIVE-AREA-REF DEST="EXCLUSIVE-AREA">/AUTOSAR_Eth_43_PFE/BswModuleDescriptions/Eth/InternalBehavior_0/ETH_EXCLUSIVE_AREA_38</CAN-ENTER-EXCLUSIVE-AREA-REF>
                        <CAN-ENTER-EXCLUSIVE-AREA-REF DEST="EXCLUSIVE-AREA">/AUTOSAR_Eth_43_PFE/BswModuleDescriptions/Eth/InternalBehavior_0/ETH_EXCLUSIVE_AREA_39</CAN-ENTER-EXCLUSIVE-AREA-REF>
                        <CAN-ENTER-EXCLUSIVE-AREA-REF DEST="EXCLUSIVE-AREA">/AUTOSAR_Eth_43_PFE/BswModuleDescriptions/Eth/InternalBehavior_0/ETH_EXCLUSIVE_AREA_40</CAN-ENTER-EXCLUSIVE-AREA-REF>
                        <CAN-ENTER-EXCLUSIVE-AREA-REF DEST="EXCLUSIVE-AREA">/AUTOSAR_Eth_43_PFE/BswModuleDescriptions/Eth/InternalBehavior_0/ETH_EXCLUSIVE_AREA_45</CAN-ENTER-EXCLUSIVE-AREA-REF>
                        <CAN-ENTER-EXCLUSIVE-AREA-REF DEST="EXCLUSIVE-AREA">/AUTOSAR_Eth_43_PFE/BswModuleDescriptions/Eth/InternalBehavior_0/ETH_EXCLUSIVE_AREA_46</CAN-ENTER-EXCLUSIVE-AREA-REF>
                        <CAN-ENTER-EXCLUSIVE-AREA-REF DEST="EXCLUSIVE-AREA">/AUTOSAR_Eth_43_PFE/BswModuleDescriptions/Eth/InternalBehavior_0/ETH_EXCLUSIVE_AREA_47</CAN-ENTER-EXCLUSIVE-AREA-REF>
                        <CAN-ENTER-EXCLUSIVE-AREA-REF DEST="EXCLUSIVE-AREA">/AUTOSAR_Eth_43_PFE/BswModuleDescriptions/Eth/InternalBehavior_0/ETH_EXCLUSIVE_AREA_48</CAN-ENTER-EXCLUSIVE-AREA-REF>
                        <CAN-ENTER-EXCLUSIVE-AREA-REF DEST="EXCLUSIVE-AREA">/AUTOSAR_Eth_43_PFE/BswModuleDescriptions/Eth/InternalBehavior_0/ETH_EXCLUSIVE_AREA_54</CAN-ENTER-EXCLUSIVE-AREA-REF>
                        <CAN-ENTER-EXCLUSIVE-AREA-REF DEST="EXCLUSIVE-AREA">/AUTOSAR_Eth_43_PFE/BswModuleDescriptions/Eth/InternalBehavior_0/ETH_EXCLUSIVE_AREA_55</CAN-ENTER-EXCLUSIVE-AREA-REF>
                        <CAN-ENTER-EXCLUSIVE-AREA-REF DEST="EXCLUSIVE-AREA">/AUTOSAR_Eth_43_PFE/BswModuleDescriptions/Eth/InternalBehavior_0/ETH_EXCLUSIVE_AREA_56</CAN-ENTER-EXCLUSIVE-AREA-REF>
                        <CAN-ENTER-EXCLUSIVE-AREA-REF DEST="EXCLUSIVE-AREA">/AUTOSAR_Eth_43_PFE/BswModuleDescriptions/Eth/InternalBehavior_0/ETH_EXCLUSIVE_AREA_57</CAN-ENTER-EXCLUSIVE-AREA-REF>
                        <CAN-ENTER-EXCLUSIVE-AREA-REF DEST="EXCLUSIVE-AREA">/AUTOSAR_Eth_43_PFE/BswModuleDescriptions/Eth/InternalBehavior_0/ETH_EXCLUSIVE_AREA_58</CAN-ENTER-EXCLUSIVE-AREA-REF>
                        <CAN-ENTER-EXCLUSIVE-AREA-REF DEST="EXCLUSIVE-AREA">/AUTOSAR_Eth_43_PFE/BswModuleDescriptions/Eth/InternalBehavior_0/ETH_EXCLUSIVE_AREA_59</CAN-ENTER-EXCLUSIVE-AREA-REF>
                        <CAN-ENTER-EXCLUSIVE-AREA-REF DEST="EXCLUSIVE-AREA">/AUTOSAR_Eth_43_PFE/BswModuleDescriptions/Eth/InternalBehavior_0/ETH_EXCLUSIVE_AREA_60</CAN-ENTER-EXCLUSIVE-AREA-REF>
                        <CAN-ENTER-EXCLUSIVE-AREA-REF DEST="EXCLUSIVE-AREA">/AUTOSAR_Eth_43_PFE/BswModuleDescriptions/Eth/InternalBehavior_0/ETH_EXCLUSIVE_AREA_65</CAN-ENTER-EXCLUSIVE-AREA-REF>
                        <CAN-ENTER-EXCLUSIVE-AREA-REF DEST="EXCLUSIVE-AREA">/AUTOSAR_Eth_43_PFE/BswModuleDescriptions/Eth/InternalBehavior_0/ETH_EXCLUSIVE_AREA_66</CAN-ENTER-EXCLUSIVE-AREA-REF>
                        <CAN-ENTER-EXCLUSIVE-AREA-REF DEST="EXCLUSIVE-AREA">/AUTOSAR_Eth_43_PFE/BswModuleDescriptions/Eth/InternalBehavior_0/ETH_EXCLUSIVE_AREA_67</CAN-ENTER-EXCLUSIVE-AREA-REF>
                        <CAN-ENTER-EXCLUSIVE-AREA-REF DEST="EXCLUSIVE-AREA">/AUTOSAR_Eth_43_PFE/BswModuleDescriptions/Eth/InternalBehavior_0/ETH_EXCLUSIVE_AREA_68</CAN-ENTER-EXCLUSIVE-AREA-REF>
                        <CAN-ENTER-EXCLUSIVE-AREA-REF DEST="EXCLUSIVE-AREA">/AUTOSAR_Eth_43_PFE/BswModuleDescriptions/Eth/InternalBehavior_0/ETH_EXCLUSIVE_AREA_69</CAN-ENTER-EXCLUSIVE-AREA-REF>
                        <CAN-ENTER-EXCLUSIVE-AREA-REF DEST="EXCLUSIVE-AREA">/AUTOSAR_Eth_43_PFE/BswModuleDescriptions/Eth/InternalBehavior_0/ETH_EXCLUSIVE_AREA_70</CAN-ENTER-EXCLUSIVE-AREA-REF>
                        <CAN-ENTER-EXCLUSIVE-AREA-REF DEST="EXCLUSIVE-AREA">/AUTOSAR_Eth_43_PFE/BswModuleDescriptions/Eth/InternalBehavior_0/ETH_EXCLUSIVE_AREA_71</CAN-ENTER-EXCLUSIVE-AREA-REF>
                        <CAN-ENTER-EXCLUSIVE-AREA-REF DEST="EXCLUSIVE-AREA">/AUTOSAR_Eth_43_PFE/BswModuleDescriptions/Eth/InternalBehavior_0/ETH_EXCLUSIVE_AREA_72</CAN-ENTER-EXCLUSIVE-AREA-REF>
                        <CAN-ENTER-EXCLUSIVE-AREA-REF DEST="EXCLUSIVE-AREA">/AUTOSAR_Eth_43_PFE/BswModuleDescriptions/Eth/InternalBehavior_0/ETH_EXCLUSIVE_AREA_73</CAN-ENTER-EXCLUSIVE-AREA-REF>
                        <CAN-ENTER-EXCLUSIVE-AREA-REF DEST="EXCLUSIVE-AREA">/AUTOSAR_Eth_43_PFE/BswModuleDescriptions/Eth/InternalBehavior_0/ETH_EXCLUSIVE_AREA_74</CAN-ENTER-EXCLUSIVE-AREA-REF>
                        <CAN-ENTER-EXCLUSIVE-AREA-REF DEST="EXCLUSIVE-AREA">/AUTOSAR_Eth_43_PFE/BswModuleDescriptions/Eth/InternalBehavior_0/ETH_EXCLUSIVE_AREA_77</CAN-ENTER-EXCLUSIVE-AREA-REF>
                        <CAN-ENTER-EXCLUSIVE-AREA-REF DEST="EXCLUSIVE-AREA">/AUTOSAR_Eth_43_PFE/BswModuleDescriptions/Eth/InternalBehavior_0/ETH_EXCLUSIVE_AREA_78</CAN-ENTER-EXCLUSIVE-AREA-REF>
                        <CAN-ENTER-EXCLUSIVE-AREA-REF DEST="EXCLUSIVE-AREA">/AUTOSAR_Eth_43_PFE/BswModuleDescriptions/Eth/InternalBehavior_0/ETH_EXCLUSIVE_AREA_79</CAN-ENTER-EXCLUSIVE-AREA-REF>
                        <CAN-ENTER-EXCLUSIVE-AREA-REF DEST="EXCLUSIVE-AREA">/AUTOSAR_Eth_43_PFE/BswModuleDescriptions/Eth/InternalBehavior_0/ETH_EXCLUSIVE_AREA_80</CAN-ENTER-EXCLUSIVE-AREA-REF>
                        <CAN-ENTER-EXCLUSIVE-AREA-REF DEST="EXCLUSIVE-AREA">/AUTOSAR_Eth_43_PFE/BswModuleDescriptions/Eth/InternalBehavior_0/ETH_EXCLUSIVE_AREA_81</CAN-ENTER-EXCLUSIVE-AREA-REF>
                        <CAN-ENTER-EXCLUSIVE-AREA-REF DEST="EXCLUSIVE-AREA">/AUTOSAR_Eth_43_PFE/BswModuleDescriptions/Eth/InternalBehavior_0/ETH_EXCLUSIVE_AREA_82</CAN-ENTER-EXCLUSIVE-AREA-REF>
                        <CAN-ENTER-EXCLUSIVE-AREA-REF DEST="EXCLUSIVE-AREA">/AUTOSAR_Eth_43_PFE/BswModuleDescriptions/Eth/InternalBehavior_0/ETH_EXCLUSIVE_AREA_85</CAN-ENTER-EXCLUSIVE-AREA-REF>
                        <CAN-ENTER-EXCLUSIVE-AREA-REF DEST="EXCLUSIVE-AREA">/AUTOSAR_Eth_43_PFE/BswModuleDescriptions/Eth/InternalBehavior_0/ETH_EXCLUSIVE_AREA_86</CAN-ENTER-EXCLUSIVE-AREA-REF>
                        <CAN-ENTER-EXCLUSIVE-AREA-REF DEST="EXCLUSIVE-AREA">/AUTOSAR_Eth_43_PFE/BswModuleDescriptions/Eth/InternalBehavior_0/ETH_EXCLUSIVE_AREA_88</CAN-ENTER-EXCLUSIVE-AREA-REF>
                        <CAN-ENTER-EXCLUSIVE-AREA-REF DEST="EXCLUSIVE-AREA">/AUTOSAR_Eth_43_PFE/BswModuleDescriptions/Eth/InternalBehavior_0/ETH_EXCLUSIVE_AREA_89</CAN-ENTER-EXCLUSIVE-AREA-REF>
                        <CAN-ENTER-EXCLUSIVE-AREA-REF DEST="EXCLUSIVE-AREA">/AUTOSAR_Eth_43_PFE/BswModuleDescriptions/Eth/InternalBehavior_0/ETH_EXCLUSIVE_AREA_90</CAN-ENTER-EXCLUSIVE-AREA-REF>
                        <CAN-ENTER-EXCLUSIVE-AREA-REF DEST="EXCLUSIVE-AREA">/AUTOSAR_Eth_43_PFE/BswModuleDescriptions/Eth/InternalBehavior_0/ETH_EXCLUSIVE_AREA_91</CAN-ENTER-EXCLUSIVE-AREA-REF>
                        <CAN-ENTER-EXCLUSIVE-AREA-REF DEST="EXCLUSIVE-AREA">/AUTOSAR_Eth_43_PFE/BswModuleDescriptions/Eth/InternalBehavior_0/ETH_EXCLUSIVE_AREA_92</CAN-ENTER-EXCLUSIVE-AREA-REF>
                        <CAN-ENTER-EXCLUSIVE-AREA-REF DEST="EXCLUSIVE-AREA">/AUTOSAR_Eth_43_PFE/BswModuleDescriptions/Eth/InternalBehavior_0/ETH_EXCLUSIVE_AREA_93</CAN-ENTER-EXCLUSIVE-AREA-REF>
                        <CAN-ENTER-EXCLUSIVE-AREA-REF DEST="EXCLUSIVE-AREA">/AUTOSAR_Eth_43_PFE/BswModuleDescriptions/Eth/InternalBehavior_0/ETH_EXCLUSIVE_AREA_95</CAN-ENTER-EXCLUSIVE-AREA-REF>
                        <CAN-ENTER-EXCLUSIVE-AREA-REF DEST="EXCLUSIVE-AREA">/AUTOSAR_Eth_43_PFE/BswModuleDescriptions/Eth/InternalBehavior_0/ETH_EXCLUSIVE_AREA_97</CAN-ENTER-EXCLUSIVE-AREA-REF>
                        <CAN-ENTER-EXCLUSIVE-AREA-REF DEST="EXCLUSIVE-AREA">/AUTOSAR_Eth_43_PFE/BswModuleDescriptions/Eth/InternalBehavior_0/ETH_EXCLUSIVE_AREA_99</CAN-ENTER-EXCLUSIVE-AREA-REF>
                        <CAN-ENTER-EXCLUSIVE-AREA-REF DEST="EXCLUSIVE-AREA">/AUTOSAR_Eth_43_PFE/BswModuleDescriptions/Eth/InternalBehavior_0/ETH_EXCLUSIVE_AREA_100</CAN-ENTER-EXCLUSIVE-AREA-REF>
                        <CAN-ENTER-EXCLUSIVE-AREA-REF DEST="EXCLUSIVE-AREA">/AUTOSAR_Eth_43_PFE/BswModuleDescriptions/Eth/InternalBehavior_0/ETH_EXCLUSIVE_AREA_101</CAN-ENTER-EXCLUSIVE-AREA-REF>
                        <CAN-ENTER-EXCLUSIVE-AREA-REF DEST="EXCLUSIVE-AREA">/AUTOSAR_Eth_43_PFE/BswModuleDescriptions/Eth/InternalBehavior_0/ETH_EXCLUSIVE_AREA_102</CAN-ENTER-EXCLUSIVE-AREA-REF>
                        <CAN-ENTER-EXCLUSIVE-AREA-REF DEST="EXCLUSIVE-AREA">/AUTOSAR_Eth_43_PFE/BswModuleDescriptions/Eth/InternalBehavior_0/ETH_EXCLUSIVE_AREA_103</CAN-ENTER-EXCLUSIVE-AREA-REF>
                        <CAN-ENTER-EXCLUSIVE-AREA-REF DEST="EXCLUSIVE-AREA">/AUTOSAR_Eth_43_PFE/BswModuleDescriptions/Eth/InternalBehavior_0/ETH_EXCLUSIVE_AREA_104</CAN-ENTER-EXCLUSIVE-AREA-REF>
                      </CAN-ENTER-EXCLUSIVE-AREA-REFS>
                      <MINIMUM-START-INTERVAL>0.0</MINIMUM-START-INTERVAL>
                      <IMPLEMENTED-ENTRY-REF DEST="BSW-MODULE-ENTRY">/AUTOSAR_Eth_43_PFE/BswModuleEntrys/Eth_MainFunction</IMPLEMENTED-ENTRY-REF>
                    </BSW-SCHEDULABLE-ENTITY>
