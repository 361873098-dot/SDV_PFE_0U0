AUTOSAR XML (schema 00046)
package /AUTOSAR_Qdec/BswModuleDescriptions
  bsw module description Qdec: module-id=255
    provided-entrys:
      Ftm_Qdec_Ip_CounterState
      Ftm_Qdec_Ip_DisableOverFlowNotification
      Ftm_Qdec_Ip_EnableOverFlowNotification
      Ftm_Qdec_Ip_GetState
      Ftm_Qdec_Ip_ResetState
      Ftm_Qdec_Ip_SetClockMode
      Ftm_Qdec_Ip_SetMode
      Qdec_CounterState
      Qdec_DeInit
      Qdec_DisableOverFlowNotification
      Qdec_EnableOverFlowNotification
      Qdec_GetState
      Qdec_Init
      Qdec_ResetState
      Qdec_SetClockMode
      Qdec_SetMode
      FTM_{0..2}_ISR
    bsw internal behavior InternalBehavior_0
      7 x exclusive area:
        QDEC_EXCLUSIVE_AREA_{01..07}
      16 x bsw called entity:
        Ftm_Qdec_Ip_CounterState: can-enter-exclusive-area=QDEC_EXCLUSIVE_AREA_03, implemented-entry=Ftm_Qdec_Ip_CounterState
        Ftm_Qdec_Ip_DisableOverFlowNotification: can-enter-exclusive-area=QDEC_EXCLUSIVE_AREA_05, implemented-entry=Ftm_Qdec_Ip_DisableOverFlowNotification
        Ftm_Qdec_Ip_EnableOverFlowNotification: can-enter-exclusive-area=QDEC_EXCLUSIVE_AREA_06, implemented-entry=Ftm_Qdec_Ip_EnableOverFlowNotification
        Ftm_Qdec_Ip_GetState: can-enter-exclusive-area=QDEC_EXCLUSIVE_AREA_01, implemented-entry=Ftm_Qdec_Ip_GetState
        Ftm_Qdec_Ip_ResetState: can-enter-exclusive-area=QDEC_EXCLUSIVE_AREA_04, implemented-entry=Ftm_Qdec_Ip_ResetState
        Ftm_Qdec_Ip_SetClockMode: can-enter-exclusive-area=QDEC_EXCLUSIVE_AREA_02, implemented-entry=Ftm_Qdec_Ip_SetClockMode
        Ftm_Qdec_Ip_SetMode: can-enter-exclusive-area=QDEC_EXCLUSIVE_AREA_07, implemented-entry=Ftm_Qdec_Ip_SetMode
        Qdec_CounterState: can-enter-exclusive-area=QDEC_EXCLUSIVE_AREA_03, implemented-entry=Qdec_CounterState
        Qdec_DeInit: implemented-entry=Qdec_DeInit
        Qdec_DisableOverFlowNotification: can-enter-exclusive-area=QDEC_EXCLUSIVE_AREA_05, implemented-entry=Qdec_DisableOverFlowNotification
        Qdec_EnableOverFlowNotification: can-enter-exclusive-area=QDEC_EXCLUSIVE_AREA_06, implemented-entry=Qdec_EnableOverFlowNotification
        Qdec_GetState: can-enter-exclusive-area=QDEC_EXCLUSIVE_AREA_01, implemented-entry=Qdec_GetState
        Qdec_Init: implemented-entry=Qdec_Init
        Qdec_ResetState: can-enter-exclusive-area=QDEC_EXCLUSIVE_AREA_04, implemented-entry=Qdec_ResetState
        Qdec_SetClockMode: can-enter-exclusive-area=QDEC_EXCLUSIVE_AREA_02, implemented-entry=Qdec_SetClockMode
        Qdec_SetMode: can-enter-exclusive-area=QDEC_EXCLUSIVE_AREA_07, implemented-entry=Qdec_SetMode
      bsw interrupt entity FTM_{0..2}_ISR: implemented-entry=FTM_{0..2}_ISR, interrupt-category=CAT-2, interrupt-source=Hardware
package /AUTOSAR_Qdec/BswModuleEntrys
  19 x bsw module entry, all with is-synchronous=true, sw-service-impl-policy=STANDARD:
    Ftm_Qdec_Ip_CounterState: service-id=0x0c, is-reentrant=true, call-type=REGULAR, execution-context=UNSPECIFIED
    Ftm_Qdec_Ip_DisableOverFlowNotification: service-id=0x0e, is-reentrant=true, call-type=REGULAR, execution-context=UNSPECIFIED
    Ftm_Qdec_Ip_EnableOverFlowNotification: service-id=0x0f, is-reentrant=true, call-type=REGULAR, execution-context=UNSPECIFIED
    Ftm_Qdec_Ip_GetState: service-id=0x0a, is-reentrant=true, call-type=REGULAR, execution-context=UNSPECIFIED
    Ftm_Qdec_Ip_ResetState: service-id=0x0d, is-reentrant=true, call-type=REGULAR, execution-context=UNSPECIFIED
    Ftm_Qdec_Ip_SetClockMode: service-id=0x0b, is-reentrant=true, call-type=REGULAR, execution-context=UNSPECIFIED
    Ftm_Qdec_Ip_SetMode: service-id=0x10, is-reentrant=true, call-type=REGULAR, execution-context=UNSPECIFIED
    Qdec_CounterState: service-id=0x05, is-reentrant=true, call-type=REGULAR, execution-context=UNSPECIFIED
    Qdec_DeInit: service-id=0x02, is-reentrant=false, call-type=REGULAR, execution-context=UNSPECIFIED
    Qdec_DisableOverFlowNotification: service-id=0x07, is-reentrant=true, call-type=REGULAR, execution-context=UNSPECIFIED
    Qdec_EnableOverFlowNotification: service-id=0x08, is-reentrant=true, call-type=REGULAR, execution-context=UNSPECIFIED
    Qdec_GetState: service-id=0x03, is-reentrant=true, call-type=REGULAR, execution-context=UNSPECIFIED
    Qdec_Init: service-id=0x01, is-reentrant=false, call-type=REGULAR, execution-context=UNSPECIFIED
    Qdec_ResetState: service-id=0x06, is-reentrant=true, call-type=REGULAR, execution-context=UNSPECIFIED
    Qdec_SetClockMode: service-id=0x04, is-reentrant=false, call-type=REGULAR, execution-context=UNSPECIFIED
    Qdec_SetMode: service-id=0x09, is-reentrant=true, call-type=REGULAR, execution-context=UNSPECIFIED
    FTM_{0..2}_ISR: service-id=0, is-reentrant=false, call-type=INTERRUPT, execution-context=INTERRUPT-CAT-2
package /Qdec_TS_T40D11M40I2R0/Implementations
  bsw implementation BswImplementation_0: programming-language=C, sw-version=4.0.2, vendor-id=43, ar-release-version=4.4.0, behavior=InternalBehavior_0, vendor-specific-module-def=Qdec
    code-descriptors:
      code Files
        artifact-descriptors:
          short-label=config::Qdec.xdm, category=SWCFG
          short-label=doc::RTD_QDEC_IM.pdf, category=SWDOC
          short-label=doc::RTD_QDEC_UM.pdf, category=SWDOC
          short-label=examples::EBT::S32G2::Qdec_Example_S32G274A_M7::generate::epc::BaseNXP.xdm, category=SWCFG
          short-label=examples::EBT::S32G2::Qdec_Example_S32G274A_M7::generate::epc::Dem.xdm, category=SWCFG
          short-label=examples::EBT::S32G2::Qdec_Example_S32G274A_M7::generate::epc::Dio.xdm, category=SWCFG
          short-label=examples::EBT::S32G2::Qdec_Example_S32G274A_M7::generate::epc::Mcu.xdm, category=SWCFG
          short-label=examples::EBT::S32G2::Qdec_Example_S32G274A_M7::generate::epc::Port.xdm, category=SWCFG
          short-label=examples::EBT::S32G2::Qdec_Example_S32G274A_M7::generate::epc::Qdec.xdm, category=SWCFG
          short-label=examples::EBT::S32G2::Qdec_Example_S32G274A_M7::generate::epc::Resource.xdm, category=SWCFG
          short-label=examples::EBT::S32G2::Qdec_Example_S32G274A_M7::include::check_example.h, category=SWHDR
          short-label=examples::EBT::S32G2::Qdec_Example_S32G274A_M7::src::main.c, category=SWSRC
          short-label=examples::EBT::S32G2::Qdec_Example_S32G274A_M7::TresosProject::Qdec_Example_S32G274A_M7::.prefs::preferences.xdm, category=SWCFG
          short-label=examples::EBT::S32G2::Qdec_Example_S32G274A_M7::TresosProject::Qdec_Example_S32G274A_M7::config::BaseNXP.xdm, category=SWCFG
          short-label=examples::EBT::S32G2::Qdec_Example_S32G274A_M7::TresosProject::Qdec_Example_S32G274A_M7::config::Dem.xdm, category=SWCFG
          short-label=examples::EBT::S32G2::Qdec_Example_S32G274A_M7::TresosProject::Qdec_Example_S32G274A_M7::config::Dio.xdm, category=SWCFG
          short-label=examples::EBT::S32G2::Qdec_Example_S32G274A_M7::TresosProject::Qdec_Example_S32G274A_M7::config::EcuC.xdm, category=SWCFG
          short-label=examples::EBT::S32G2::Qdec_Example_S32G274A_M7::TresosProject::Qdec_Example_S32G274A_M7::config::Mcu.xdm, category=SWCFG
          short-label=examples::EBT::S32G2::Qdec_Example_S32G274A_M7::TresosProject::Qdec_Example_S32G274A_M7::config::Port.xdm, category=SWCFG
          short-label=examples::EBT::S32G2::Qdec_Example_S32G274A_M7::TresosProject::Qdec_Example_S32G274A_M7::config::Qdec.xdm, category=SWCFG
          short-label=examples::EBT::S32G2::Qdec_Example_S32G274A_M7::TresosProject::Qdec_Example_S32G274A_M7::config::Resource.xdm, category=SWCFG
          short-label=examples::EBT::S32G3::Qdec_Example_S32G399A_M7::generate::epc::BaseNXP.xdm, category=SWCFG
          short-label=examples::EBT::S32G3::Qdec_Example_S32G399A_M7::generate::epc::Dem.xdm, category=SWCFG
          short-label=examples::EBT::S32G3::Qdec_Example_S32G399A_M7::generate::epc::Dio.xdm, category=SWCFG
          short-label=examples::EBT::S32G3::Qdec_Example_S32G399A_M7::generate::epc::Mcu.xdm, category=SWCFG
          short-label=examples::EBT::S32G3::Qdec_Example_S32G399A_M7::generate::epc::Port.xdm, category=SWCFG
          short-label=examples::EBT::S32G3::Qdec_Example_S32G399A_M7::generate::epc::Qdec.xdm, category=SWCFG
          short-label=examples::EBT::S32G3::Qdec_Example_S32G399A_M7::generate::epc::Resource.xdm, category=SWCFG
          short-label=examples::EBT::S32G3::Qdec_Example_S32G399A_M7::include::check_example.h, category=SWHDR
          short-label=examples::EBT::S32G3::Qdec_Example_S32G399A_M7::src::main.c, category=SWSRC
          short-label=examples::EBT::S32G3::Qdec_Example_S32G399A_M7::TresosProject::Qdec_Example_S32G399A_M7::.prefs::preferences.xdm, category=SWCFG
          short-label=examples::EBT::S32G3::Qdec_Example_S32G399A_M7::TresosProject::Qdec_Example_S32G399A_M7::config::BaseNXP.xdm, category=SWCFG
          short-label=examples::EBT::S32G3::Qdec_Example_S32G399A_M7::TresosProject::Qdec_Example_S32G399A_M7::config::Dem.xdm, category=SWCFG
          short-label=examples::EBT::S32G3::Qdec_Example_S32G399A_M7::TresosProject::Qdec_Example_S32G399A_M7::config::Dio.xdm, category=SWCFG
          short-label=examples::EBT::S32G3::Qdec_Example_S32G399A_M7::TresosProject::Qdec_Example_S32G399A_M7::config::EcuC.xdm, category=SWCFG
          short-label=examples::EBT::S32G3::Qdec_Example_S32G399A_M7::TresosProject::Qdec_Example_S32G399A_M7::config::Mcu.xdm, category=SWCFG
          short-label=examples::EBT::S32G3::Qdec_Example_S32G399A_M7::TresosProject::Qdec_Example_S32G399A_M7::config::Port.xdm, category=SWCFG
          short-label=examples::EBT::S32G3::Qdec_Example_S32G399A_M7::TresosProject::Qdec_Example_S32G399A_M7::config::Qdec.xdm, category=SWCFG
          short-label=examples::EBT::S32G3::Qdec_Example_S32G399A_M7::TresosProject::Qdec_Example_S32G399A_M7::config::Resource.xdm, category=SWCFG
          short-label=examples::S32DS::S32G2::Ftm_Qdec_Ip_Example_S32G274A_M7::include::check_example.h, category=SWHDR
          short-label=examples::S32DS::S32G2::Ftm_Qdec_Ip_Example_S32G274A_M7::Project_Settings::Startup_Code::exceptions.c, category=SWSRC
          short-label=examples::S32DS::S32G2::Ftm_Qdec_Ip_Example_S32G274A_M7::Project_Settings::Startup_Code::nvic.c, category=SWSRC
          short-label=examples::S32DS::S32G2::Ftm_Qdec_Ip_Example_S32G274A_M7::Project_Settings::Startup_Code::startup.c, category=SWSRC
          short-label=examples::S32DS::S32G2::Ftm_Qdec_Ip_Example_S32G274A_M7::Project_Settings::Startup_Code::system.c, category=SWSRC
          short-label=examples::S32DS::S32G2::Ftm_Qdec_Ip_Example_S32G274A_M7::src::main.c, category=SWSRC
          short-label=examples::S32DS::S32G2::Qdec_Example_S32G274A_M7::include::check_example.h, category=SWHDR
          short-label=examples::S32DS::S32G2::Qdec_Example_S32G274A_M7::Project_Settings::Startup_Code::exceptions.c, category=SWSRC
          short-label=examples::S32DS::S32G2::Qdec_Example_S32G274A_M7::Project_Settings::Startup_Code::nvic.c, category=SWSRC
          short-label=examples::S32DS::S32G2::Qdec_Example_S32G274A_M7::Project_Settings::Startup_Code::startup.c, category=SWSRC
          short-label=examples::S32DS::S32G2::Qdec_Example_S32G274A_M7::Project_Settings::Startup_Code::system.c, category=SWSRC
          short-label=examples::S32DS::S32G2::Qdec_Example_S32G274A_M7::src::main.c, category=SWSRC
          short-label=examples::S32DS::S32G3::Ftm_Qdec_Ip_Example_S32G399A_M7::include::check_example.h, category=SWHDR
          short-label=examples::S32DS::S32G3::Ftm_Qdec_Ip_Example_S32G399A_M7::Project_Settings::Startup_Code::exceptions.c, category=SWSRC
          short-label=examples::S32DS::S32G3::Ftm_Qdec_Ip_Example_S32G399A_M7::Project_Settings::Startup_Code::nvic.c, category=SWSRC
          short-label=examples::S32DS::S32G3::Ftm_Qdec_Ip_Example_S32G399A_M7::Project_Settings::Startup_Code::startup.c, category=SWSRC
          short-label=examples::S32DS::S32G3::Ftm_Qdec_Ip_Example_S32G399A_M7::Project_Settings::Startup_Code::system.c, category=SWSRC
          short-label=examples::S32DS::S32G3::Ftm_Qdec_Ip_Example_S32G399A_M7::src::main.c, category=SWSRC
          short-label=examples::S32DS::S32G3::Qdec_Example_S32G399A_M7::include::check_example.h, category=SWHDR
          short-label=examples::S32DS::S32G3::Qdec_Example_S32G399A_M7::Project_Settings::Startup_Code::exceptions.c, category=SWSRC
          short-label=examples::S32DS::S32G3::Qdec_Example_S32G399A_M7::Project_Settings::Startup_Code::nvic.c, category=SWSRC
          short-label=examples::S32DS::S32G3::Qdec_Example_S32G399A_M7::Project_Settings::Startup_Code::startup.c, category=SWSRC
          short-label=examples::S32DS::S32G3::Qdec_Example_S32G399A_M7::Project_Settings::Startup_Code::system.c, category=SWSRC
          short-label=examples::S32DS::S32G3::Qdec_Example_S32G399A_M7::src::main.c, category=SWSRC
          short-label=include::Ftm_Qdec_Ip.h, category=SWHDR
          short-label=include::Ftm_Qdec_Ip_Irq.h, category=SWHDR
          short-label=include::Ftm_Qdec_Ip_TrustedFunctions.h, category=SWHDR
          short-label=include::Ftm_Qdec_Ip_Types.h, category=SWHDR
          short-label=include::Qdec.h, category=SWHDR
          short-label=include::Qdec_EnvCfg.h, category=SWHDR
          short-label=include::Qdec_Ipw.h, category=SWHDR
          short-label=include::Qdec_Ipw_Irq.h, category=SWHDR
          short-label=include::Qdec_Ipw_Types.h, category=SWHDR
          short-label=include::Qdec_Types.h, category=SWHDR
          short-label=src::Ftm_Qdec_Ip.c, category=SWSRC
          short-label=src::Ftm_Qdec_Ip_Irq.c, category=SWSRC
          short-label=src::Qdec.c, category=SWSRC
          short-label=src::Qdec_Ipw.c, category=SWSRC
    compiler DIAB_Compiler:
      name=Windriver Diab
      options=-tARMCORTEXM7MG:simple -mthumb -std=c99 -Oz -g -fstandalone-debug -Wstrict-prototypes -Wsign-compare -Wdouble-promotion -Wunknown-pragmas -Wundef -Wextra -Wall -pedantic -Werror=implicit-function-declaration -fno-common -fno-signed-char -fno-trigraphs -V -c -DS32XX -DS32G2XX -DS32G3XX -DS32R45 -DDIAB -DUSE_SW_VECTOR_MODE -DD_CACHE_ENABLE -DI_CACHE_ENABLE -DENABLE_FPU -DMCAL_ENABLE_USER_MODE_SUPPORT
      vendor=Windriver
      version=DIAB_7_0_3_0-FCS_20200409_160912
    compiler GCC_Compiler:
      name=GCC Compiler
      options=-mcpu=cortex-m7 -mthumb -mlittle-endian -mfpu=fpv5-sp-d16 -mfloat-abi=hard -std=c99 -Os -ggdb3 -Wall -Wextra -pedantic -Wstrict-prototypes -Wundef -Wunused -Werror=implicit-function-declaration -Wsign-compare -Wdouble-promotion -fno-short-enums -funsigned-char -funsigned-bitfields -fomit-frame-pointer -fno-common -fstack-usage -fdump-ipa-all -c -DS32XX -DS32G2XX -DS32G3XX -DS32R45 -DGCC -DUSE_SW_VECTOR_MODE -DD_CACHE_ENABLE -DI_CACHE_ENABLE -DENABLE_FPU -DMCAL_ENABLE_USER_MODE_SUPPORT
      vendor=GCC Systems
      version=NXP GCC 9.2.0 20190812 (Build 1649 Revision gaf57174)
    compiler GHS_Compiler:
      name=Green Hills
      options=-cpu=cortexm7 -thumb -fpu=vfpv5_d16 -fsingle -C99 --ghstd=last -Osize --gnu_asm -dual_debug -G -keeptempfiles -Wimplicit-int -Wshadow -Wtrigraphs -Wundef --unsigned_chars --unsigned_fields --no_commons --no_exceptions --no_slash_comment --prototype_errors --incorrect_pragma_warnings -c -DS32XX -DS32G2XX -DS32G3XX -DS32R45 -DGHS -DUSE_SW_VECTOR_MODE -DD_CACHE_ENABLE -DI_CACHE_ENABLE -DENABLE_FPU -DMCAL_ENABLE_USER_MODE_SUPPORT
      vendor=Green Hills
      version=Green Hills Multi 7.1.6d / Compiler 2020.1.4
    generated-artifacts:
      9 x dependency on artifact:
        Ftm_Qdec_Ip_PBcfg_h: artifact-descriptor={short-label=generate_PB::include::Ftm_Qdec_Ip_PBcfg.h, category=SWHDR}, usages=EXECUTE
        Qdec_Ipw_PBcfg_h: artifact-descriptor={short-label=generate_PB::include::Qdec_Ipw_PBcfg.h, category=SWHDR}, usages=EXECUTE
        Qdec_PBcfg_h: artifact-descriptor={short-label=generate_PB::include::Qdec_PBcfg.h, category=SWHDR}, usages=EXECUTE
        Ftm_Qdec_Ip_PBcfg_c: artifact-descriptor={short-label=generate_PB::src::Ftm_Qdec_Ip_PBcfg.c, category=SWSRC}, usages=EXECUTE
        Qdec_Ipw_PBcfg_c: artifact-descriptor={short-label=generate_PB::src::Qdec_Ipw_PBcfg.c, category=SWSRC}, usages=EXECUTE
        Qdec_PBcfg_c: artifact-descriptor={short-label=generate_PB::src::Qdec_PBcfg.c, category=SWSRC}, usages=EXECUTE
        Ftm_Qdec_Ip_Cfg_h: artifact-descriptor={short-label=generate_PC::include::Ftm_Qdec_Ip_Cfg.h, category=SWHDR}, usages=COMPILE
        Ftm_Qdec_Ip_CfgDefines_h: artifact-descriptor={short-label=generate_PC::include::Ftm_Qdec_Ip_CfgDefines.h, category=SWHDR}, usages=COMPILE
        Qdec_Cfg_h: artifact-descriptor={short-label=generate_PC::include::Qdec_Cfg.h, category=SWHDR}, usages=COMPILE
    linker DIAB_Linker: name=Windriver Diab, options=-e Reset_Handler linker_script_file.dld -m30 -Xstack-usage -Xpreprocess-lecl -Llibrary_path -lc -lm, vendor=Windriver, version=DIAB_7_0_3_0-FCS_20200409_160912
    linker GCC_Linker: name=GCC Compiler, options=-Wl,-Map,filename -T linkerfile --entry=Reset_Handler -nostartfiles -mcpu=cortexm7 -mthumb -mfpu=fpv5-sp-d16 -mfloat-abi=hard -mlittle-endian -ggdb3 -lc -lm -lgcc, vendor=GCC Systems, version=NXP GCC 9.2.0 20190812 (Build 1649 Revision gaf57174)
    linker GHS_Linker: name=Green Hills, options=-e Reset_Handler -T linker_script_file.ld -map -keepmap -Mn -delete -ignore_debug_references -Llibrary_path -larch -lstartup -lind_sd -v -nostartfiles, vendor=Green Hills, version=Green Hills Multi 7.1.6d / Compiler 2020.1.4
    resource consumption ResourceConsumption
      6 x memory section:
        QDEC_CODE: alignment=UNSPECIFIED, sw-addrmethod=CODE, symbol=CODE
        QDEC_CONFIG_DATA_UNSPECIFIED: alignment=UNSPECIFIED, sw-addrmethod=CONFIG_DATA, symbol=CONFIG_DATA_UNSPECIFIED
        QDEC_CONST_UNSPECIFIED: alignment=UNSPECIFIED, sw-addrmethod=CONST, symbol=CONST_UNSPECIFIED
        QDEC_VAR_CLEARED_BOOLEAN: alignment=BOOLEAN, sw-addrmethod=VAR_CLEARED, symbol=VAR_CLEARED_BOOLEAN
        QDEC_VAR_CLEARED_UNSPECIFIED: alignment=UNSPECIFIED, sw-addrmethod=VAR_CLEARED, symbol=VAR_CLEARED_UNSPECIFIED
        QDEC_VAR_INIT_UNSPECIFIED: alignment=UNSPECIFIED, sw-addrmethod=VAR_INIT, symbol=VAR_INIT_UNSPECIFIED
