[part 3 of 3]
[!IF "EthGeneral/EthVendorSpecific/EthCommonHif = 'HIF0'"!][!//
                    <BSW-INTERRUPT-ENTITY>
                      <SHORT-NAME>Eth_43_PFE_HifIrqHdlr_0</SHORT-NAME>
                      <CAN-ENTER-EXCLUSIVE-AREA-REFS>
                        <CAN-ENTER-EXCLUSIVE-AREA-REF DEST="EXCLUSIVE-AREA">/AUTOSAR_Eth_43_PFE/BswModuleDescriptions/Eth/InternalBehavior_0/ETH_EXCLUSIVE_AREA_01</CAN-ENTER-EXCLUSIVE-AREA-REF>
                        <CAN-ENTER-EXCLUSIVE-AREA-REF DEST="EXCLUSIVE-AREA">/AUTOSAR_Eth_43_PFE/BswModuleDescriptions/Eth/InternalBehavior_0/ETH_EXCLUSIVE_AREA_03</CAN-ENTER-EXCLUSIVE-AREA-REF>
                        <CAN-ENTER-EXCLUSIVE-AREA-REF DEST="EXCLUSIVE-AREA">/AUTOSAR_Eth_43_PFE/BswModuleDescriptions/Eth/InternalBehavior_0/ETH_EXCLUSIVE_AREA_04</CAN-ENTER-EXCLUSIVE-AREA-REF>
                        <CAN-ENTER-EXCLUSIVE-AREA-REF DEST="EXCLUSIVE-AREA">/AUTOSAR_Eth_43_PFE/BswModuleDescriptions/Eth/InternalBehavior_0/ETH_EXCLUSIVE_AREA_05</CAN-ENTER-EXCLUSIVE-AREA-REF>
                        <CAN-ENTER-EXCLUSIVE-AREA-REF DEST="EXCLUSIVE-AREA">/AUTOSAR_Eth_43_PFE/BswModuleDescriptions/Eth/InternalBehavior_0/ETH_EXCLUSIVE_AREA_07</CAN-ENTER-EXCLUSIVE-AREA-REF>
                        <CAN-ENTER-EXCLUSIVE-AREA-REF DEST="EXCLUSIVE-AREA">/AUTOSAR_Eth_43_PFE/BswModuleDescriptions/Eth/InternalBehavior_0/ETH_EXCLUSIVE_AREA_08</CAN-ENTER-EXCLUSIVE-AREA-REF>
                        <CAN-ENTER-EXCLUSIVE-AREA-REF DEST="EXCLUSIVE-AREA">/AUTOSAR_Eth_43_PFE/BswModuleDescriptions/Eth/InternalBehavior_0/ETH_EXCLUSIVE_AREA_09</CAN-ENTER-EXCLUSIVE-AREA-REF>
                        <CAN-ENTER-EXCLUSIVE-AREA-REF DEST="EXCLUSIVE-AREA">/AUTOSAR_Eth_43_PFE/BswModuleDescriptions/Eth/InternalBehavior_0/ETH_EXCLUSIVE_AREA_10</CAN-ENTER-EXCLUSIVE-AREA-REF>
                        <CAN-ENTER-EXCLUSIVE-AREA-REF DEST="EXCLUSIVE-AREA">/AUTOSAR_Eth_43_PFE/BswModuleDescriptions/Eth/InternalBehavior_0/ETH_EXCLUSIVE_AREA_13</CAN-ENTER-EXCLUSIVE-AREA-REF>
                        <CAN-ENTER-EXCLUSIVE-AREA-REF DEST="EXCLUSIVE-AREA">/AUTOSAR_Eth_43_PFE/BswModuleDescriptions/Eth/InternalBehavior_0/ETH_EXCLUSIVE_AREA_14</CAN-ENTER-EXCLUSIVE-AREA-REF>
                        <CAN-ENTER-EXCLUSIVE-AREA-REF DEST="EXCLUSIVE-AREA">/AUTOSAR_Eth_43_PFE/BswModuleDescriptions/Eth/InternalBehavior_0/ETH_EXCLUSIVE_AREA_15</CAN-ENTER-EXCLUSIVE-AREA-REF>
                        <CAN-ENTER-EXCLUSIVE-AREA-REF DEST="EXCLUSIVE-AREA">/AUTOSAR_Eth_43_PFE/BswModuleDescriptions/Eth/InternalBehavior_0/ETH_EXCLUSIVE_AREA_16</CAN-ENTER-EXCLUSIVE-AREA-REF>
                        <CAN-ENTER-EXCLUSIVE-AREA-REF DEST="EXCLUSIVE-AREA">/AUTOSAR_Eth_43_PFE/BswModuleDescriptions/Eth/InternalBehavior_0/ETH_EXCLUSIVE_AREA_18</CAN-ENTER-EXCLUSIVE-AREA-REF>
                        <CAN-ENTER-EXCLUSIVE-AREA-REF DEST="EXCLUSIVE-AREA">/AUTOSAR_Eth_43_PFE/BswModuleDescriptions/Eth/InternalBehavior_0/ETH_EXCLUSIVE_AREA_20</CAN-ENTER-EXCLUSIVE-AREA-REF>
                        <CAN-ENTER-EXCLUSIVE-AREA-REF DEST="EXCLUSIVE-AREA">/AUTOSAR_Eth_43_PFE/BswModuleDescriptions/Eth/InternalBehavior_0/ETH_EXCLUSIVE_AREA_21</CAN-ENTER-EXCLUSIVE-AREA-REF>
                        <CAN-ENTER-EXCLUSIVE-AREA-REF DEST="EXCLUSIVE-AREA">/AUTOSAR_Eth_43_PFE/BswModuleDescriptions/Eth/InternalBehavior_0/ETH_EXCLUSIVE_AREA_22</CAN-ENTER-EXCLUSIVE-AREA-REF>
                        <CAN-ENTER-EXCLUSIVE-AREA-REF DEST="EXCLUSIVE-AREA">/AUTOSAR_Eth_43_PFE/BswModuleDescriptions/Eth/InternalBehavior_0/ETH_EXCLUSIVE_AREA_23</CAN-ENTER-EXCLUSIVE-AREA-REF>
                        <CAN-ENTER-EXCLUSIVE-AREA-REF DEST="EXCLUSIVE-AREA">/AUTOSAR_Eth_43_PFE/BswModuleDescriptions/Eth/InternalBehavior_0/ETH_EXCLUSIVE_AREA_26</CAN-ENTER-EXCLUSIVE-AREA-REF>
                        <CAN-ENTER-EXCLUSIVE-AREA-REF DEST="EXCLUSIVE-AREA">/AUTOSAR_Eth_43_PFE/BswModuleDescriptions/Eth/InternalBehavior_0/ETH_EXCLUSIVE_AREA_28</CAN-ENTER-EXCLUSIVE-AREA-REF>
                        <CAN-ENTER-EXCLUSIVE-AREA-REF DEST="EXCLUSIVE-AREA">/AUTOSAR_Eth_43_PFE/BswModuleDescriptions/Eth/InternalBehavior_0/ETH_EXCLUSIVE_AREA_30</CAN-ENTER-EXCLUSIVE-AREA-REF>
                        <CAN-ENTER-EXCLUSIVE-AREA-REF DEST="EXCLUSIVE-AREA">/AUTOSAR_Eth_43_PFE/BswModuleDescriptions/Eth/InternalBehavior_0/ETH_EXCLUSIVE_AREA_31</CAN-ENTER-EXCLUSIVE-AREA-REF>
                        <CAN-ENTER-EXCLUSIVE-AREA-REF DEST="EXCLUSIVE-AREA">/AUTOSAR_Eth_43_PFE/BswModuleDescriptions/Eth/InternalBehavior_0/ETH_EXCLUSIVE_AREA_38</CAN-ENTER-EXCLUSIVE-AREA-REF>
                        <CAN-ENTER-EXCLUSIVE-AREA-REF DEST="EXCLUSIVE-AREA">/AUTOSAR_Eth_43_PFE/BswModuleDescriptions/Eth/InternalBehavior_0/ETH_EXCLUSIVE_AREA_39</CAN-ENTER-EXCLUSIVE-AREA-REF>
                        <CAN-ENTER-EXCLUSIVE-AREA-REF DEST="EXCLUSIVE-AREA">/AUTOSAR_Eth_43_PFE/BswModuleDescriptions/Eth/InternalBehavior_0/ETH_EXCLUSIVE_AREA_40</CAN-ENTER-EXCLUSIVE-AREA-REF>
                        <CAN-ENTER-EXCLUSIVE-AREA-REF DEST="EXCLUSIVE-AREA">/AUTOSAR_Eth_43_PFE/BswModuleDescriptions/Eth/InternalBehavior_0/ETH_EXCLUSIVE_AREA_41</CAN-ENTER-EXCLUSIVE-AREA-REF>
                        <CAN-ENTER-EXCLUSIVE-AREA-REF DEST="EXCLUSIVE-AREA">/AUTOSAR_Eth_43_PFE/BswModuleDescriptions/Eth/InternalBehavior_0/ETH_EXCLUSIVE_AREA_42</CAN-ENTER-EXCLUSIVE-AREA-REF>
                        <CAN-ENTER-EXCLUSIVE-AREA-REF DEST="EXCLUSIVE-AREA">/AUTOSAR_Eth_43_PFE/BswModuleDescriptions/Eth/InternalBehavior_0/ETH_EXCLUSIVE_AREA_43</CAN-ENTER-EXCLUSIVE-AREA-REF>
                        <CAN-ENTER-EXCLUSIVE-AREA-REF DEST="EXCLUSIVE-AREA">/AUTOSAR_Eth_43_PFE/BswModuleDescriptions/Eth/InternalBehavior_0/ETH_EXCLUSIVE_AREA_45</CAN-ENTER-EXCLUSIVE-AREA-REF>
                        <CAN-ENTER-EXCLUSIVE-AREA-REF DEST="EXCLUSIVE-AREA">/AUTOSAR_Eth_43_PFE/BswModuleDescriptions/Eth/InternalBehavior_0/ETH_EXCLUSIVE_AREA_46</CAN-ENTER-EXCLUSIVE-AREA-REF>
                        <CAN-ENTER-EXCLUSIVE-AREA-REF DEST="EXCLUSIVE-AREA">/AUTOSAR_Eth_43_PFE/BswModuleDescriptions/Eth/InternalBehavior_0/ETH_EXCLUSIVE_AREA_47</CAN-ENTER-EXCLUSIVE-AREA-REF>
                        <CAN-ENTER-EXCLUSIVE-AREA-REF DEST="EXCLUSIVE-AREA">/AUTOSAR_Eth_43_PFE/BswModuleDescriptions/Eth/InternalBehavior_0/ETH_EXCLUSIVE_AREA_48</CAN-ENTER-EXCLUSIVE-AREA-REF>
                        <CAN-ENTER-EXCLUSIVE-AREA-REF DEST="EXCLUSIVE-AREA">/AUTOSAR_Eth_43_PFE/BswModuleDescriptions/Eth/InternalBehavior_0/ETH_EXCLUSIVE_AREA_50</CAN-ENTER-EXCLUSIVE-AREA-REF>
                        <CAN-ENTER-EXCLUSIVE-AREA-REF DEST="EXCLUSIVE-AREA">/AUTOSAR_Eth_43_PFE/BswModuleDescriptions/Eth/InternalBehavior_0/ETH_EXCLUSIVE_AREA_54</CAN-ENTER-EXCLUSIVE-AREA-REF>
                        <CAN-ENTER-EXCLUSIVE-AREA-REF DEST="EXCLUSIVE-AREA">/AUTOSAR_Eth_43_PFE/BswModuleDescriptions/Eth/InternalBehavior_0/ETH_EXCLUSIVE_AREA_55</CAN-ENTER-EXCLUSIVE-AREA-REF>
                        <CAN-ENTER-EXCLUSIVE-AREA-REF DEST="EXCLUSIVE-AREA">/AUTOSAR_Eth_43_PFE/BswModuleDescriptions/Eth/InternalBehavior_0/ETH_EXCLUSIVE_AREA_56</CAN-ENTER-EXCLUSIVE-AREA-REF>
                        <CAN-ENTER-EXCLUSIVE-AREA-REF DEST="EXCLUSIVE-AREA">/AUTOSAR_Eth_43_PFE/BswModuleDescriptions/Eth/InternalBehavior_0/ETH_EXCLUSIVE_AREA_57</CAN-ENTER-EXCLUSIVE-AREA-REF>
                        <CAN-ENTER-EXCLUSIVE-AREA-REF DEST="EXCLUSIVE-AREA">/AUTOSAR_Eth_43_PFE/BswModuleDescriptions/Eth/InternalBehavior_0/ETH_EXCLUSIVE_AREA_58</CAN-ENTER-EXCLUSIVE-AREA-REF>
                        <CAN-ENTER-EXCLUSIVE-AREA-REF DEST="EXCLUSIVE-AREA">/AUTOSAR_Eth_43_PFE/BswModuleDescriptions/Eth/InternalBehavior_0/ETH_EXCLUSIVE_AREA_59</CAN-ENTER-EXCLUSIVE-AREA-REF>
                        <CAN-ENTER-EXCLUSIVE-AREA-REF DEST="EXCLUSIVE-AREA">/AUTOSAR_Eth_43_PFE/BswModuleDescriptions/Eth/InternalBehavior_0/ETH_EXCLUSIVE_AREA_60</CAN-ENTER-EXCLUSIVE-AREA-REF>
                        <CAN-ENTER-EXCLUSIVE-AREA-REF DEST="EXCLUSIVE-AREA">/AUTOSAR_Eth_43_PFE/BswModuleDescriptions/Eth/InternalBehavior_0/ETH_EXCLUSIVE_AREA_65</CAN-ENTER-EXCLUSIVE-AREA-REF>
                        <CAN-ENTER-EXCLUSIVE-AREA-REF DEST="EXCLUSIVE-AREA">/AUTOSAR_Eth_43_PFE/BswModuleDescriptions/Eth/InternalBehavior_0/ETH_EXCLUSIVE_AREA_66</CAN-ENTER-EXCLUSIVE-AREA-REF>
                        <CAN-ENTER-EXCLUSIVE-AREA-REF DEST="EXCLUSIVE-AREA">/AUTOSAR_Eth_43_PFE/BswModuleDescriptions/Eth/InternalBehavior_0/ETH_EXCLUSIVE_AREA_67</CAN-ENTER-EXCLUSIVE-AREA-REF>
                        <CAN-ENTER-EXCLUSIVE-AREA-REF DEST="EXCLUSIVE-AREA">/AUTOSAR_Eth_43_PFE/BswModuleDescriptions/Eth/InternalBehavior_0/ETH_EXCLUSIVE_AREA_68</CAN-ENTER-EXCLUSIVE-AREA-REF>
                        <CAN-ENTER-EXCLUSIVE-AREA-REF DEST="EXCLUSIVE-AREA">/AUTOSAR_Eth_43_PFE/BswModuleDescriptions/Eth/InternalBehavior_0/ETH_EXCLUSIVE_AREA_69</CAN-ENTER-EXCLUSIVE-AREA-REF>
                        <CAN-ENTER-EXCLUSIVE-AREA-REF DEST="EXCLUSIVE-AREA">/AUTOSAR_Eth_43_PFE/BswModuleDescriptions/Eth/InternalBehavior_0/ETH_EXCLUSIVE_AREA_70</CAN-ENTER-EXCLUSIVE-AREA-REF>
                        <CAN-ENTER-EXCLUSIVE-AREA-REF DEST="EXCLUSIVE-AREA">/AUTOSAR_Eth_43_PFE/BswModuleDescriptions/Eth/InternalBehavior_0/ETH_EXCLUSIVE_AREA_71</CAN-ENTER-EXCLUSIVE-AREA-REF>
                        <CAN-ENTER-EXCLUSIVE-AREA-REF DEST="EXCLUSIVE-AREA">/AUTOSAR_Eth_43_PFE/BswModuleDescriptions/Eth/InternalBehavior_0/ETH_EXCLUSIVE_AREA_72</CAN-ENTER-EXCLUSIVE-AREA-REF>
                        <CAN-ENTER-EXCLUSIVE-AREA-REF DEST="EXCLUSIVE-AREA">/AUTOSAR_Eth_43_PFE/BswModuleDescriptions/Eth/InternalBehavior_0/ETH_EXCLUSIVE_AREA_73</CAN-ENTER-EXCLUSIVE-AREA-REF>
                        <CAN-ENTER-EXCLUSIVE-AREA-REF DEST="EXCLUSIVE-AREA">/AUTOSAR_Eth_43_PFE/BswModuleDescriptions/Eth/InternalBehavior_0/ETH_EXCLUSIVE_AREA_74</CAN-ENTER-EXCLUSIVE-AREA-REF>
                        <CAN-ENTER-EXCLUSIVE-AREA-REF DEST="EXCLUSIVE-AREA">/AUTOSAR_Eth_43_PFE/BswModuleDescriptions/Eth/InternalBehavior_0/ETH_EXCLUSIVE_AREA_77</CAN-ENTER-EXCLUSIVE-AREA-REF>
                        <CAN-ENTER-EXCLUSIVE-AREA-REF DEST="EXCLUSIVE-AREA">/AUTOSAR_Eth_43_PFE/BswModuleDescriptions/Eth/InternalBehavior_0/ETH_EXCLUSIVE_AREA_78</CAN-ENTER-EXCLUSIVE-AREA-REF>
                        <CAN-ENTER-EXCLUSIVE-AREA-REF DEST="EXCLUSIVE-AREA">/AUTOSAR_Eth_43_PFE/BswModuleDescriptions/Eth/InternalBehavior_0/ETH_EXCLUSIVE_AREA_79</CAN-ENTER-EXCLUSIVE-AREA-REF>
                        <CAN-ENTER-EXCLUSIVE-AREA-REF DEST="EXCLUSIVE-AREA">/AUTOSAR_Eth_43_PFE/BswModuleDescriptions/Eth/InternalBehavior_0/ETH_EXCLUSIVE_AREA_81</CAN-ENTER-EXCLUSIVE-AREA-REF>
                        <CAN-ENTER-EXCLUSIVE-AREA-REF DEST="EXCLUSIVE-AREA">/AUTOSAR_Eth_43_PFE/BswModuleDescriptions/Eth/InternalBehavior_0/ETH_EXCLUSIVE_AREA_82</CAN-ENTER-EXCLUSIVE-AREA-REF>
                        <CAN-ENTER-EXCLUSIVE-AREA-REF DEST="EXCLUSIVE-AREA">/AUTOSAR_Eth_43_PFE/BswModuleDescriptions/Eth/InternalBehavior_0/ETH_EXCLUSIVE_AREA_85</CAN-ENTER-EXCLUSIVE-AREA-REF>
                        <CAN-ENTER-EXCLUSIVE-AREA-REF DEST="EXCLUSIVE-AREA">/AUTOSAR_Eth_43_PFE/BswModuleDescriptions/Eth/InternalBehavior_0/ETH_EXCLUSIVE_AREA_86</CAN-ENTER-EXCLUSIVE-AREA-REF>
                        <CAN-ENTER-EXCLUSIVE-AREA-REF DEST="EXCLUSIVE-AREA">/AUTOSAR_Eth_43_PFE/BswModuleDescriptions/Eth/InternalBehavior_0/ETH_EXCLUSIVE_AREA_88</CAN-ENTER-EXCLUSIVE-AREA-REF>
                        <CAN-ENTER-EXCLUSIVE-AREA-REF DEST="EXCLUSIVE-AREA">/AUTOSAR_Eth_43_PFE/BswModuleDescriptions/Eth/InternalBehavior_0/ETH_EXCLUSIVE_AREA_89</CAN-ENTER-EXCLUSIVE-AREA-REF>
                        <CAN-ENTER-EXCLUSIVE-AREA-REF DEST="EXCLUSIVE-AREA">/AUTOSAR_Eth_43_PFE/BswModuleDescriptions/Eth/InternalBehavior_0/ETH_EXCLUSIVE_AREA_90</CAN-ENTER-EXCLUSIVE-AREA-REF>
                        <CAN-ENTER-EXCLUSIVE-AREA-REF DEST="EXCLUSIVE-AREA">/AUTOSAR_Eth_43_PFE/BswModuleDescriptions/Eth/InternalBehavior_0/ETH_EXCLUSIVE_AREA_92</CAN-ENTER-EXCLUSIVE-AREA-REF>
                        <CAN-ENTER-EXCLUSIVE-AREA-REF DEST="EXCLUSIVE-AREA">/AUTOSAR_Eth_43_PFE/BswModuleDescriptions/Eth/InternalBehavior_0/ETH_EXCLUSIVE_AREA_93</CAN-ENTER-EXCLUSIVE-AREA-REF>
                        <CAN-ENTER-EXCLUSIVE-AREA-REF DEST="EXCLUSIVE-AREA">/AUTOSAR_Eth_43_PFE/BswModuleDescriptions/Eth/InternalBehavior_0/ETH_EXCLUSIVE_AREA_94</CAN-ENTER-EXCLUSIVE-AREA-REF>
                        <CAN-ENTER-EXCLUSIVE-AREA-REF DEST="EXCLUSIVE-AREA">/AUTOSAR_Eth_43_PFE/BswModuleDescriptions/Eth/InternalBehavior_0/ETH_EXCLUSIVE_AREA_95</CAN-ENTER-EXCLUSIVE-AREA-REF>
                        <CAN-ENTER-EXCLUSIVE-AREA-REF DEST="EXCLUSIVE-AREA">/AUTOSAR_Eth_43_PFE/BswModuleDescriptions/Eth/InternalBehavior_0/ETH_EXCLUSIVE_AREA_97</CAN-ENTER-EXCLUSIVE-AREA-REF>
                        <CAN-ENTER-EXCLUSIVE-AREA-REF DEST="EXCLUSIVE-AREA">/AUTOSAR_Eth_43_PFE/BswModuleDescriptions/Eth/InternalBehavior_0/ETH_EXCLUSIVE_AREA_99</CAN-ENTER-EXCLUSIVE-AREA-REF>
                        <CAN-ENTER-EXCLUSIVE-AREA-REF DEST="EXCLUSIVE-AREA">/AUTOSAR_Eth_43_PFE/BswModuleDescriptions/Eth/InternalBehavior_0/ETH_EXCLUSIVE_AREA_100</CAN-ENTER-EXCLUSIVE-AREA-REF>
                        <CAN-ENTER-EXCLUSIVE-AREA-REF DEST="EXCLUSIVE-AREA">/AUTOSAR_Eth_43_PFE/BswModuleDescriptions/Eth/InternalBehavior_0/ETH_EXCLUSIVE_AREA_101</CAN-ENTER-EXCLUSIVE-AREA-REF>
                        <CAN-ENTER-EXCLUSIVE-AREA-REF DEST="EXCLUSIVE-AREA">/AUTOSAR_Eth_43_PFE/BswModuleDescriptions/Eth/InternalBehavior_0/ETH_EXCLUSIVE_AREA_102</CAN-ENTER-EXCLUSIVE-AREA-REF>
                        <CAN-ENTER-EXCLUSIVE-AREA-REF DEST="EXCLUSIVE-AREA">/AUTOSAR_Eth_43_PFE/BswModuleDescriptions/Eth/InternalBehavior_0/ETH_EXCLUSIVE_AREA_103</CAN-ENTER-EXCLUSIVE-AREA-REF>
                        <CAN-ENTER-EXCLUSIVE-AREA-REF DEST="EXCLUSIVE-AREA">/AUTOSAR_Eth_43_PFE/BswModuleDescriptions/Eth/InternalBehavior_0/ETH_EXCLUSIVE_AREA_104</CAN-ENTER-EXCLUSIVE-AREA-REF>
                      </CAN-ENTER-EXCLUSIVE-AREA-REFS>
                      <MINIMUM-START-INTERVAL>0.0</MINIMUM-START-INTERVAL>
                      <IMPLEMENTED-ENTRY-REF DEST="BSW-MODULE-ENTRY">/AUTOSAR_Eth_43_PFE/BswModuleEntrys/Eth_HifIrqHdlr_0</IMPLEMENTED-ENTRY-REF>
                      <INTERRUPT-CATEGORY>CAT-2</INTERRUPT-CATEGORY>
                      <INTERRUPT-SOURCE>Hardware</INTERRUPT-SOURCE>
                    </BSW-INTERRUPT-ENTITY>
[!ENDIF!][!//
[!IF "EthGeneral/EthVendorSpecific/EthCommonHif = 'HIF1'"!][!//
                    <BSW-INTERRUPT-ENTITY>
                      <SHORT-NAME>Eth_43_PFE_HifIrqHdlr_1</SHORT-NAME>
                      <CAN-ENTER-EXCLUSIVE-AREA-REFS>
                        <CAN-ENTER-EXCLUSIVE-AREA-REF DEST="EXCLUSIVE-AREA">/AUTOSAR_Eth_43_PFE/BswModuleDescriptions/Eth/InternalBehavior_0/ETH_EXCLUSIVE_AREA_01</CAN-ENTER-EXCLUSIVE-AREA-REF>
                        <CAN-ENTER-EXCLUSIVE-AREA-REF DEST="EXCLUSIVE-AREA">/AUTOSAR_Eth_43_PFE/BswModuleDescriptions/Eth/InternalBehavior_0/ETH_EXCLUSIVE_AREA_03</CAN-ENTER-EXCLUSIVE-AREA-REF>
                        <CAN-ENTER-EXCLUSIVE-AREA-REF DEST="EXCLUSIVE-AREA">/AUTOSAR_Eth_43_PFE/BswModuleDescriptions/Eth/InternalBehavior_0/ETH_EXCLUSIVE_AREA_04</CAN-ENTER-EXCLUSIVE-AREA-REF>
                        <CAN-ENTER-EXCLUSIVE-AREA-REF DEST="EXCLUSIVE-AREA">/AUTOSAR_Eth_43_PFE/BswModuleDescriptions/Eth/InternalBehavior_0/ETH_EXCLUSIVE_AREA_05</CAN-ENTER-EXCLUSIVE-AREA-REF>
                        <CAN-ENTER-EXCLUSIVE-AREA-REF DEST="EXCLUSIVE-AREA">/AUTOSAR_Eth_43_PFE/BswModuleDescriptions/Eth/InternalBehavior_0/ETH_EXCLUSIVE_AREA_07</CAN-ENTER-EXCLUSIVE-AREA-REF>
                        <CAN-ENTER-EXCLUSIVE-AREA-REF DEST="EXCLUSIVE-AREA">/AUTOSAR_Eth_43_PFE/BswModuleDescriptions/Eth/InternalBehavior_0/ETH_EXCLUSIVE_AREA_08</CAN-ENTER-EXCLUSIVE-AREA-REF>
                        <CAN-ENTER-EXCLUSIVE-AREA-REF DEST="EXCLUSIVE-AREA">/AUTOSAR_Eth_43_PFE/BswModuleDescriptions/Eth/InternalBehavior_0/ETH_EXCLUSIVE_AREA_09</CAN-ENTER-EXCLUSIVE-AREA-REF>
                        <CAN-ENTER-EXCLUSIVE-AREA-REF DEST="EXCLUSIVE-AREA">/AUTOSAR_Eth_43_PFE/BswModuleDescriptions/Eth/InternalBehavior_0/ETH_EXCLUSIVE_AREA_10</CAN-ENTER-EXCLUSIVE-AREA-REF>
                        <CAN-ENTER-EXCLUSIVE-AREA-REF DEST="EXCLUSIVE-AREA">/AUTOSAR_Eth_43_PFE/BswModuleDescriptions/Eth/InternalBehavior_0/ETH_EXCLUSIVE_AREA_13</CAN-ENTER-EXCLUSIVE-AREA-REF>
                        <CAN-ENTER-EXCLUSIVE-AREA-REF DEST="EXCLUSIVE-AREA">/AUTOSAR_Eth_43_PFE/BswModuleDescriptions/Eth/InternalBehavior_0/ETH_EXCLUSIVE_AREA_14</CAN-ENTER-EXCLUSIVE-AREA-REF>
                        <CAN-ENTER-EXCLUSIVE-AREA-REF DEST="EXCLUSIVE-AREA">/AUTOSAR_Eth_43_PFE/BswModuleDescriptions/Eth/InternalBehavior_0/ETH_EXCLUSIVE_AREA_15</CAN-ENTER-EXCLUSIVE-AREA-REF>
                        <CAN-ENTER-EXCLUSIVE-AREA-REF DEST="EXCLUSIVE-AREA">/AUTOSAR_Eth_43_PFE/BswModuleDescriptions/Eth/InternalBehavior_0/ETH_EXCLUSIVE_AREA_16</CAN-ENTER-EXCLUSIVE-AREA-REF>
                        <CAN-ENTER-EXCLUSIVE-AREA-REF DEST="EXCLUSIVE-AREA">/AUTOSAR_Eth_43_PFE/BswModuleDescriptions/Eth/InternalBehavior_0/ETH_EXCLUSIVE_AREA_18</CAN-ENTER-EXCLUSIVE-AREA-REF>
                        <CAN-ENTER-EXCLUSIVE-AREA-REF DEST="EXCLUSIVE-AREA">/AUTOSAR_Eth_43_PFE/BswModuleDescriptions/Eth/InternalBehavior_0/ETH_EXCLUSIVE_AREA_20</CAN-ENTER-EXCLUSIVE-AREA-REF>
                        <CAN-ENTER-EXCLUSIVE-AREA-REF DEST="EXCLUSIVE-AREA">/AUTOSAR_Eth_43_PFE/BswModuleDescriptions/Eth/InternalBehavior_0/ETH_EXCLUSIVE_AREA_21</CAN-ENTER-EXCLUSIVE-AREA-REF>
                        <CAN-ENTER-EXCLUSIVE-AREA-REF DEST="EXCLUSIVE-AREA">/AUTOSAR_Eth_43_PFE/BswModuleDescriptions/Eth/InternalBehavior_0/ETH_EXCLUSIVE_AREA_22</CAN-ENTER-EXCLUSIVE-AREA-REF>
                        <CAN-ENTER-EXCLUSIVE-AREA-REF DEST="EXCLUSIVE-AREA">/AUTOSAR_Eth_43_PFE/BswModuleDescriptions/Eth/InternalBehavior_0/ETH_EXCLUSIVE_AREA_23</CAN-ENTER-EXCLUSIVE-AREA-REF>
                        <CAN-ENTER-EXCLUSIVE-AREA-REF DEST="EXCLUSIVE-AREA">/AUTOSAR_Eth_43_PFE/BswModuleDescriptions/Eth/InternalBehavior_0/ETH_EXCLUSIVE_AREA_26</CAN-ENTER-EXCLUSIVE-AREA-REF>
                        <CAN-ENTER-EXCLUSIVE-AREA-REF DEST="EXCLUSIVE-AREA">/AUTOSAR_Eth_43_PFE/BswModuleDescriptions/Eth/InternalBehavior_0/ETH_EXCLUSIVE_AREA_28</CAN-ENTER-EXCLUSIVE-AREA-REF>
                        <CAN-ENTER-EXCLUSIVE-AREA-REF DEST="EXCLUSIVE-AREA">/AUTOSAR_Eth_43_PFE/BswModuleDescriptions/Eth/InternalBehavior_0/ETH_EXCLUSIVE_AREA_30</CAN-ENTER-EXCLUSIVE-AREA-REF>
                        <CAN-ENTER-EXCLUSIVE-AREA-REF DEST="EXCLUSIVE-AREA">/AUTOSAR_Eth_43_PFE/BswModuleDescriptions/Eth/InternalBehavior_0/ETH_EXCLUSIVE_AREA_31</CAN-ENTER-EXCLUSIVE-AREA-REF>
                        <CAN-ENTER-EXCLUSIVE-AREA-REF DEST="EXCLUSIVE-AREA">/AUTOSAR_Eth_43_PFE/BswModuleDescriptions/Eth/InternalBehavior_0/ETH_EXCLUSIVE_AREA_38</CAN-ENTER-EXCLUSIVE-AREA-REF>
                        <CAN-ENTER-EXCLUSIVE-AREA-REF DEST="EXCLUSIVE-AREA">/AUTOSAR_Eth_43_PFE/BswModuleDescriptions/Eth/InternalBehavior_0/ETH_EXCLUSIVE_AREA_39</CAN-ENTER-EXCLUSIVE-AREA-REF>
                        <CAN-ENTER-EXCLUSIVE-AREA-REF DEST="EXCLUSIVE-AREA">/AUTOSAR_Eth_43_PFE/BswModuleDescriptions/Eth/InternalBehavior_0/ETH_EXCLUSIVE_AREA_40</CAN-ENTER-EXCLUSIVE-AREA-REF>
                        <CAN-ENTER-EXCLUSIVE-AREA-REF DEST="EXCLUSIVE-AREA">/AUTOSAR_Eth_43_PFE/BswModuleDescriptions/Eth/InternalBehavior_0/ETH_EXCLUSIVE_AREA_41</CAN-ENTER-EXCLUSIVE-AREA-REF>
                        <CAN-ENTER-EXCLUSIVE-AREA-REF DEST="EXCLUSIVE-AREA">/AUTOSAR_Eth_43_PFE/BswModuleDescriptions/Eth/InternalBehavior_0/ETH_EXCLUSIVE_AREA_42</CAN-ENTER-EXCLUSIVE-AREA-REF>
                        <CAN-ENTER-EXCLUSIVE-AREA-REF DEST="EXCLUSIVE-AREA">/AUTOSAR_Eth_43_PFE/BswModuleDescriptions/Eth/InternalBehavior_0/ETH_EXCLUSIVE_AREA_43</CAN-ENTER-EXCLUSIVE-AREA-REF>
                        <CAN-ENTER-EXCLUSIVE-AREA-REF DEST="EXCLUSIVE-AREA">/AUTOSAR_Eth_43_PFE/BswModuleDescriptions/Eth/InternalBehavior_0/ETH_EXCLUSIVE_AREA_45</CAN-ENTER-EXCLUSIVE-AREA-REF>
                        <CAN-ENTER-EXCLUSIVE-AREA-REF DEST="EXCLUSIVE-AREA">/AUTOSAR_Eth_43_PFE/BswModuleDescriptions/Eth/InternalBehavior_0/ETH_EXCLUSIVE_AREA_46</CAN-ENTER-EXCLUSIVE-AREA-REF>
                        <CAN-ENTER-EXCLUSIVE-AREA-REF DEST="EXCLUSIVE-AREA">/AUTOSAR_Eth_43_PFE/BswModuleDescriptions/Eth/InternalBehavior_0/ETH_EXCLUSIVE_AREA_47</CAN-ENTER-EXCLUSIVE-AREA-REF>
                        <CAN-ENTER-EXCLUSIVE-AREA-REF DEST="EXCLUSIVE-AREA">/AUTOSAR_Eth_43_PFE/BswModuleDescriptions/Eth/InternalBehavior_0/ETH_EXCLUSIVE_AREA_48</CAN-ENTER-EXCLUSIVE-AREA-REF>
                        <CAN-ENTER-EXCLUSIVE-AREA-REF DEST="EXCLUSIVE-AREA">/AUTOSAR_Eth_43_PFE/BswModuleDescriptions/Eth/InternalBehavior_0/ETH_EXCLUSIVE_AREA_50</CAN-ENTER-EXCLUSIVE-AREA-REF>
                        <CAN-ENTER-EXCLUSIVE-AREA-REF DEST="EXCLUSIVE-AREA">/AUTOSAR_Eth_43_PFE/BswModuleDescriptions/Eth/InternalBehavior_0/ETH_EXCLUSIVE_AREA_54</CAN-ENTER-EXCLUSIVE-AREA-REF>
                        <CAN-ENTER-EXCLUSIVE-AREA-REF DEST="EXCLUSIVE-AREA">/AUTOSAR_Eth_43_PFE/BswModuleDescriptions/Eth/InternalBehavior_0/ETH_EXCLUSIVE_AREA_55</CAN-ENTER-EXCLUSIVE-AREA-REF>
                        <CAN-ENTER-EXCLUSIVE-AREA-REF DEST="EXCLUSIVE-AREA">/AUTOSAR_Eth_43_PFE/BswModuleDescriptions/Eth/InternalBehavior_0/ETH_EXCLUSIVE_AREA_56</CAN-ENTER-EXCLUSIVE-AREA-REF>
                        <CAN-ENTER-EXCLUSIVE-AREA-REF DEST="EXCLUSIVE-AREA">/AUTOSAR_Eth_43_PFE/BswModuleDescriptions/Eth/InternalBehavior_0/ETH_EXCLUSIVE_AREA_57</CAN-ENTER-EXCLUSIVE-AREA-REF>
                        <CAN-ENTER-EXCLUSIVE-AREA-REF DEST="EXCLUSIVE-AREA">/AUTOSAR_Eth_43_PFE/BswModuleDescriptions/Eth/InternalBehavior_0/ETH_EXCLUSIVE_AREA_58</CAN-ENTER-EXCLUSIVE-AREA-REF>
                        <CAN-ENTER-EXCLUSIVE-AREA-REF DEST="EXCLUSIVE-AREA">/AUTOSAR_Eth_43_PFE/BswModuleDescriptions/Eth/InternalBehavior_0/ETH_EXCLUSIVE_AREA_59</CAN-ENTER-EXCLUSIVE-AREA-REF>
                        <CAN-ENTER-EXCLUSIVE-AREA-REF DEST="EXCLUSIVE-AREA">/AUTOSAR_Eth_43_PFE/BswModuleDescriptions/Eth/InternalBehavior_0/ETH_EXCLUSIVE_AREA_60</CAN-ENTER-EXCLUSIVE-AREA-REF>
                        <CAN-ENTER-EXCLUSIVE-AREA-REF DEST="EXCLUSIVE-AREA">/AUTOSAR_Eth_43_PFE/BswModuleDescriptions/Eth/InternalBehavior_0/ETH_EXCLUSIVE_AREA_65</CAN-ENTER-EXCLUSIVE-AREA-REF>
                        <CAN-ENTER-EXCLUSIVE-AREA-REF DEST="EXCLUSIVE-AREA">/AUTOSAR_Eth_43_PFE/BswModuleDescriptions/Eth/InternalBehavior_0/ETH_EXCLUSIVE_AREA_66</CAN-ENTER-EXCLUSIVE-AREA-REF>
                        <CAN-ENTER-EXCLUSIVE-AREA-REF DEST="EXCLUSIVE-AREA">/AUTOSAR_Eth_43_PFE/BswModuleDescriptions/Eth/InternalBehavior_0/ETH_EXCLUSIVE_AREA_67</CAN-ENTER-EXCLUSIVE-AREA-REF>
                        <CAN-ENTER-EXCLUSIVE-AREA-REF DEST="EXCLUSIVE-AREA">/AUTOSAR_Eth_43_PFE/BswModuleDescriptions/Eth/InternalBehavior_0/ETH_EXCLUSIVE_AREA_68</CAN-ENTER-EXCLUSIVE-AREA-REF>
                        <CAN-ENTER-EXCLUSIVE-AREA-REF DEST="EXCLUSIVE-AREA">/AUTOSAR_Eth_43_PFE/BswModuleDescriptions/Eth/InternalBehavior_0/ETH_EXCLUSIVE_AREA_69</CAN-ENTER-EXCLUSIVE-AREA-REF>
                        <CAN-ENTER-EXCLUSIVE-AREA-REF DEST="EXCLUSIVE-AREA">/AUTOSAR_Eth_43_PFE/BswModuleDescriptions/Eth/InternalBehavior_0/ETH_EXCLUSIVE_AREA_70</CAN-ENTER-EXCLUSIVE-AREA-REF>
                        <CAN-ENTER-EXCLUSIVE-AREA-REF DEST="EXCLUSIVE-AREA">/AUTOSAR_Eth_43_PFE/BswModuleDescriptions/Eth/InternalBehavior_0/ETH_EXCLUSIVE_AREA_71</CAN-ENTER-EXCLUSIVE-AREA-REF>
                        <CAN-ENTER-EXCLUSIVE-AREA-REF DEST="EXCLUSIVE-AREA">/AUTOSAR_Eth_43_PFE/BswModuleDescriptions/Eth/InternalBehavior_0/ETH_EXCLUSIVE_AREA_72</CAN-ENTER-EXCLUSIVE-AREA-REF>
                        <CAN-ENTER-EXCLUSIVE-AREA-REF DEST="EXCLUSIVE-AREA">/AUTOSAR_Eth_43_PFE/BswModuleDescriptions/Eth/InternalBehavior_0/ETH_EXCLUSIVE_AREA_73</CAN-ENTER-EXCLUSIVE-AREA-REF>
                        <CAN-ENTER-EXCLUSIVE-AREA-REF DEST="EXCLUSIVE-AREA">/AUTOSAR_Eth_43_PFE/BswModuleDescriptions/Eth/InternalBehavior_0/ETH_EXCLUSIVE_AREA_74</CAN-ENTER-EXCLUSIVE-AREA-REF>
                        <CAN-ENTER-EXCLUSIVE-AREA-REF DEST="EXCLUSIVE-AREA">/AUTOSAR_Eth_43_PFE/BswModuleDescriptions/Eth/InternalBehavior_0/ETH_EXCLUSIVE_AREA_77</CAN-ENTER-EXCLUSIVE-AREA-REF>
                        <CAN-ENTER-EXCLUSIVE-AREA-REF DEST="EXCLUSIVE-AREA">/AUTOSAR_Eth_43_PFE/BswModuleDescriptions/Eth/InternalBehavior_0/ETH_EXCLUSIVE_AREA_78</CAN-ENTER-EXCLUSIVE-AREA-REF>
                        <CAN-ENTER-EXCLUSIVE-AREA-REF DEST="EXCLUSIVE-AREA">/AUTOSAR_Eth_43_PFE/BswModuleDescriptions/Eth/InternalBehavior_0/ETH_EXCLUSIVE_AREA_79</CAN-ENTER-EXCLUSIVE-AREA-REF>
                        <CAN-ENTER-EXCLUSIVE-AREA-REF DEST="EXCLUSIVE-AREA">/AUTOSAR_Eth_43_PFE/BswModuleDescriptions/Eth/InternalBehavior_0/ETH_EXCLUSIVE_AREA_81</CAN-ENTER-EXCLUSIVE-AREA-REF>
                        <CAN-ENTER-EXCLUSIVE-AREA-REF DEST="EXCLUSIVE-AREA">/AUTOSAR_Eth_43_PFE/BswModuleDescriptions/Eth/InternalBehavior_0/ETH_EXCLUSIVE_AREA_82</CAN-ENTER-EXCLUSIVE-AREA-REF>
                        <CAN-ENTER-EXCLUSIVE-AREA-REF DEST="EXCLUSIVE-AREA">/AUTOSAR_Eth_43_PFE/BswModuleDescriptions/Eth/InternalBehavior_0/ETH_EXCLUSIVE_AREA_85</CAN-ENTER-EXCLUSIVE-AREA-REF>
                        <CAN-ENTER-EXCLUSIVE-AREA-REF DEST="EXCLUSIVE-AREA">/AUTOSAR_Eth_43_PFE/BswModuleDescriptions/Eth/InternalBehavior_0/ETH_EXCLUSIVE_AREA_86</CAN-ENTER-EXCLUSIVE-AREA-REF>
                        <CAN-ENTER-EXCLUSIVE-AREA-REF DEST="EXCLUSIVE-AREA">/AUTOSAR_Eth_43_PFE/BswModuleDescriptions/Eth/InternalBehavior_0/ETH_EXCLUSIVE_AREA_88</CAN-ENTER-EXCLUSIVE-AREA-REF>
                        <CAN-ENTER-EXCLUSIVE-AREA-REF DEST="EXCLUSIVE-AREA">/AUTOSAR_Eth_43_PFE/BswModuleDescriptions/Eth/InternalBehavior_0/ETH_EXCLUSIVE_AREA_89</CAN-ENTER-EXCLUSIVE-AREA-REF>
                        <CAN-ENTER-EXCLUSIVE-AREA-REF DEST="EXCLUSIVE-AREA">/AUTOSAR_Eth_43_PFE/BswModuleDescriptions/Eth/InternalBehavior_0/ETH_EXCLUSIVE_AREA_90</CAN-ENTER-EXCLUSIVE-AREA-REF>
                        <CAN-ENTER-EXCLUSIVE-AREA-REF DEST="EXCLUSIVE-AREA">/AUTOSAR_Eth_43_PFE/BswModuleDescriptions/Eth/InternalBehavior_0/ETH_EXCLUSIVE_AREA_92</CAN-ENTER-EXCLUSIVE-AREA-REF>
                        <CAN-ENTER-EXCLUSIVE-AREA-REF DEST="EXCLUSIVE-AREA">/AUTOSAR_Eth_43_PFE/BswModuleDescriptions/Eth/InternalBehavior_0/ETH_EXCLUSIVE_AREA_93</CAN-ENTER-EXCLUSIVE-AREA-REF>
                        <CAN-ENTER-EXCLUSIVE-AREA-REF DEST="EXCLUSIVE-AREA">/AUTOSAR_Eth_43_PFE/BswModuleDescriptions/Eth/InternalBehavior_0/ETH_EXCLUSIVE_AREA_94</CAN-ENTER-EXCLUSIVE-AREA-REF>
                        <CAN-ENTER-EXCLUSIVE-AREA-REF DEST="EXCLUSIVE-AREA">/AUTOSAR_Eth_43_PFE/BswModuleDescriptions/Eth/InternalBehavior_0/ETH_EXCLUSIVE_AREA_95</CAN-ENTER-EXCLUSIVE-AREA-REF>
                        <CAN-ENTER-EXCLUSIVE-AREA-REF DEST="EXCLUSIVE-AREA">/AUTOSAR_Eth_43_PFE/BswModuleDescriptions/Eth/InternalBehavior_0/ETH_EXCLUSIVE_AREA_97</CAN-ENTER-EXCLUSIVE-AREA-REF>
                        <CAN-ENTER-EXCLUSIVE-AREA-REF DEST="EXCLUSIVE-AREA">/AUTOSAR_Eth_43_PFE/BswModuleDescriptions/Eth/InternalBehavior_0/ETH_EXCLUSIVE_AREA_99</CAN-ENTER-EXCLUSIVE-AREA-REF>
                        <CAN-ENTER-EXCLUSIVE-AREA-REF DEST="EXCLUSIVE-AREA">/AUTOSAR_Eth_43_PFE/BswModuleDescriptions/Eth/InternalBehavior_0/ETH_EXCLUSIVE_AREA_100</CAN-ENTER-EXCLUSIVE-AREA-REF>
                        <CAN-ENTER-EXCLUSIVE-AREA-REF DEST="EXCLUSIVE-AREA">/AUTOSAR_Eth_43_PFE/BswModuleDescriptions/Eth/InternalBehavior_0/ETH_EXCLUSIVE_AREA_101</CAN-ENTER-EXCLUSIVE-AREA-REF>
                        <CAN-ENTER-EXCLUSIVE-AREA-REF DEST="EXCLUSIVE-AREA">/AUTOSAR_Eth_43_PFE/BswModuleDescriptions/Eth/InternalBehavior_0/ETH_EXCLUSIVE_AREA_102</CAN-ENTER-EXCLUSIVE-AREA-REF>
                        <CAN-ENTER-EXCLUSIVE-AREA-REF DEST="EXCLUSIVE-AREA">/AUTOSAR_Eth_43_PFE/BswModuleDescriptions/Eth/InternalBehavior_0/ETH_EXCLUSIVE_AREA_103</CAN-ENTER-EXCLUSIVE-AREA-REF>
                        <CAN-ENTER-EXCLUSIVE-AREA-REF DEST="EXCLUSIVE-AREA">/AUTOSAR_Eth_43_PFE/BswModuleDescriptions/Eth/InternalBehavior_0/ETH_EXCLUSIVE_AREA_104</CAN-ENTER-EXCLUSIVE-AREA-REF>
                      </CAN-ENTER-EXCLUSIVE-AREA-REFS>
                      <MINIMUM-START-INTERVAL>0.0</MINIMUM-START-INTERVAL>
                      <IMPLEMENTED-ENTRY-REF DEST="BSW-MODULE-ENTRY">/AUTOSAR_Eth_43_PFE/BswModuleEntrys/Eth_HifIrqHdlr_1</IMPLEMENTED-ENTRY-REF>
                      <INTERRUPT-CATEGORY>CAT-2</INTERRUPT-CATEGORY>
                      <INTERRUPT-SOURCE>Hardware</INTERRUPT-SOURCE>
                    </BSW-INTERRUPT-ENTITY>
[!ENDIF!][!//
[!IF "EthGeneral/EthVendorSpecific/EthCommonHif = 'HIF2'"!][!//
                    <BSW-INTERRUPT-ENTITY>
                      <SHORT-NAME>Eth_43_PFE_HifIrqHdlr_2</SHORT-NAME>
                      <CAN-ENTER-EXCLUSIVE-AREA-REFS>
                        <CAN-ENTER-EXCLUSIVE-AREA-REF DEST="EXCLUSIVE-AREA">/AUTOSAR_Eth_43_PFE/BswModuleDescriptions/Eth/InternalBehavior_0/ETH_EXCLUSIVE_AREA_01</CAN-ENTER-EXCLUSIVE-AREA-REF>
                        <CAN-ENTER-EXCLUSIVE-AREA-REF DEST="EXCLUSIVE-AREA">/AUTOSAR_Eth_43_PFE/BswModuleDescriptions/Eth/InternalBehavior_0/ETH_EXCLUSIVE_AREA_03</CAN-ENTER-EXCLUSIVE-AREA-REF>
                        <CAN-ENTER-EXCLUSIVE-AREA-REF DEST="EXCLUSIVE-AREA">/AUTOSAR_Eth_43_PFE/BswModuleDescriptions/Eth/InternalBehavior_0/ETH_EXCLUSIVE_AREA_04</CAN-ENTER-EXCLUSIVE-AREA-REF>
                        <CAN-ENTER-EXCLUSIVE-AREA-REF DEST="EXCLUSIVE-AREA">/AUTOSAR_Eth_43_PFE/BswModuleDescriptions/Eth/InternalBehavior_0/ETH_EXCLUSIVE_AREA_05</CAN-ENTER-EXCLUSIVE-AREA-REF>
                        <CAN-ENTER-EXCLUSIVE-AREA-REF DEST="EXCLUSIVE-AREA">/AUTOSAR_Eth_43_PFE/BswModuleDescriptions/Eth/InternalBehavior_0/ETH_EXCLUSIVE_AREA_07</CAN-ENTER-EXCLUSIVE-AREA-REF>
                        <CAN-ENTER-EXCLUSIVE-AREA-REF DEST="EXCLUSIVE-AREA">/AUTOSAR_Eth_43_PFE/BswModuleDescriptions/Eth/InternalBehavior_0/ETH_EXCLUSIVE_AREA_08</CAN-ENTER-EXCLUSIVE-AREA-REF>
                        <CAN-ENTER-EXCLUSIVE-AREA-REF DEST="EXCLUSIVE-AREA">/AUTOSAR_Eth_43_PFE/BswModuleDescriptions/Eth/InternalBehavior_0/ETH_EXCLUSIVE_AREA_09</CAN-ENTER-EXCLUSIVE-AREA-REF>
                        <CAN-ENTER-EXCLUSIVE-AREA-REF DEST="EXCLUSIVE-AREA">/AUTOSAR_Eth_43_PFE/BswModuleDescriptions/Eth/InternalBehavior_0/ETH_EXCLUSIVE_AREA_10</CAN-ENTER-EXCLUSIVE-AREA-REF>
                        <CAN-ENTER-EXCLUSIVE-AREA-REF DEST="EXCLUSIVE-AREA">/AUTOSAR_Eth_43_PFE/BswModuleDescriptions/Eth/InternalBehavior_0/ETH_EXCLUSIVE_AREA_13</CAN-ENTER-EXCLUSIVE-AREA-REF>
                        <CAN-ENTER-EXCLUSIVE-AREA-REF DEST="EXCLUSIVE-AREA">/AUTOSAR_Eth_43_PFE/BswModuleDescriptions/Eth/InternalBehavior_0/ETH_EXCLUSIVE_AREA_14</CAN-ENTER-EXCLUSIVE-AREA-REF>
                        <CAN-ENTER-EXCLUSIVE-AREA-REF DEST="EXCLUSIVE-AREA">/AUTOSAR_Eth_43_PFE/BswModuleDescriptions/Eth/InternalBehavior_0/ETH_EXCLUSIVE_AREA_15</CAN-ENTER-EXCLUSIVE-AREA-REF>
                        <CAN-ENTER-EXCLUSIVE-AREA-REF DEST="EXCLUSIVE-AREA">/AUTOSAR_Eth_43_PFE/BswModuleDescriptions/Eth/InternalBehavior_0/ETH_EXCLUSIVE_AREA_16</CAN-ENTER-EXCLUSIVE-AREA-REF>
                        <CAN-ENTER-EXCLUSIVE-AREA-REF DEST="EXCLUSIVE-AREA">/AUTOSAR_Eth_43_PFE/BswModuleDescriptions/Eth/InternalBehavior_0/ETH_EXCLUSIVE_AREA_18</CAN-ENTER-EXCLUSIVE-AREA-REF>
                        <CAN-ENTER-EXCLUSIVE-AREA-REF DEST="EXCLUSIVE-AREA">/AUTOSAR_Eth_43_PFE/BswModuleDescriptions/Eth/InternalBehavior_0/ETH_EXCLUSIVE_AREA_20</CAN-ENTER-EXCLUSIVE-AREA-REF>
                        <CAN-ENTER-EXCLUSIVE-AREA-REF DEST="EXCLUSIVE-AREA">/AUTOSAR_Eth_43_PFE/BswModuleDescriptions/Eth/InternalBehavior_0/ETH_EXCLUSIVE_AREA_21</CAN-ENTER-EXCLUSIVE-AREA-REF>
                        <CAN-ENTER-EXCLUSIVE-AREA-REF DEST="EXCLUSIVE-AREA">/AUTOSAR_Eth_43_PFE/BswModuleDescriptions/Eth/InternalBehavior_0/ETH_EXCLUSIVE_AREA_22</CAN-ENTER-EXCLUSIVE-AREA-REF>
                        <CAN-ENTER-EXCLUSIVE-AREA-REF DEST="EXCLUSIVE-AREA">/AUTOSAR_Eth_43_PFE/BswModuleDescriptions/Eth/InternalBehavior_0/ETH_EXCLUSIVE_AREA_23</CAN-ENTER-EXCLUSIVE-AREA-REF>
                        <CAN-ENTER-EXCLUSIVE-AREA-REF DEST="EXCLUSIVE-AREA">/AUTOSAR_Eth_43_PFE/BswModuleDescriptions/Eth/InternalBehavior_0/ETH_EXCLUSIVE_AREA_26</CAN-ENTER-EXCLUSIVE-AREA-REF>
                        <CAN-ENTER-EXCLUSIVE-AREA-REF DEST="EXCLUSIVE-AREA">/AUTOSAR_Eth_43_PFE/BswModuleDescriptions/Eth/InternalBehavior_0/ETH_EXCLUSIVE_AREA_28</CAN-ENTER-EXCLUSIVE-AREA-REF>
                        <CAN-ENTER-EXCLUSIVE-AREA-REF DEST="EXCLUSIVE-AREA">/AUTOSAR_Eth_43_PFE/BswModuleDescriptions/Eth/InternalBehavior_0/ETH_EXCLUSIVE_AREA_30</CAN-ENTER-EXCLUSIVE-AREA-REF>
                        <CAN-ENTER-EXCLUSIVE-AREA-REF DEST="EXCLUSIVE-AREA">/AUTOSAR_Eth_43_PFE/BswModuleDescriptions/Eth/InternalBehavior_0/ETH_EXCLUSIVE_AREA_31</CAN-ENTER-EXCLUSIVE-AREA-REF>
                        <CAN-ENTER-EXCLUSIVE-AREA-REF DEST="EXCLUSIVE-AREA">/AUTOSAR_Eth_43_PFE/BswModuleDescriptions/Eth/InternalBehavior_0/ETH_EXCLUSIVE_AREA_38</CAN-ENTER-EXCLUSIVE-AREA-REF>
                        <CAN-ENTER-EXCLUSIVE-AREA-REF DEST="EXCLUSIVE-AREA">/AUTOSAR_Eth_43_PFE/BswModuleDescriptions/Eth/InternalBehavior_0/ETH_EXCLUSIVE_AREA_39</CAN-ENTER-EXCLUSIVE-AREA-REF>
                        <CAN-ENTER-EXCLUSIVE-AREA-REF DEST="EXCLUSIVE-AREA">/AUTOSAR_Eth_43_PFE/BswModuleDescriptions/Eth/InternalBehavior_0/ETH_EXCLUSIVE_AREA_40</CAN-ENTER-EXCLUSIVE-AREA-REF>
                        <CAN-ENTER-EXCLUSIVE-AREA-REF DEST="EXCLUSIVE-AREA">/AUTOSAR_Eth_43_PFE/BswModuleDescriptions/Eth/InternalBehavior_0/ETH_EXCLUSIVE_AREA_41</CAN-ENTER-EXCLUSIVE-AREA-REF>
                        <CAN-ENTER-EXCLUSIVE-AREA-REF DEST="EXCLUSIVE-AREA">/AUTOSAR_Eth_43_PFE/BswModuleDescriptions/Eth/InternalBehavior_0/ETH_EXCLUSIVE_AREA_42</CAN-ENTER-EXCLUSIVE-AREA-REF>
                        <CAN-ENTER-EXCLUSIVE-AREA-REF DEST="EXCLUSIVE-AREA">/AUTOSAR_Eth_43_PFE/BswModuleDescriptions/Eth/InternalBehavior_0/ETH_EXCLUSIVE_AREA_43</CAN-ENTER-EXCLUSIVE-AREA-REF>
                        <CAN-ENTER-EXCLUSIVE-AREA-REF DEST="EXCLUSIVE-AREA">/AUTOSAR_Eth_43_PFE/BswModuleDescriptions/Eth/InternalBehavior_0/ETH_EXCLUSIVE_AREA_45</CAN-ENTER-EXCLUSIVE-AREA-REF>
                        <CAN-ENTER-EXCLUSIVE-AREA-REF DEST="EXCLUSIVE-AREA">/AUTOSAR_Eth_43_PFE/BswModuleDescriptions/Eth/InternalBehavior_0/ETH_EXCLUSIVE_AREA_46</CAN-ENTER-EXCLUSIVE-AREA-REF>
                        <CAN-ENTER-EXCLUSIVE-AREA-REF DEST="EXCLUSIVE-AREA">/AUTOSAR_Eth_43_PFE/BswModuleDescriptions/Eth/InternalBehavior_0/ETH_EXCLUSIVE_AREA_47</CAN-ENTER-EXCLUSIVE-AREA-REF>
                        <CAN-ENTER-EXCLUSIVE-AREA-REF DEST="EXCLUSIVE-AREA">/AUTOSAR_Eth_43_PFE/BswModuleDescriptions/Eth/InternalBehavior_0/ETH_EXCLUSIVE_AREA_48</CAN-ENTER-EXCLUSIVE-AREA-REF>
                        <CAN-ENTER-EXCLUSIVE-AREA-REF DEST="EXCLUSIVE-AREA">/AUTOSAR_Eth_43_PFE/BswModuleDescriptions/Eth/InternalBehavior_0/ETH_EXCLUSIVE_AREA_50</CAN-ENTER-EXCLUSIVE-AREA-REF>
                        <CAN-ENTER-EXCLUSIVE-AREA-REF DEST="EXCLUSIVE-AREA">/AUTOSAR_Eth_43_PFE/BswModuleDescriptions/Eth/InternalBehavior_0/ETH_EXCLUSIVE_AREA_54</CAN-ENTER-EXCLUSIVE-AREA-REF>
                        <CAN-ENTER-EXCLUSIVE-AREA-REF DEST="EXCLUSIVE-AREA">/AUTOSAR_Eth_43_PFE/BswModuleDescriptions/Eth/InternalBehavior_0/ETH_EXCLUSIVE_AREA_55</CAN-ENTER-EXCLUSIVE-AREA-REF>
                        <CAN-ENTER-EXCLUSIVE-AREA-REF DEST="EXCLUSIVE-AREA">/AUTOSAR_Eth_43_PFE/BswModuleDescriptions/Eth/InternalBehavior_0/ETH_EXCLUSIVE_AREA_56</CAN-ENTER-EXCLUSIVE-AREA-REF>
                        <CAN-ENTER-EXCLUSIVE-AREA-REF DEST="EXCLUSIVE-AREA">/AUTOSAR_Eth_43_PFE/BswModuleDescriptions/Eth/InternalBehavior_0/ETH_EXCLUSIVE_AREA_57</CAN-ENTER-EXCLUSIVE-AREA-REF>
                        <CAN-ENTER-EXCLUSIVE-AREA-REF DEST="EXCLUSIVE-AREA">/AUTOSAR_Eth_43_PFE/BswModuleDescriptions/Eth/InternalBehavior_0/ETH_EXCLUSIVE_AREA_58</CAN-ENTER-EXCLUSIVE-AREA-REF>
                        <CAN-ENTER-EXCLUSIVE-AREA-REF DEST="EXCLUSIVE-AREA">/AUTOSAR_Eth_43_PFE/BswModuleDescriptions/Eth/InternalBehavior_0/ETH_EXCLUSIVE_AREA_59</CAN-ENTER-EXCLUSIVE-AREA-REF>
                        <CAN-ENTER-EXCLUSIVE-AREA-REF DEST="EXCLUSIVE-AREA">/AUTOSAR_Eth_43_PFE/BswModuleDescriptions/Eth/InternalBehavior_0/ETH_EXCLUSIVE_AREA_60</CAN-ENTER-EXCLUSIVE-AREA-REF>
                        <CAN-ENTER-EXCLUSIVE-AREA-REF DEST="EXCLUSIVE-AREA">/AUTOSAR_Eth_43_PFE/BswModuleDescriptions/Eth/InternalBehavior_0/ETH_EXCLUSIVE_AREA_65</CAN-ENTER-EXCLUSIVE-AREA-REF>
                        <CAN-ENTER-EXCLUSIVE-AREA-REF DEST="EXCLUSIVE-AREA">/AUTOSAR_Eth_43_PFE/BswModuleDescriptions/Eth/InternalBehavior_0/ETH_EXCLUSIVE_AREA_66</CAN-ENTER-EXCLUSIVE-AREA-REF>
                        <CAN-ENTER-EXCLUSIVE-AREA-REF DEST="EXCLUSIVE-AREA">/AUTOSAR_Eth_43_PFE/BswModuleDescriptions/Eth/InternalBehavior_0/ETH_EXCLUSIVE_AREA_67</CAN-ENTER-EXCLUSIVE-AREA-REF>
                        <CAN-ENTER-EXCLUSIVE-AREA-REF DEST="EXCLUSIVE-AREA">/AUTOSAR_Eth_43_PFE/BswModuleDescriptions/Eth/InternalBehavior_0/ETH_EXCLUSIVE_AREA_68</CAN-ENTER-EXCLUSIVE-AREA-REF>
                        <CAN-ENTER-EXCLUSIVE-AREA-REF DEST="EXCLUSIVE-AREA">/AUTOSAR_Eth_43_PFE/BswModuleDescriptions/Eth/InternalBehavior_0/ETH_EXCLUSIVE_AREA_69</CAN-ENTER-EXCLUSIVE-AREA-REF>
                        <CAN-ENTER-EXCLUSIVE-AREA-REF DEST="EXCLUSIVE-AREA">/AUTOSAR_Eth_43_PFE/BswModuleDescriptions/Eth/InternalBehavior_0/ETH_EXCLUSIVE_AREA_70</CAN-ENTER-EXCLUSIVE-AREA-REF>
                        <CAN-ENTER-EXCLUSIVE-AREA-REF DEST="EXCLUSIVE-AREA">/AUTOSAR_Eth_43_PFE/BswModuleDescriptions/Eth/InternalBehavior_0/ETH_EXCLUSIVE_AREA_71</CAN-ENTER-EXCLUSIVE-AREA-REF>
                        <CAN-ENTER-EXCLUSIVE-AREA-REF DEST="EXCLUSIVE-AREA">/AUTOSAR_Eth_43_PFE/BswModuleDescriptions/Eth/InternalBehavior_0/ETH_EXCLUSIVE_AREA_72</CAN-ENTER-EXCLUSIVE-AREA-REF>
                        <CAN-ENTER-EXCLUSIVE-AREA-REF DEST="EXCLUSIVE-AREA">/AUTOSAR_Eth_43_PFE/BswModuleDescriptions/Eth/InternalBehavior_0/ETH_EXCLUSIVE_AREA_73</CAN-ENTER-EXCLUSIVE-AREA-REF>
                        <CAN-ENTER-EXCLUSIVE-AREA-REF DEST="EXCLUSIVE-AREA">/AUTOSAR_Eth_43_PFE/BswModuleDescriptions/Eth/InternalBehavior_0/ETH_EXCLUSIVE_AREA_74</CAN-ENTER-EXCLUSIVE-AREA-REF>
                        <CAN-ENTER-EXCLUSIVE-AREA-REF DEST="EXCLUSIVE-AREA">/AUTOSAR_Eth_43_PFE/BswModuleDescriptions/Eth/InternalBehavior_0/ETH_EXCLUSIVE_AREA_77</CAN-ENTER-EXCLUSIVE-AREA-REF>
                        <CAN-ENTER-EXCLUSIVE-AREA-REF DEST="EXCLUSIVE-AREA">/AUTOSAR_Eth_43_PFE/BswModuleDescriptions/Eth/InternalBehavior_0/ETH_EXCLUSIVE_AREA_78</CAN-ENTER-EXCLUSIVE-AREA-REF>
                        <CAN-ENTER-EXCLUSIVE-AREA-REF DEST="EXCLUSIVE-AREA">/AUTOSAR_Eth_43_PFE/BswModuleDescriptions/Eth/InternalBehavior_0/ETH_EXCLUSIVE_AREA_79</CAN-ENTER-EXCLUSIVE-AREA-REF>
                        <CAN-ENTER-EXCLUSIVE-AREA-REF DEST="EXCLUSIVE-AREA">/AUTOSAR_Eth_43_PFE/BswModuleDescriptions/Eth/InternalBehavior_0/ETH_EXCLUSIVE_AREA_81</CAN-ENTER-EXCLUSIVE-AREA-REF>
                        <CAN-ENTER-EXCLUSIVE-AREA-REF DEST="EXCLUSIVE-AREA">/AUTOSAR_Eth_43_PFE/BswModuleDescriptions/Eth/InternalBehavior_0/ETH_EXCLUSIVE_AREA_82</CAN-ENTER-EXCLUSIVE-AREA-REF>
                        <CAN-ENTER-EXCLUSIVE-AREA-REF DEST="EXCLUSIVE-AREA">/AUTOSAR_Eth_43_PFE/BswModuleDescriptions/Eth/InternalBehavior_0/ETH_EXCLUSIVE_AREA_85</CAN-ENTER-EXCLUSIVE-AREA-REF>
                        <CAN-ENTER-EXCLUSIVE-AREA-REF DEST="EXCLUSIVE-AREA">/AUTOSAR_Eth_43_PFE/BswModuleDescriptions/Eth/InternalBehavior_0/ETH_EXCLUSIVE_AREA_86</CAN-ENTER-EXCLUSIVE-AREA-REF>
                        <CAN-ENTER-EXCLUSIVE-AREA-REF DEST="EXCLUSIVE-AREA">/AUTOSAR_Eth_43_PFE/BswModuleDescriptions/Eth/InternalBehavior_0/ETH_EXCLUSIVE_AREA_88</CAN-ENTER-EXCLUSIVE-AREA-REF>
                        <CAN-ENTER-EXCLUSIVE-AREA-REF DEST="EXCLUSIVE-AREA">/AUTOSAR_Eth_43_PFE/BswModuleDescriptions/Eth/InternalBehavior_0/ETH_EXCLUSIVE_AREA_89</CAN-ENTER-EXCLUSIVE-AREA-REF>
                        <CAN-ENTER-EXCLUSIVE-AREA-REF DEST="EXCLUSIVE-AREA">/AUTOSAR_Eth_43_PFE/BswModuleDescriptions/Eth/InternalBehavior_0/ETH_EXCLUSIVE_AREA_90</CAN-ENTER-EXCLUSIVE-AREA-REF>
                        <CAN-ENTER-EXCLUSIVE-AREA-REF DEST="EXCLUSIVE-AREA">/AUTOSAR_Eth_43_PFE/BswModuleDescriptions/Eth/InternalBehavior_0/ETH_EXCLUSIVE_AREA_92</CAN-ENTER-EXCLUSIVE-AREA-REF>
                        <CAN-ENTER-EXCLUSIVE-AREA-REF DEST="EXCLUSIVE-AREA">/AUTOSAR_Eth_43_PFE/BswModuleDescriptions/Eth/InternalBehavior_0/ETH_EXCLUSIVE_AREA_93</CAN-ENTER-EXCLUSIVE-AREA-REF>
                        <CAN-ENTER-EXCLUSIVE-AREA-REF DEST="EXCLUSIVE-AREA">/AUTOSAR_Eth_43_PFE/BswModuleDescriptions/Eth/InternalBehavior_0/ETH_EXCLUSIVE_AREA_94</CAN-ENTER-EXCLUSIVE-AREA-REF>
                        <CAN-ENTER-EXCLUSIVE-AREA-REF DEST="EXCLUSIVE-AREA">/AUTOSAR_Eth_43_PFE/BswModuleDescriptions/Eth/InternalBehavior_0/ETH_EXCLUSIVE_AREA_95</CAN-ENTER-EXCLUSIVE-AREA-REF>
                        <CAN-ENTER-EXCLUSIVE-AREA-REF DEST="EXCLUSIVE-AREA">/AUTOSAR_Eth_43_PFE/BswModuleDescriptions/Eth/InternalBehavior_0/ETH_EXCLUSIVE_AREA_97</CAN-ENTER-EXCLUSIVE-AREA-REF>
                        <CAN-ENTER-EXCLUSIVE-AREA-REF DEST="EXCLUSIVE-AREA">/AUTOSAR_Eth_43_PFE/BswModuleDescriptions/Eth/InternalBehavior_0/ETH_EXCLUSIVE_AREA_99</CAN-ENTER-EXCLUSIVE-AREA-REF>
                        <CAN-ENTER-EXCLUSIVE-AREA-REF DEST="EXCLUSIVE-AREA">/AUTOSAR_Eth_43_PFE/BswModuleDescriptions/Eth/InternalBehavior_0/ETH_EXCLUSIVE_AREA_100</CAN-ENTER-EXCLUSIVE-AREA-REF>
                        <CAN-ENTER-EXCLUSIVE-AREA-REF DEST="EXCLUSIVE-AREA">/AUTOSAR_Eth_43_PFE/BswModuleDescriptions/Eth/InternalBehavior_0/ETH_EXCLUSIVE_AREA_101</CAN-ENTER-EXCLUSIVE-AREA-REF>
                        <CAN-ENTER-EXCLUSIVE-AREA-REF DEST="EXCLUSIVE-AREA">/AUTOSAR_Eth_43_PFE/BswModuleDescriptions/Eth/InternalBehavior_0/ETH_EXCLUSIVE_AREA_102</CAN-ENTER-EXCLUSIVE-AREA-REF>
                        <CAN-ENTER-EXCLUSIVE-AREA-REF DEST="EXCLUSIVE-AREA">/AUTOSAR_Eth_43_PFE/BswModuleDescriptions/Eth/InternalBehavior_0/ETH_EXCLUSIVE_AREA_103</CAN-ENTER-EXCLUSIVE-AREA-REF>
                        <CAN-ENTER-EXCLUSIVE-AREA-REF DEST="EXCLUSIVE-AREA">/AUTOSAR_Eth_43_PFE/BswModuleDescriptions/Eth/InternalBehavior_0/ETH_EXCLUSIVE_AREA_104</CAN-ENTER-EXCLUSIVE-AREA-REF>
                      </CAN-ENTER-EXCLUSIVE-AREA-REFS>
                      <MINIMUM-START-INTERVAL>0.0</MINIMUM-START-INTERVAL>
                      <IMPLEMENTED-ENTRY-REF DEST="BSW-MODULE-ENTRY">/AUTOSAR_Eth_43_PFE/BswModuleEntrys/Eth_HifIrqHdlr_2</IMPLEMENTED-ENTRY-REF>
                      <INTERRUPT-CATEGORY>CAT-2</INTERRUPT-CATEGORY>
                      <INTERRUPT-SOURCE>Hardware</INTERRUPT-SOURCE>
                    </BSW-INTERRUPT-ENTITY>
[!ENDIF!][!//
[!IF "EthGeneral/EthVendorSpecific/EthCommonHif = 'HIF3'"!][!//
                    <BSW-INTERRUPT-ENTITY>
                      <SHORT-NAME>Eth_43_PFE_HifIrqHdlr_3</SHORT-NAME>
                      <CAN-ENTER-EXCLUSIVE-AREA-REFS>
                        <CAN-ENTER-EXCLUSIVE-AREA-REF DEST="EXCLUSIVE-AREA">/AUTOSAR_Eth_43_PFE/BswModuleDescriptions/Eth/InternalBehavior_0/ETH_EXCLUSIVE_AREA_01</CAN-ENTER-EXCLUSIVE-AREA-REF>
                        <CAN-ENTER-EXCLUSIVE-AREA-REF DEST="EXCLUSIVE-AREA">/AUTOSAR_Eth_43_PFE/BswModuleDescriptions/Eth/InternalBehavior_0/ETH_EXCLUSIVE_AREA_03</CAN-ENTER-EXCLUSIVE-AREA-REF>
                        <CAN-ENTER-EXCLUSIVE-AREA-REF DEST="EXCLUSIVE-AREA">/AUTOSAR_Eth_43_PFE/BswModuleDescriptions/Eth/InternalBehavior_0/ETH_EXCLUSIVE_AREA_04</CAN-ENTER-EXCLUSIVE-AREA-REF>
                        <CAN-ENTER-EXCLUSIVE-AREA-REF DEST="EXCLUSIVE-AREA">/AUTOSAR_Eth_43_PFE/BswModuleDescriptions/Eth/InternalBehavior_0/ETH_EXCLUSIVE_AREA_05</CAN-ENTER-EXCLUSIVE-AREA-REF>
                        <CAN-ENTER-EXCLUSIVE-AREA-REF DEST="EXCLUSIVE-AREA">/AUTOSAR_Eth_43_PFE/BswModuleDescriptions/Eth/InternalBehavior_0/ETH_EXCLUSIVE_AREA_07</CAN-ENTER-EXCLUSIVE-AREA-REF>
                        <CAN-ENTER-EXCLUSIVE-AREA-REF DEST="EXCLUSIVE-AREA">/AUTOSAR_Eth_43_PFE/BswModuleDescriptions/Eth/InternalBehavior_0/ETH_EXCLUSIVE_AREA_08</CAN-ENTER-EXCLUSIVE-AREA-REF>
                        <CAN-ENTER-EXCLUSIVE-AREA-REF DEST="EXCLUSIVE-AREA">/AUTOSAR_Eth_43_PFE/BswModuleDescriptions/Eth/InternalBehavior_0/ETH_EXCLUSIVE_AREA_09</CAN-ENTER-EXCLUSIVE-AREA-REF>
                        <CAN-ENTER-EXCLUSIVE-AREA-REF DEST="EXCLUSIVE-AREA">/AUTOSAR_Eth_43_PFE/BswModuleDescriptions/Eth/InternalBehavior_0/ETH_EXCLUSIVE_AREA_10</CAN-ENTER-EXCLUSIVE-AREA-REF>
                        <CAN-ENTER-EXCLUSIVE-AREA-REF DEST="EXCLUSIVE-AREA">/AUTOSAR_Eth_43_PFE/BswModuleDescriptions/Eth/InternalBehavior_0/ETH_EXCLUSIVE_AREA_13</CAN-ENTER-EXCLUSIVE-AREA-REF>
                        <CAN-ENTER-EXCLUSIVE-AREA-REF DEST="EXCLUSIVE-AREA">/AUTOSAR_Eth_43_PFE/BswModuleDescriptions/Eth/InternalBehavior_0/ETH_EXCLUSIVE_AREA_14</CAN-ENTER-EXCLUSIVE-AREA-REF>
                        <CAN-ENTER-EXCLUSIVE-AREA-REF DEST="EXCLUSIVE-AREA">/AUTOSAR_Eth_43_PFE/BswModuleDescriptions/Eth/InternalBehavior_0/ETH_EXCLUSIVE_AREA_15</CAN-ENTER-EXCLUSIVE-AREA-REF>
                        <CAN-ENTER-EXCLUSIVE-AREA-REF DEST="EXCLUSIVE-AREA">/AUTOSAR_Eth_43_PFE/BswModuleDescriptions/Eth/InternalBehavior_0/ETH_EXCLUSIVE_AREA_16</CAN-ENTER-EXCLUSIVE-AREA-REF>
                        <CAN-ENTER-EXCLUSIVE-AREA-REF DEST="EXCLUSIVE-AREA">/AUTOSAR_Eth_43_PFE/BswModuleDescriptions/Eth/InternalBehavior_0/ETH_EXCLUSIVE_AREA_18</CAN-ENTER-EXCLUSIVE-AREA-REF>
                        <CAN-ENTER-EXCLUSIVE-AREA-REF DEST="EXCLUSIVE-AREA">/AUTOSAR_Eth_43_PFE/BswModuleDescriptions/Eth/InternalBehavior_0/ETH_EXCLUSIVE_AREA_20</CAN-ENTER-EXCLUSIVE-AREA-REF>
                        <CAN-ENTER-EXCLUSIVE-AREA-REF DEST="EXCLUSIVE-AREA">/AUTOSAR_Eth_43_PFE/BswModuleDescriptions/Eth/InternalBehavior_0/ETH_EXCLUSIVE_AREA_21</CAN-ENTER-EXCLUSIVE-AREA-REF>
                        <CAN-ENTER-EXCLUSIVE-AREA-REF DEST="EXCLUSIVE-AREA">/AUTOSAR_Eth_43_PFE/BswModuleDescriptions/Eth/InternalBehavior_0/ETH_EXCLUSIVE_AREA_22</CAN-ENTER-EXCLUSIVE-AREA-REF>
                        <CAN-ENTER-EXCLUSIVE-AREA-REF DEST="EXCLUSIVE-AREA">/AUTOSAR_Eth_43_PFE/BswModuleDescriptions/Eth/InternalBehavior_0/ETH_EXCLUSIVE_AREA_23</CAN-ENTER-EXCLUSIVE-AREA-REF>
                        <CAN-ENTER-EXCLUSIVE-AREA-REF DEST="EXCLUSIVE-AREA">/AUTOSAR_Eth_43_PFE/BswModuleDescriptions/Eth/InternalBehavior_0/ETH_EXCLUSIVE_AREA_26</CAN-ENTER-EXCLUSIVE-AREA-REF>
                        <CAN-ENTER-EXCLUSIVE-AREA-REF DEST="EXCLUSIVE-AREA">/AUTOSAR_Eth_43_PFE/BswModuleDescriptions/Eth/InternalBehavior_0/ETH_EXCLUSIVE_AREA_28</CAN-ENTER-EXCLUSIVE-AREA-REF>
                        <CAN-ENTER-EXCLUSIVE-AREA-REF DEST="EXCLUSIVE-AREA">/AUTOSAR_Eth_43_PFE/BswModuleDescriptions/Eth/InternalBehavior_0/ETH_EXCLUSIVE_AREA_30</CAN-ENTER-EXCLUSIVE-AREA-REF>
                        <CAN-ENTER-EXCLUSIVE-AREA-REF DEST="EXCLUSIVE-AREA">/AUTOSAR_Eth_43_PFE/BswModuleDescriptions/Eth/InternalBehavior_0/ETH_EXCLUSIVE_AREA_31</CAN-ENTER-EXCLUSIVE-AREA-REF>
                        <CAN-ENTER-EXCLUSIVE-AREA-REF DEST="EXCLUSIVE-AREA">/AUTOSAR_Eth_43_PFE/BswModuleDescriptions/Eth/InternalBehavior_0/ETH_EXCLUSIVE_AREA_38</CAN-ENTER-EXCLUSIVE-AREA-REF>
                        <CAN-ENTER-EXCLUSIVE-AREA-REF DEST="EXCLUSIVE-AREA">/AUTOSAR_Eth_43_PFE/BswModuleDescriptions/Eth/InternalBehavior_0/ETH_EXCLUSIVE_AREA_39</CAN-ENTER-EXCLUSIVE-AREA-REF>
                        <CAN-ENTER-EXCLUSIVE-AREA-REF DEST="EXCLUSIVE-AREA">/AUTOSAR_Eth_43_PFE/BswModuleDescriptions/Eth/InternalBehavior_0/ETH_EXCLUSIVE_AREA_40</CAN-ENTER-EXCLUSIVE-AREA-REF>
                        <CAN-ENTER-EXCLUSIVE-AREA-REF DEST="EXCLUSIVE-AREA">/AUTOSAR_Eth_43_PFE/BswModuleDescriptions/Eth/InternalBehavior_0/ETH_EXCLUSIVE_AREA_41</CAN-ENTER-EXCLUSIVE-AREA-REF>
                        <CAN-ENTER-EXCLUSIVE-AREA-REF DEST="EXCLUSIVE-AREA">/AUTOSAR_Eth_43_PFE/BswModuleDescriptions/Eth/InternalBehavior_0/ETH_EXCLUSIVE_AREA_42</CAN-ENTER-EXCLUSIVE-AREA-REF>
                        <CAN-ENTER-EXCLUSIVE-AREA-REF DEST="EXCLUSIVE-AREA">/AUTOSAR_Eth_43_PFE/BswModuleDescriptions/Eth/InternalBehavior_0/ETH_EXCLUSIVE_AREA_43</CAN-ENTER-EXCLUSIVE-AREA-REF>
                        <CAN-ENTER-EXCLUSIVE-AREA-REF DEST="EXCLUSIVE-AREA">/AUTOSAR_Eth_43_PFE/BswModuleDescriptions/Eth/InternalBehavior_0/ETH_EXCLUSIVE_AREA_45</CAN-ENTER-EXCLUSIVE-AREA-REF>
                        <CAN-ENTER-EXCLUSIVE-AREA-REF DEST="EXCLUSIVE-AREA">/AUTOSAR_Eth_43_PFE/BswModuleDescriptions/Eth/InternalBehavior_0/ETH_EXCLUSIVE_AREA_46</CAN-ENTER-EXCLUSIVE-AREA-REF>
                        <CAN-ENTER-EXCLUSIVE-AREA-REF DEST="EXCLUSIVE-AREA">/AUTOSAR_Eth_43_PFE/BswModuleDescriptions/Eth/InternalBehavior_0/ETH_EXCLUSIVE_AREA_47</CAN-ENTER-EXCLUSIVE-AREA-REF>
                        <CAN-ENTER-EXCLUSIVE-AREA-REF DEST="EXCLUSIVE-AREA">/AUTOSAR_Eth_43_PFE/BswModuleDescriptions/Eth/InternalBehavior_0/ETH_EXCLUSIVE_AREA_48</CAN-ENTER-EXCLUSIVE-AREA-REF>
                        <CAN-ENTER-EXCLUSIVE-AREA-REF DEST="EXCLUSIVE-AREA">/AUTOSAR_Eth_43_PFE/BswModuleDescriptions/Eth/InternalBehavior_0/ETH_EXCLUSIVE_AREA_50</CAN-ENTER-EXCLUSIVE-AREA-REF>
                        <CAN-ENTER-EXCLUSIVE-AREA-REF DEST="EXCLUSIVE-AREA">/AUTOSAR_Eth_43_PFE/BswModuleDescriptions/Eth/InternalBehavior_0/ETH_EXCLUSIVE_AREA_54</CAN-ENTER-EXCLUSIVE-AREA-REF>
                        <CAN-ENTER-EXCLUSIVE-AREA-REF DEST="EXCLUSIVE-AREA">/AUTOSAR_Eth_43_PFE/BswModuleDescriptions/Eth/InternalBehavior_0/ETH_EXCLUSIVE_AREA_55</CAN-ENTER-EXCLUSIVE-AREA-REF>
                        <CAN-ENTER-EXCLUSIVE-AREA-REF DEST="EXCLUSIVE-AREA">/AUTOSAR_Eth_43_PFE/BswModuleDescriptions/Eth/InternalBehavior_0/ETH_EXCLUSIVE_AREA_56</CAN-ENTER-EXCLUSIVE-AREA-REF>
                        <CAN-ENTER-EXCLUSIVE-AREA-REF DEST="EXCLUSIVE-AREA">/AUTOSAR_Eth_43_PFE/BswModuleDescriptions/Eth/InternalBehavior_0/ETH_EXCLUSIVE_AREA_57</CAN-ENTER-EXCLUSIVE-AREA-REF>
                        <CAN-ENTER-EXCLUSIVE-AREA-REF DEST="EXCLUSIVE-AREA">/AUTOSAR_Eth_43_PFE/BswModuleDescriptions/Eth/InternalBehavior_0/ETH_EXCLUSIVE_AREA_58</CAN-ENTER-EXCLUSIVE-AREA-REF>
                        <CAN-ENTER-EXCLUSIVE-AREA-REF DEST="EXCLUSIVE-AREA">/AUTOSAR_Eth_43_PFE/BswModuleDescriptions/Eth/InternalBehavior_0/ETH_EXCLUSIVE_AREA_59</CAN-ENTER-EXCLUSIVE-AREA-REF>
                        <CAN-ENTER-EXCLUSIVE-AREA-REF DEST="EXCLUSIVE-AREA">/AUTOSAR_Eth_43_PFE/BswModuleDescriptions/Eth/InternalBehavior_0/ETH_EXCLUSIVE_AREA_60</CAN-ENTER-EXCLUSIVE-AREA-REF>
                        <CAN-ENTER-EXCLUSIVE-AREA-REF DEST="EXCLUSIVE-AREA">/AUTOSAR_Eth_43_PFE/BswModuleDescriptions/Eth/InternalBehavior_0/ETH_EXCLUSIVE_AREA_65</CAN-ENTER-EXCLUSIVE-AREA-REF>
                        <CAN-ENTER-EXCLUSIVE-AREA-REF DEST="EXCLUSIVE-AREA">/AUTOSAR_Eth_43_PFE/BswModuleDescriptions/Eth/InternalBehavior_0/ETH_EXCLUSIVE_AREA_66</CAN-ENTER-EXCLUSIVE-AREA-REF>
                        <CAN-ENTER-EXCLUSIVE-AREA-REF DEST="EXCLUSIVE-AREA">/AUTOSAR_Eth_43_PFE/BswModuleDescriptions/Eth/InternalBehavior_0/ETH_EXCLUSIVE_AREA_67</CAN-ENTER-EXCLUSIVE-AREA-REF>
                        <CAN-ENTER-EXCLUSIVE-AREA-REF DEST="EXCLUSIVE-AREA">/AUTOSAR_Eth_43_PFE/BswModuleDescriptions/Eth/InternalBehavior_0/ETH_EXCLUSIVE_AREA_68</CAN-ENTER-EXCLUSIVE-AREA-REF>
                        <CAN-ENTER-EXCLUSIVE-AREA-REF DEST="EXCLUSIVE-AREA">/AUTOSAR_Eth_43_PFE/BswModuleDescriptions/Eth/InternalBehavior_0/ETH_EXCLUSIVE_AREA_69</CAN-ENTER-EXCLUSIVE-AREA-REF>
                        <CAN-ENTER-EXCLUSIVE-AREA-REF DEST="EXCLUSIVE-AREA">/AUTOSAR_Eth_43_PFE/BswModuleDescriptions/Eth/InternalBehavior_0/ETH_EXCLUSIVE_AREA_70</CAN-ENTER-EXCLUSIVE-AREA-REF>
                        <CAN-ENTER-EXCLUSIVE-AREA-REF DEST="EXCLUSIVE-AREA">/AUTOSAR_Eth_43_PFE/BswModuleDescriptions/Eth/InternalBehavior_0/ETH_EXCLUSIVE_AREA_71</CAN-ENTER-EXCLUSIVE-AREA-REF>
                        <CAN-ENTER-EXCLUSIVE-AREA-REF DEST="EXCLUSIVE-AREA">/AUTOSAR_Eth_43_PFE/BswModuleDescriptions/Eth/InternalBehavior_0/ETH_EXCLUSIVE_AREA_72</CAN-ENTER-EXCLUSIVE-AREA-REF>
                        <CAN-ENTER-EXCLUSIVE-AREA-REF DEST="EXCLUSIVE-AREA">/AUTOSAR_Eth_43_PFE/BswModuleDescriptions/Eth/InternalBehavior_0/ETH_EXCLUSIVE_AREA_73</CAN-ENTER-EXCLUSIVE-AREA-REF>
                        <CAN-ENTER-EXCLUSIVE-AREA-REF DEST="EXCLUSIVE-AREA">/AUTOSAR_Eth_43_PFE/BswModuleDescriptions/Eth/InternalBehavior_0/ETH_EXCLUSIVE_AREA_74</CAN-ENTER-EXCLUSIVE-AREA-REF>
                        <CAN-ENTER-EXCLUSIVE-AREA-REF DEST="EXCLUSIVE-AREA">/AUTOSAR_Eth_43_PFE/BswModuleDescriptions/Eth/InternalBehavior_0/ETH_EXCLUSIVE_AREA_77</CAN-ENTER-EXCLUSIVE-AREA-REF>
                        <CAN-ENTER-EXCLUSIVE-AREA-REF DEST="EXCLUSIVE-AREA">/AUTOSAR_Eth_43_PFE/BswModuleDescriptions/Eth/InternalBehavior_0/ETH_EXCLUSIVE_AREA_78</CAN-ENTER-EXCLUSIVE-AREA-REF>
                        <CAN-ENTER-EXCLUSIVE-AREA-REF DEST="EXCLUSIVE-AREA">/AUTOSAR_Eth_43_PFE/BswModuleDescriptions/Eth/InternalBehavior_0/ETH_EXCLUSIVE_AREA_79</CAN-ENTER-EXCLUSIVE-AREA-REF>
                        <CAN-ENTER-EXCLUSIVE-AREA-REF DEST="EXCLUSIVE-AREA">/AUTOSAR_Eth_43_PFE/BswModuleDescriptions/Eth/InternalBehavior_0/ETH_EXCLUSIVE_AREA_81</CAN-ENTER-EXCLUSIVE-AREA-REF>
                        <CAN-ENTER-EXCLUSIVE-AREA-REF DEST="EXCLUSIVE-AREA">/AUTOSAR_Eth_43_PFE/BswModuleDescriptions/Eth/InternalBehavior_0/ETH_EXCLUSIVE_AREA_82</CAN-ENTER-EXCLUSIVE-AREA-REF>
                        <CAN-ENTER-EXCLUSIVE-AREA-REF DEST="EXCLUSIVE-AREA">/AUTOSAR_Eth_43_PFE/BswModuleDescriptions/Eth/InternalBehavior_0/ETH_EXCLUSIVE_AREA_85</CAN-ENTER-EXCLUSIVE-AREA-REF>
                        <CAN-ENTER-EXCLUSIVE-AREA-REF DEST="EXCLUSIVE-AREA">/AUTOSAR_Eth_43_PFE/BswModuleDescriptions/Eth/InternalBehavior_0/ETH_EXCLUSIVE_AREA_86</CAN-ENTER-EXCLUSIVE-AREA-REF>
                        <CAN-ENTER-EXCLUSIVE-AREA-REF DEST="EXCLUSIVE-AREA">/AUTOSAR_Eth_43_PFE/BswModuleDescriptions/Eth/InternalBehavior_0/ETH_EXCLUSIVE_AREA_88</CAN-ENTER-EXCLUSIVE-AREA-REF>
                        <CAN-ENTER-EXCLUSIVE-AREA-REF DEST="EXCLUSIVE-AREA">/AUTOSAR_Eth_43_PFE/BswModuleDescriptions/Eth/InternalBehavior_0/ETH_EXCLUSIVE_AREA_89</CAN-ENTER-EXCLUSIVE-AREA-REF>
                        <CAN-ENTER-EXCLUSIVE-AREA-REF DEST="EXCLUSIVE-AREA">/AUTOSAR_Eth_43_PFE/BswModuleDescriptions/Eth/InternalBehavior_0/ETH_EXCLUSIVE_AREA_90</CAN-ENTER-EXCLUSIVE-AREA-REF>
                        <CAN-ENTER-EXCLUSIVE-AREA-REF DEST="EXCLUSIVE-AREA">/AUTOSAR_Eth_43_PFE/BswModuleDescriptions/Eth/InternalBehavior_0/ETH_EXCLUSIVE_AREA_92</CAN-ENTER-EXCLUSIVE-AREA-REF>
                        <CAN-ENTER-EXCLUSIVE-AREA-REF DEST="EXCLUSIVE-AREA">/AUTOSAR_Eth_43_PFE/BswModuleDescriptions/Eth/InternalBehavior_0/ETH_EXCLUSIVE_AREA_93</CAN-ENTER-EXCLUSIVE-AREA-REF>
                        <CAN-ENTER-EXCLUSIVE-AREA-REF DEST="EXCLUSIVE-AREA">/AUTOSAR_Eth_43_PFE/BswModuleDescriptions/Eth/InternalBehavior_0/ETH_EXCLUSIVE_AREA_94</CAN-ENTER-EXCLUSIVE-AREA-REF>
                        <CAN-ENTER-EXCLUSIVE-AREA-REF DEST="EXCLUSIVE-AREA">/AUTOSAR_Eth_43_PFE/BswModuleDescriptions/Eth/InternalBehavior_0/ETH_EXCLUSIVE_AREA_95</CAN-ENTER-EXCLUSIVE-AREA-REF>
                        <CAN-ENTER-EXCLUSIVE-AREA-REF DEST="EXCLUSIVE-AREA">/AUTOSAR_Eth_43_PFE/BswModuleDescriptions/Eth/InternalBehavior_0/ETH_EXCLUSIVE_AREA_97</CAN-ENTER-EXCLUSIVE-AREA-REF>
                        <CAN-ENTER-EXCLUSIVE-AREA-REF DEST="EXCLUSIVE-AREA">/AUTOSAR_Eth_43_PFE/BswModuleDescriptions/Eth/InternalBehavior_0/ETH_EXCLUSIVE_AREA_99</CAN-ENTER-EXCLUSIVE-AREA-REF>
                        <CAN-ENTER-EXCLUSIVE-AREA-REF DEST="EXCLUSIVE-AREA">/AUTOSAR_Eth_43_PFE/BswModuleDescriptions/Eth/InternalBehavior_0/ETH_EXCLUSIVE_AREA_100</CAN-ENTER-EXCLUSIVE-AREA-REF>
                        <CAN-ENTER-EXCLUSIVE-AREA-REF DEST="EXCLUSIVE-AREA">/AUTOSAR_Eth_43_PFE/BswModuleDescriptions/Eth/InternalBehavior_0/ETH_EXCLUSIVE_AREA_101</CAN-ENTER-EXCLUSIVE-AREA-REF>
                        <CAN-ENTER-EXCLUSIVE-AREA-REF DEST="EXCLUSIVE-AREA">/AUTOSAR_Eth_43_PFE/BswModuleDescriptions/Eth/InternalBehavior_0/ETH_EXCLUSIVE_AREA_102</CAN-ENTER-EXCLUSIVE-AREA-REF>
                        <CAN-ENTER-EXCLUSIVE-AREA-REF DEST="EXCLUSIVE-AREA">/AUTOSAR_Eth_43_PFE/BswModuleDescriptions/Eth/InternalBehavior_0/ETH_EXCLUSIVE_AREA_103</CAN-ENTER-EXCLUSIVE-AREA-REF>
                        <CAN-ENTER-EXCLUSIVE-AREA-REF DEST="EXCLUSIVE-AREA">/AUTOSAR_Eth_43_PFE/BswModuleDescriptions/Eth/InternalBehavior_0/ETH_EXCLUSIVE_AREA_104</CAN-ENTER-EXCLUSIVE-AREA-REF>
                      </CAN-ENTER-EXCLUSIVE-AREA-REFS>
                      <MINIMUM-START-INTERVAL>0.0</MINIMUM-START-INTERVAL>
                      <IMPLEMENTED-ENTRY-REF DEST="BSW-MODULE-ENTRY">/AUTOSAR_Eth_43_PFE/BswModuleEntrys/Eth_HifIrqHdlr_3</IMPLEMENTED-ENTRY-REF>
                      <INTERRUPT-CATEGORY>CAT-2</INTERRUPT-CATEGORY>
                      <INTERRUPT-SOURCE>Hardware</INTERRUPT-SOURCE>
                    </BSW-INTERRUPT-ENTITY>
[!ENDIF!][!//
[!IF "EthGeneral/EthVendorSpecific/EthCommonHif = 'HIF_NOCPY'"!][!//
                    <BSW-INTERRUPT-ENTITY>
                      <SHORT-NAME>Eth_43_PFE_HifNoCpyIrqHdlr</SHORT-NAME>
                      <CAN-ENTER-EXCLUSIVE-AREA-REFS>
                        <CAN-ENTER-EXCLUSIVE-AREA-REF DEST="EXCLUSIVE-AREA">/AUTOSAR_Eth_43_PFE/BswModuleDescriptions/Eth/InternalBehavior_0/ETH_EXCLUSIVE_AREA_01</CAN-ENTER-EXCLUSIVE-AREA-REF>
                        <CAN-ENTER-EXCLUSIVE-AREA-REF DEST="EXCLUSIVE-AREA">/AUTOSAR_Eth_43_PFE/BswModuleDescriptions/Eth/InternalBehavior_0/ETH_EXCLUSIVE_AREA_03</CAN-ENTER-EXCLUSIVE-AREA-REF>
                        <CAN-ENTER-EXCLUSIVE-AREA-REF DEST="EXCLUSIVE-AREA">/AUTOSAR_Eth_43_PFE/BswModuleDescriptions/Eth/InternalBehavior_0/ETH_EXCLUSIVE_AREA_04</CAN-ENTER-EXCLUSIVE-AREA-REF>
                        <CAN-ENTER-EXCLUSIVE-AREA-REF DEST="EXCLUSIVE-AREA">/AUTOSAR_Eth_43_PFE/BswModuleDescriptions/Eth/InternalBehavior_0/ETH_EXCLUSIVE_AREA_05</CAN-ENTER-EXCLUSIVE-AREA-REF>
                        <CAN-ENTER-EXCLUSIVE-AREA-REF DEST="EXCLUSIVE-AREA">/AUTOSAR_Eth_43_PFE/BswModuleDescriptions/Eth/InternalBehavior_0/ETH_EXCLUSIVE_AREA_07</CAN-ENTER-EXCLUSIVE-AREA-REF>
                        <CAN-ENTER-EXCLUSIVE-AREA-REF DEST="EXCLUSIVE-AREA">/AUTOSAR_Eth_43_PFE/BswModuleDescriptions/Eth/InternalBehavior_0/ETH_EXCLUSIVE_AREA_08</CAN-ENTER-EXCLUSIVE-AREA-REF>
                        <CAN-ENTER-EXCLUSIVE-AREA-REF DEST="EXCLUSIVE-AREA">/AUTOSAR_Eth_43_PFE/BswModuleDescriptions/Eth/InternalBehavior_0/ETH_EXCLUSIVE_AREA_09</CAN-ENTER-EXCLUSIVE-AREA-REF>
                        <CAN-ENTER-EXCLUSIVE-AREA-REF DEST="EXCLUSIVE-AREA">/AUTOSAR_Eth_43_PFE/BswModuleDescriptions/Eth/InternalBehavior_0/ETH_EXCLUSIVE_AREA_10</CAN-ENTER-EXCLUSIVE-AREA-REF>
                        <CAN-ENTER-EXCLUSIVE-AREA-REF DEST="EXCLUSIVE-AREA">/AUTOSAR_Eth_43_PFE/BswModuleDescriptions/Eth/InternalBehavior_0/ETH_EXCLUSIVE_AREA_13</CAN-ENTER-EXCLUSIVE-AREA-REF>
                        <CAN-ENTER-EXCLUSIVE-AREA-REF DEST="EXCLUSIVE-AREA">/AUTOSAR_Eth_43_PFE/BswModuleDescriptions/Eth/InternalBehavior_0/ETH_EXCLUSIVE_AREA_14</CAN-ENTER-EXCLUSIVE-AREA-REF>
                        <CAN-ENTER-EXCLUSIVE-AREA-REF DEST="EXCLUSIVE-AREA">/AUTOSAR_Eth_43_PFE/BswModuleDescriptions/Eth/InternalBehavior_0/ETH_EXCLUSIVE_AREA_15</CAN-ENTER-EXCLUSIVE-AREA-REF>
                        <CAN-ENTER-EXCLUSIVE-AREA-REF DEST="EXCLUSIVE-AREA">/AUTOSAR_Eth_43_PFE/BswModuleDescriptions/Eth/InternalBehavior_0/ETH_EXCLUSIVE_AREA_16</CAN-ENTER-EXCLUSIVE-AREA-REF>
                        <CAN-ENTER-EXCLUSIVE-AREA-REF DEST="EXCLUSIVE-AREA">/AUTOSAR_Eth_43_PFE/BswModuleDescriptions/Eth/InternalBehavior_0/ETH_EXCLUSIVE_AREA_18</CAN-ENTER-EXCLUSIVE-AREA-REF>
                        <CAN-ENTER-EXCLUSIVE-AREA-REF DEST="EXCLUSIVE-AREA">/AUTOSAR_Eth_43_PFE/BswModuleDescriptions/Eth/InternalBehavior_0/ETH_EXCLUSIVE_AREA_20</CAN-ENTER-EXCLUSIVE-AREA-REF>
                        <CAN-ENTER-EXCLUSIVE-AREA-REF DEST="EXCLUSIVE-AREA">/AUTOSAR_Eth_43_PFE/BswModuleDescriptions/Eth/InternalBehavior_0/ETH_EXCLUSIVE_AREA_21</CAN-ENTER-EXCLUSIVE-AREA-REF>
                        <CAN-ENTER-EXCLUSIVE-AREA-REF DEST="EXCLUSIVE-AREA">/AUTOSAR_Eth_43_PFE/BswModuleDescriptions/Eth/InternalBehavior_0/ETH_EXCLUSIVE_AREA_22</CAN-ENTER-EXCLUSIVE-AREA-REF>
                        <CAN-ENTER-EXCLUSIVE-AREA-REF DEST="EXCLUSIVE-AREA">/AUTOSAR_Eth_43_PFE/BswModuleDescriptions/Eth/InternalBehavior_0/ETH_EXCLUSIVE_AREA_23</CAN-ENTER-EXCLUSIVE-AREA-REF>
                        <CAN-ENTER-EXCLUSIVE-AREA-REF DEST="EXCLUSIVE-AREA">/AUTOSAR_Eth_43_PFE/BswModuleDescriptions/Eth/InternalBehavior_0/ETH_EXCLUSIVE_AREA_26</CAN-ENTER-EXCLUSIVE-AREA-REF>
                        <CAN-ENTER-EXCLUSIVE-AREA-REF DEST="EXCLUSIVE-AREA">/AUTOSAR_Eth_43_PFE/BswModuleDescriptions/Eth/InternalBehavior_0/ETH_EXCLUSIVE_AREA_28</CAN-ENTER-EXCLUSIVE-AREA-REF>
                        <CAN-ENTER-EXCLUSIVE-AREA-REF DEST="EXCLUSIVE-AREA">/AUTOSAR_Eth_43_PFE/BswModuleDescriptions/Eth/InternalBehavior_0/ETH_EXCLUSIVE_AREA_30</CAN-ENTER-EXCLUSIVE-AREA-REF>
                        <CAN-ENTER-EXCLUSIVE-AREA-REF DEST="EXCLUSIVE-AREA">/AUTOSAR_Eth_43_PFE/BswModuleDescriptions/Eth/InternalBehavior_0/ETH_EXCLUSIVE_AREA_31</CAN-ENTER-EXCLUSIVE-AREA-REF>
                        <CAN-ENTER-EXCLUSIVE-AREA-REF DEST="EXCLUSIVE-AREA">/AUTOSAR_Eth_43_PFE/BswModuleDescriptions/Eth/InternalBehavior_0/ETH_EXCLUSIVE_AREA_38</CAN-ENTER-EXCLUSIVE-AREA-REF>
                        <CAN-ENTER-EXCLUSIVE-AREA-REF DEST="EXCLUSIVE-AREA">/AUTOSAR_Eth_43_PFE/BswModuleDescriptions/Eth/InternalBehavior_0/ETH_EXCLUSIVE_AREA_39</CAN-ENTER-EXCLUSIVE-AREA-REF>
                        <CAN-ENTER-EXCLUSIVE-AREA-REF DEST="EXCLUSIVE-AREA">/AUTOSAR_Eth_43_PFE/BswModuleDescriptions/Eth/InternalBehavior_0/ETH_EXCLUSIVE_AREA_40</CAN-ENTER-EXCLUSIVE-AREA-REF>
                        <CAN-ENTER-EXCLUSIVE-AREA-REF DEST="EXCLUSIVE-AREA">/AUTOSAR_Eth_43_PFE/BswModuleDescriptions/Eth/InternalBehavior_0/ETH_EXCLUSIVE_AREA_41</CAN-ENTER-EXCLUSIVE-AREA-REF>
                        <CAN-ENTER-EXCLUSIVE-AREA-REF DEST="EXCLUSIVE-AREA">/AUTOSAR_Eth_43_PFE/BswModuleDescriptions/Eth/InternalBehavior_0/ETH_EXCLUSIVE_AREA_42</CAN-ENTER-EXCLUSIVE-AREA-REF>
                        <CAN-ENTER-EXCLUSIVE-AREA-REF DEST="EXCLUSIVE-AREA">/AUTOSAR_Eth_43_PFE/BswModuleDescriptions/Eth/InternalBehavior_0/ETH_EXCLUSIVE_AREA_43</CAN-ENTER-EXCLUSIVE-AREA-REF>
                        <CAN-ENTER-EXCLUSIVE-AREA-REF DEST="EXCLUSIVE-AREA">/AUTOSAR_Eth_43_PFE/BswModuleDescriptions/Eth/InternalBehavior_0/ETH_EXCLUSIVE_AREA_45</CAN-ENTER-EXCLUSIVE-AREA-REF>
                        <CAN-ENTER-EXCLUSIVE-AREA-REF DEST="EXCLUSIVE-AREA">/AUTOSAR_Eth_43_PFE/BswModuleDescriptions/Eth/InternalBehavior_0/ETH_EXCLUSIVE_AREA_46</CAN-ENTER-EXCLUSIVE-AREA-REF>
                        <CAN-ENTER-EXCLUSIVE-AREA-REF DEST="EXCLUSIVE-AREA">/AUTOSAR_Eth_43_PFE/BswModuleDescriptions/Eth/InternalBehavior_0/ETH_EXCLUSIVE_AREA_47</CAN-ENTER-EXCLUSIVE-AREA-REF>
                        <CAN-ENTER-EXCLUSIVE-AREA-REF DEST="EXCLUSIVE-AREA">/AUTOSAR_Eth_43_PFE/BswModuleDescriptions/Eth/InternalBehavior_0/ETH_EXCLUSIVE_AREA_48</CAN-ENTER-EXCLUSIVE-AREA-REF>
                        <CAN-ENTER-EXCLUSIVE-AREA-REF DEST="EXCLUSIVE-AREA">/AUTOSAR_Eth_43_PFE/BswModuleDescriptions/Eth/InternalBehavior_0/ETH_EXCLUSIVE_AREA_50</CAN-ENTER-EXCLUSIVE-AREA-REF>
                        <CAN-ENTER-EXCLUSIVE-AREA-REF DEST="EXCLUSIVE-AREA">/AUTOSAR_Eth_43_PFE/BswModuleDescriptions/Eth/InternalBehavior_0/ETH_EXCLUSIVE_AREA_54</CAN-ENTER-EXCLUSIVE-AREA-REF>
                        <CAN-ENTER-EXCLUSIVE-AREA-REF DEST="EXCLUSIVE-AREA">/AUTOSAR_Eth_43_PFE/BswModuleDescriptions/Eth/InternalBehavior_0/ETH_EXCLUSIVE_AREA_55</CAN-ENTER-EXCLUSIVE-AREA-REF>
                        <CAN-ENTER-EXCLUSIVE-AREA-REF DEST="EXCLUSIVE-AREA">/AUTOSAR_Eth_43_PFE/BswModuleDescriptions/Eth/InternalBehavior_0/ETH_EXCLUSIVE_AREA_56</CAN-ENTER-EXCLUSIVE-AREA-REF>
                        <CAN-ENTER-EXCLUSIVE-AREA-REF DEST="EXCLUSIVE-AREA">/AUTOSAR_Eth_43_PFE/BswModuleDescriptions/Eth/InternalBehavior_0/ETH_EXCLUSIVE_AREA_57</CAN-ENTER-EXCLUSIVE-AREA-REF>
                        <CAN-ENTER-EXCLUSIVE-AREA-REF DEST="EXCLUSIVE-AREA">/AUTOSAR_Eth_43_PFE/BswModuleDescriptions/Eth/InternalBehavior_0/ETH_EXCLUSIVE_AREA_58</CAN-ENTER-EXCLUSIVE-AREA-REF>
                        <CAN-ENTER-EXCLUSIVE-AREA-REF DEST="EXCLUSIVE-AREA">/AUTOSAR_Eth_43_PFE/BswModuleDescriptions/Eth/InternalBehavior_0/ETH_EXCLUSIVE_AREA_59</CAN-ENTER-EXCLUSIVE-AREA-REF>
                        <CAN-ENTER-EXCLUSIVE-AREA-REF DEST="EXCLUSIVE-AREA">/AUTOSAR_Eth_43_PFE/BswModuleDescriptions/Eth/InternalBehavior_0/ETH_EXCLUSIVE_AREA_60</CAN-ENTER-EXCLUSIVE-AREA-REF>
                        <CAN-ENTER-EXCLUSIVE-AREA-REF DEST="EXCLUSIVE-AREA">/AUTOSAR_Eth_43_PFE/BswModuleDescriptions/Eth/InternalBehavior_0/ETH_EXCLUSIVE_AREA_65</CAN-ENTER-EXCLUSIVE-AREA-REF>
                        <CAN-ENTER-EXCLUSIVE-AREA-REF DEST="EXCLUSIVE-AREA">/AUTOSAR_Eth_43_PFE/BswModuleDescriptions/Eth/InternalBehavior_0/ETH_EXCLUSIVE_AREA_66</CAN-ENTER-EXCLUSIVE-AREA-REF>
                        <CAN-ENTER-EXCLUSIVE-AREA-REF DEST="EXCLUSIVE-AREA">/AUTOSAR_Eth_43_PFE/BswModuleDescriptions/Eth/InternalBehavior_0/ETH_EXCLUSIVE_AREA_67</CAN-ENTER-EXCLUSIVE-AREA-REF>
                        <CAN-ENTER-EXCLUSIVE-AREA-REF DEST="EXCLUSIVE-AREA">/AUTOSAR_Eth_43_PFE/BswModuleDescriptions/Eth/InternalBehavior_0/ETH_EXCLUSIVE_AREA_68</CAN-ENTER-EXCLUSIVE-AREA-REF>
                        <CAN-ENTER-EXCLUSIVE-AREA-REF DEST="EXCLUSIVE-AREA">/AUTOSAR_Eth_43_PFE/BswModuleDescriptions/Eth/InternalBehavior_0/ETH_EXCLUSIVE_AREA_69</CAN-ENTER-EXCLUSIVE-AREA-REF>
                        <CAN-ENTER-EXCLUSIVE-AREA-REF DEST="EXCLUSIVE-AREA">/AUTOSAR_Eth_43_PFE/BswModuleDescriptions/Eth/InternalBehavior_0/ETH_EXCLUSIVE_AREA_70</CAN-ENTER-EXCLUSIVE-AREA-REF>
                        <CAN-ENTER-EXCLUSIVE-AREA-REF DEST="EXCLUSIVE-AREA">/AUTOSAR_Eth_43_PFE/BswModuleDescriptions/Eth/InternalBehavior_0/ETH_EXCLUSIVE_AREA_71</CAN-ENTER-EXCLUSIVE-AREA-REF>
                        <CAN-ENTER-EXCLUSIVE-AREA-REF DEST="EXCLUSIVE-AREA">/AUTOSAR_Eth_43_PFE/BswModuleDescriptions/Eth/InternalBehavior_0/ETH_EXCLUSIVE_AREA_72</CAN-ENTER-EXCLUSIVE-AREA-REF>
                        <CAN-ENTER-EXCLUSIVE-AREA-REF DEST="EXCLUSIVE-AREA">/AUTOSAR_Eth_43_PFE/BswModuleDescriptions/Eth/InternalBehavior_0/ETH_EXCLUSIVE_AREA_73</CAN-ENTER-EXCLUSIVE-AREA-REF>
                        <CAN-ENTER-EXCLUSIVE-AREA-REF DEST="EXCLUSIVE-AREA">/AUTOSAR_Eth_43_PFE/BswModuleDescriptions/Eth/InternalBehavior_0/ETH_EXCLUSIVE_AREA_74</CAN-ENTER-EXCLUSIVE-AREA-REF>
                        <CAN-ENTER-EXCLUSIVE-AREA-REF DEST="EXCLUSIVE-AREA">/AUTOSAR_Eth_43_PFE/BswModuleDescriptions/Eth/InternalBehavior_0/ETH_EXCLUSIVE_AREA_77</CAN-ENTER-EXCLUSIVE-AREA-REF>
                        <CAN-ENTER-EXCLUSIVE-AREA-REF DEST="EXCLUSIVE-AREA">/AUTOSAR_Eth_43_PFE/BswModuleDescriptions/Eth/InternalBehavior_0/ETH_EXCLUSIVE_AREA_78</CAN-ENTER-EXCLUSIVE-AREA-REF>
                        <CAN-ENTER-EXCLUSIVE-AREA-REF DEST="EXCLUSIVE-AREA">/AUTOSAR_Eth_43_PFE/BswModuleDescriptions/Eth/InternalBehavior_0/ETH_EXCLUSIVE_AREA_79</CAN-ENTER-EXCLUSIVE-AREA-REF>
                        <CAN-ENTER-EXCLUSIVE-AREA-REF DEST="EXCLUSIVE-AREA">/AUTOSAR_Eth_43_PFE/BswModuleDescriptions/Eth/InternalBehavior_0/ETH_EXCLUSIVE_AREA_81</CAN-ENTER-EXCLUSIVE-AREA-REF>
                        <CAN-ENTER-EXCLUSIVE-AREA-REF DEST="EXCLUSIVE-AREA">/AUTOSAR_Eth_43_PFE/BswModuleDescriptions/Eth/InternalBehavior_0/ETH_EXCLUSIVE_AREA_82</CAN-ENTER-EXCLUSIVE-AREA-REF>
                        <CAN-ENTER-EXCLUSIVE-AREA-REF DEST="EXCLUSIVE-AREA">/AUTOSAR_Eth_43_PFE/BswModuleDescriptions/Eth/InternalBehavior_0/ETH_EXCLUSIVE_AREA_85</CAN-ENTER-EXCLUSIVE-AREA-REF>
                        <CAN-ENTER-EXCLUSIVE-AREA-REF DEST="EXCLUSIVE-AREA">/AUTOSAR_Eth_43_PFE/BswModuleDescriptions/Eth/InternalBehavior_0/ETH_EXCLUSIVE_AREA_86</CAN-ENTER-EXCLUSIVE-AREA-REF>
                        <CAN-ENTER-EXCLUSIVE-AREA-REF DEST="EXCLUSIVE-AREA">/AUTOSAR_Eth_43_PFE/BswModuleDescriptions/Eth/InternalBehavior_0/ETH_EXCLUSIVE_AREA_88</CAN-ENTER-EXCLUSIVE-AREA-REF>
                        <CAN-ENTER-EXCLUSIVE-AREA-REF DEST="EXCLUSIVE-AREA">/AUTOSAR_Eth_43_PFE/BswModuleDescriptions/Eth/InternalBehavior_0/ETH_EXCLUSIVE_AREA_89</CAN-ENTER-EXCLUSIVE-AREA-REF>
                        <CAN-ENTER-EXCLUSIVE-AREA-REF DEST="EXCLUSIVE-AREA">/AUTOSAR_Eth_43_PFE/BswModuleDescriptions/Eth/InternalBehavior_0/ETH_EXCLUSIVE_AREA_90</CAN-ENTER-EXCLUSIVE-AREA-REF>
                        <CAN-ENTER-EXCLUSIVE-AREA-REF DEST="EXCLUSIVE-AREA">/AUTOSAR_Eth_43_PFE/BswModuleDescriptions/Eth/InternalBehavior_0/ETH_EXCLUSIVE_AREA_92</CAN-ENTER-EXCLUSIVE-AREA-REF>
                        <CAN-ENTER-EXCLUSIVE-AREA-REF DEST="EXCLUSIVE-AREA">/AUTOSAR_Eth_43_PFE/BswModuleDescriptions/Eth/InternalBehavior_0/ETH_EXCLUSIVE_AREA_93</CAN-ENTER-EXCLUSIVE-AREA-REF>
                        <CAN-ENTER-EXCLUSIVE-AREA-REF DEST="EXCLUSIVE-AREA">/AUTOSAR_Eth_43_PFE/BswModuleDescriptions/Eth/InternalBehavior_0/ETH_EXCLUSIVE_AREA_94</CAN-ENTER-EXCLUSIVE-AREA-REF>
                        <CAN-ENTER-EXCLUSIVE-AREA-REF DEST="EXCLUSIVE-AREA">/AUTOSAR_Eth_43_PFE/BswModuleDescriptions/Eth/InternalBehavior_0/ETH_EXCLUSIVE_AREA_95</CAN-ENTER-EXCLUSIVE-AREA-REF>
                        <CAN-ENTER-EXCLUSIVE-AREA-REF DEST="EXCLUSIVE-AREA">/AUTOSAR_Eth_43_PFE/BswModuleDescriptions/Eth/InternalBehavior_0/ETH_EXCLUSIVE_AREA_97</CAN-ENTER-EXCLUSIVE-AREA-REF>
                        <CAN-ENTER-EXCLUSIVE-AREA-REF DEST="EXCLUSIVE-AREA">/AUTOSAR_Eth_43_PFE/BswModuleDescriptions/Eth/InternalBehavior_0/ETH_EXCLUSIVE_AREA_99</CAN-ENTER-EXCLUSIVE-AREA-REF>
                        <CAN-ENTER-EXCLUSIVE-AREA-REF DEST="EXCLUSIVE-AREA">/AUTOSAR_Eth_43_PFE/BswModuleDescriptions/Eth/InternalBehavior_0/ETH_EXCLUSIVE_AREA_100</CAN-ENTER-EXCLUSIVE-AREA-REF>
                        <CAN-ENTER-EXCLUSIVE-AREA-REF DEST="EXCLUSIVE-AREA">/AUTOSAR_Eth_43_PFE/BswModuleDescriptions/Eth/InternalBehavior_0/ETH_EXCLUSIVE_AREA_101</CAN-ENTER-EXCLUSIVE-AREA-REF>
                        <CAN-ENTER-EXCLUSIVE-AREA-REF DEST="EXCLUSIVE-AREA">/AUTOSAR_Eth_43_PFE/BswModuleDescriptions/Eth/InternalBehavior_0/ETH_EXCLUSIVE_AREA_102</CAN-ENTER-EXCLUSIVE-AREA-REF>
                        <CAN-ENTER-EXCLUSIVE-AREA-REF DEST="EXCLUSIVE-AREA">/AUTOSAR_Eth_43_PFE/BswModuleDescriptions/Eth/InternalBehavior_0/ETH_EXCLUSIVE_AREA_103</CAN-ENTER-EXCLUSIVE-AREA-REF>
                        <CAN-ENTER-EXCLUSIVE-AREA-REF DEST="EXCLUSIVE-AREA">/AUTOSAR_Eth_43_PFE/BswModuleDescriptions/Eth/InternalBehavior_0/ETH_EXCLUSIVE_AREA_104</CAN-ENTER-EXCLUSIVE-AREA-REF>
                      </CAN-ENTER-EXCLUSIVE-AREA-REFS>
                      <MINIMUM-START-INTERVAL>0.0</MINIMUM-START-INTERVAL>
                      <IMPLEMENTED-ENTRY-REF DEST="BSW-MODULE-ENTRY">/AUTOSAR_Eth_43_PFE/BswModuleEntrys/Eth_HifNoCpyIrqHdlr</IMPLEMENTED-ENTRY-REF>
                      <INTERRUPT-CATEGORY>CAT-2</INTERRUPT-CATEGORY>
                      <INTERRUPT-SOURCE>Hardware</INTERRUPT-SOURCE>
                    </BSW-INTERRUPT-ENTITY>
[!ENDIF!][!//
[!IF "EthGeneral/EthVendorSpecific/EnableBmuInterrupt = 'true'"!][!//
                    <BSW-INTERRUPT-ENTITY>
                      <SHORT-NAME>Eth_43_PFE_BmuIrqHdlr</SHORT-NAME>
                      <CAN-ENTER-EXCLUSIVE-AREA-REFS>
                        <CAN-ENTER-EXCLUSIVE-AREA-REF DEST="EXCLUSIVE-AREA">/AUTOSAR_Eth_43_PFE/BswModuleDescriptions/Eth/InternalBehavior_0/ETH_EXCLUSIVE_AREA_95</CAN-ENTER-EXCLUSIVE-AREA-REF>
                        <CAN-ENTER-EXCLUSIVE-AREA-REF DEST="EXCLUSIVE-AREA">/AUTOSAR_Eth_43_PFE/BswModuleDescriptions/Eth/InternalBehavior_0/ETH_EXCLUSIVE_AREA_100</CAN-ENTER-EXCLUSIVE-AREA-REF>
                        <CAN-ENTER-EXCLUSIVE-AREA-REF DEST="EXCLUSIVE-AREA">/AUTOSAR_Eth_43_PFE/BswModuleDescriptions/Eth/InternalBehavior_0/ETH_EXCLUSIVE_AREA_101</CAN-ENTER-EXCLUSIVE-AREA-REF>
                      </CAN-ENTER-EXCLUSIVE-AREA-REFS>
                      <MINIMUM-START-INTERVAL>0.0</MINIMUM-START-INTERVAL>
                      <IMPLEMENTED-ENTRY-REF DEST="BSW-MODULE-ENTRY">/AUTOSAR_Eth_43_PFE/BswModuleEntrys/Eth_BmuIrqHdlr</IMPLEMENTED-ENTRY-REF>
                      <INTERRUPT-CATEGORY>CAT-2</INTERRUPT-CATEGORY>
                      <INTERRUPT-SOURCE>Hardware</INTERRUPT-SOURCE>
                    </BSW-INTERRUPT-ENTITY>
[!ENDIF!][!//
                  </ENTITYS>
                  <EVENTS>
                    <BSW-TIMING-EVENT>
                      <SHORT-NAME>EthTimingEvent_MainFunction</SHORT-NAME>
                      <STARTS-ON-EVENT-REF DEST="BSW-SCHEDULABLE-ENTITY">/AUTOSAR_Eth_43_PFE/BswModuleDescriptions/Eth/InternalBehavior_0/Eth_43_PFE_MainFunction</STARTS-ON-EVENT-REF>
                      <PERIOD>[!IF "node:exists(EthGeneral/EthMainFunctionPeriod)"!][!"EthGeneral/EthMainFunctionPeriod"!][!ELSE!]0[!ENDIF!]</PERIOD>
                    </BSW-TIMING-EVENT>
                  </EVENTS>
                </BSW-INTERNAL-BEHAVIOR>
              </INTERNAL-BEHAVIORS>
            </BSW-MODULE-DESCRIPTION>
          </ELEMENTS>
        </AR-PACKAGE>

        <AR-PACKAGE>
          <SHORT-NAME>BswModuleEntrys</SHORT-NAME>
          <ELEMENTS>
              <BSW-MODULE-ENTRY>
                <SHORT-NAME>Eth_GetControllerMode</SHORT-NAME>
                <SERVICE-ID>0x04</SERVICE-ID>
                <IS-REENTRANT>false</IS-REENTRANT>
                <IS-SYNCHRONOUS>true</IS-SYNCHRONOUS>
                <CALL-TYPE>REGULAR</CALL-TYPE>
                <EXECUTION-CONTEXT>UNSPECIFIED</EXECUTION-CONTEXT>
                <SW-SERVICE-IMPL-POLICY>STANDARD</SW-SERVICE-IMPL-POLICY>
              </BSW-MODULE-ENTRY>
              [!IF "EthGeneral/EthGetCounterValuesApi = 'true'"!][!//
              <BSW-MODULE-ENTRY>
                <SHORT-NAME>Eth_GetCounterValues</SHORT-NAME>
                <SERVICE-ID>0x14</SERVICE-ID>
                <IS-REENTRANT>false</IS-REENTRANT>
                <IS-SYNCHRONOUS>true</IS-SYNCHRONOUS>
                <CALL-TYPE>REGULAR</CALL-TYPE>
                <EXECUTION-CONTEXT>UNSPECIFIED</EXECUTION-CONTEXT>
                <SW-SERVICE-IMPL-POLICY>STANDARD</SW-SERVICE-IMPL-POLICY>
              </BSW-MODULE-ENTRY>
              [!ENDIF!][!//
              [!IF "EthGeneral/EthGetClassStatisticApi = 'true'"!][!//
              <BSW-MODULE-ENTRY>
                <SHORT-NAME>Eth_GetClassStats</SHORT-NAME>
                <SERVICE-ID>0x23</SERVICE-ID>
                <IS-REENTRANT>false</IS-REENTRANT>
                <IS-SYNCHRONOUS>true</IS-SYNCHRONOUS>
                <CALL-TYPE>REGULAR</CALL-TYPE>
                <EXECUTION-CONTEXT>UNSPECIFIED</EXECUTION-CONTEXT>
                <SW-SERVICE-IMPL-POLICY>STANDARD</SW-SERVICE-IMPL-POLICY>
              </BSW-MODULE-ENTRY>
              [!ENDIF!][!//
              <BSW-MODULE-ENTRY>
                <SHORT-NAME>Eth_GetPhysAddr</SHORT-NAME>
                <SERVICE-ID>0x08</SERVICE-ID>
                <IS-REENTRANT>false</IS-REENTRANT>
                <IS-SYNCHRONOUS>true</IS-SYNCHRONOUS>
                <CALL-TYPE>REGULAR</CALL-TYPE>
                <EXECUTION-CONTEXT>UNSPECIFIED</EXECUTION-CONTEXT>
                <SW-SERVICE-IMPL-POLICY>STANDARD</SW-SERVICE-IMPL-POLICY>
              </BSW-MODULE-ENTRY>
              [!IF "EthGeneral/EthGetRxStatsApi = 'true'"!][!//
              <BSW-MODULE-ENTRY>
                <SHORT-NAME>Eth_GetRxStats</SHORT-NAME>
                <SERVICE-ID>0x15</SERVICE-ID>
                <IS-REENTRANT>false</IS-REENTRANT>
                <IS-SYNCHRONOUS>true</IS-SYNCHRONOUS>
                <CALL-TYPE>REGULAR</CALL-TYPE>
                <EXECUTION-CONTEXT>UNSPECIFIED</EXECUTION-CONTEXT>
                <SW-SERVICE-IMPL-POLICY>STANDARD</SW-SERVICE-IMPL-POLICY>
              </BSW-MODULE-ENTRY>
              [!ENDIF!][!//
              [!IF "EthGeneral/EthGetTxErrorCounterValuesApi = 'true'"!][!//
              <BSW-MODULE-ENTRY>
                <SHORT-NAME>Eth_GetTxErrorCounterValues</SHORT-NAME>
                <SERVICE-ID>0x1d</SERVICE-ID>
                <IS-REENTRANT>false</IS-REENTRANT>
                <IS-SYNCHRONOUS>true</IS-SYNCHRONOUS>
                <CALL-TYPE>REGULAR</CALL-TYPE>
                <EXECUTION-CONTEXT>UNSPECIFIED</EXECUTION-CONTEXT>
                <SW-SERVICE-IMPL-POLICY>STANDARD</SW-SERVICE-IMPL-POLICY>
              </BSW-MODULE-ENTRY>
              [!ENDIF!][!//
              [!IF "EthGeneral/EthGlobalTimeSupport = 'true'"!][!//
              <BSW-MODULE-ENTRY>
                <SHORT-NAME>Eth_GetEgressTimeStamp</SHORT-NAME>
                <SERVICE-ID>0x18</SERVICE-ID>
                <IS-REENTRANT>false</IS-REENTRANT>
                <IS-SYNCHRONOUS>true</IS-SYNCHRONOUS>
                <CALL-TYPE>REGULAR</CALL-TYPE>
                <EXECUTION-CONTEXT>UNSPECIFIED</EXECUTION-CONTEXT>
                <SW-SERVICE-IMPL-POLICY>STANDARD</SW-SERVICE-IMPL-POLICY>
              </BSW-MODULE-ENTRY>
              <BSW-MODULE-ENTRY>
                <SHORT-NAME>Eth_GetIngressTimeStamp</SHORT-NAME>
                <SERVICE-ID>0x19</SERVICE-ID>
                <IS-REENTRANT>false</IS-REENTRANT>
                <IS-SYNCHRONOUS>true</IS-SYNCHRONOUS>
                <CALL-TYPE>REGULAR</CALL-TYPE>
                <EXECUTION-CONTEXT>UNSPECIFIED</EXECUTION-CONTEXT>
                <SW-SERVICE-IMPL-POLICY>STANDARD</SW-SERVICE-IMPL-POLICY>
              </BSW-MODULE-ENTRY>
              <BSW-MODULE-ENTRY>
                <SHORT-NAME>Eth_GetCurrentTime</SHORT-NAME>
                <SERVICE-ID>0x16</SERVICE-ID>
                <IS-REENTRANT>false</IS-REENTRANT>
                <IS-SYNCHRONOUS>true</IS-SYNCHRONOUS>
                <CALL-TYPE>REGULAR</CALL-TYPE>
                <EXECUTION-CONTEXT>UNSPECIFIED</EXECUTION-CONTEXT>
                <SW-SERVICE-IMPL-POLICY>STANDARD</SW-SERVICE-IMPL-POLICY>
              </BSW-MODULE-ENTRY>
                [!IF "EthGeneral/EthVendorSpecific/EthPfeMultiInstance = 'false' or EthGeneral/EthVendorSpecific/EthPfeSlaveMode = 'false'"!][!//
              <BSW-MODULE-ENTRY>
                <SHORT-NAME>Eth_SetGlobalTime</SHORT-NAME>
                <SERVICE-ID>0x1b</SERVICE-ID>
                <IS-REENTRANT>false</IS-REENTRANT>
                <IS-SYNCHRONOUS>true</IS-SYNCHRONOUS>
                <CALL-TYPE>REGULAR</CALL-TYPE>
                <EXECUTION-CONTEXT>UNSPECIFIED</EXECUTION-CONTEXT>
                <SW-SERVICE-IMPL-POLICY>STANDARD</SW-SERVICE-IMPL-POLICY>
              </BSW-MODULE-ENTRY>
              <BSW-MODULE-ENTRY>
                <SHORT-NAME>Eth_SetCorrectionTime</SHORT-NAME>
                <SERVICE-ID>0x1a</SERVICE-ID>
                <IS-REENTRANT>false</IS-REENTRANT>
                <IS-SYNCHRONOUS>true</IS-SYNCHRONOUS>
                <CALL-TYPE>REGULAR</CALL-TYPE>
                <EXECUTION-CONTEXT>UNSPECIFIED</EXECUTION-CONTEXT>
                <SW-SERVICE-IMPL-POLICY>STANDARD</SW-SERVICE-IMPL-POLICY>
              </BSW-MODULE-ENTRY>
                [!ENDIF!][!//
              <BSW-MODULE-ENTRY>
                <SHORT-NAME>Eth_EnableEgressTimeStamp</SHORT-NAME>
                <SERVICE-ID>0x17</SERVICE-ID>
                <IS-REENTRANT>false</IS-REENTRANT>
                <IS-SYNCHRONOUS>true</IS-SYNCHRONOUS>
                <CALL-TYPE>REGULAR</CALL-TYPE>
                <EXECUTION-CONTEXT>UNSPECIFIED</EXECUTION-CONTEXT>
                <SW-SERVICE-IMPL-POLICY>STANDARD</SW-SERVICE-IMPL-POLICY>
              </BSW-MODULE-ENTRY>
              [!ENDIF!][!//
              [!IF "EthGeneral/EthGetTxStatsApi = 'true'"!][!//
              <BSW-MODULE-ENTRY>
                <SHORT-NAME>Eth_GetTxStats</SHORT-NAME>
                <SERVICE-ID>0x1c</SERVICE-ID>
                <IS-REENTRANT>false</IS-REENTRANT>
                <IS-SYNCHRONOUS>true</IS-SYNCHRONOUS>
                <CALL-TYPE>REGULAR</CALL-TYPE>
                <EXECUTION-CONTEXT>UNSPECIFIED</EXECUTION-CONTEXT>
                <SW-SERVICE-IMPL-POLICY>STANDARD</SW-SERVICE-IMPL-POLICY>
              </BSW-MODULE-ENTRY>
              [!ENDIF!][!//
              [!IF "EthGeneral/EthVersionInfoApi = 'true'"!][!//
              <BSW-MODULE-ENTRY>
                <SHORT-NAME>Eth_GetVersionInfo</SHORT-NAME>
                <SERVICE-ID>0xd</SERVICE-ID>
                <IS-REENTRANT>true</IS-REENTRANT>
                <IS-SYNCHRONOUS>true</IS-SYNCHRONOUS>
                <CALL-TYPE>REGULAR</CALL-TYPE>
                <EXECUTION-CONTEXT>UNSPECIFIED</EXECUTION-CONTEXT>
                <SW-SERVICE-IMPL-POLICY>STANDARD</SW-SERVICE-IMPL-POLICY>
              </BSW-MODULE-ENTRY>
              [!ENDIF!][!//
              <BSW-MODULE-ENTRY>
                <SHORT-NAME>Eth_PreInit</SHORT-NAME>
                <SERVICE-ID>0x21</SERVICE-ID>
                <IS-REENTRANT>false</IS-REENTRANT>
                <IS-SYNCHRONOUS>true</IS-SYNCHRONOUS>
                <CALL-TYPE>REGULAR</CALL-TYPE>
                <EXECUTION-CONTEXT>UNSPECIFIED</EXECUTION-CONTEXT>
                <SW-SERVICE-IMPL-POLICY>STANDARD</SW-SERVICE-IMPL-POLICY>
              </BSW-MODULE-ENTRY>
              <BSW-MODULE-ENTRY>
                <SHORT-NAME>Eth_GetPlatform</SHORT-NAME>
                <SERVICE-ID>0x22</SERVICE-ID>
                <IS-REENTRANT>false</IS-REENTRANT>
                <IS-SYNCHRONOUS>true</IS-SYNCHRONOUS>
                <CALL-TYPE>REGULAR</CALL-TYPE>
                <EXECUTION-CONTEXT>UNSPECIFIED</EXECUTION-CONTEXT>
                <SW-SERVICE-IMPL-POLICY>STANDARD</SW-SERVICE-IMPL-POLICY>
              </BSW-MODULE-ENTRY>
              <BSW-MODULE-ENTRY>
                <SHORT-NAME>Eth_Init</SHORT-NAME>
                <SERVICE-ID>0x01</SERVICE-ID>
                <IS-REENTRANT>false</IS-REENTRANT>
                <IS-SYNCHRONOUS>true</IS-SYNCHRONOUS>
                <CALL-TYPE>REGULAR</CALL-TYPE>
                <EXECUTION-CONTEXT>UNSPECIFIED</EXECUTION-CONTEXT>
                <SW-SERVICE-IMPL-POLICY>STANDARD</SW-SERVICE-IMPL-POLICY>
              </BSW-MODULE-ENTRY>
              <BSW-MODULE-ENTRY>
                <SHORT-NAME>Eth_DeInit</SHORT-NAME>
                <SERVICE-ID>0x2b</SERVICE-ID>
                <IS-REENTRANT>false</IS-REENTRANT>
                <IS-SYNCHRONOUS>true</IS-SYNCHRONOUS>
                <CALL-TYPE>REGULAR</CALL-TYPE>
                <EXECUTION-CONTEXT>UNSPECIFIED</EXECUTION-CONTEXT>
                <SW-SERVICE-IMPL-POLICY>STANDARD</SW-SERVICE-IMPL-POLICY>
              </BSW-MODULE-ENTRY>
              <BSW-MODULE-ENTRY>
                <SHORT-NAME>Eth_MainFunction</SHORT-NAME>
                <SERVICE-ID>0x20</SERVICE-ID>
                <IS-REENTRANT>false</IS-REENTRANT>
                <IS-SYNCHRONOUS>true</IS-SYNCHRONOUS>
                <CALL-TYPE>SCHEDULED</CALL-TYPE>
                <EXECUTION-CONTEXT>TASK</EXECUTION-CONTEXT>
                <SW-SERVICE-IMPL-POLICY>STANDARD</SW-SERVICE-IMPL-POLICY>
              </BSW-MODULE-ENTRY>
              <BSW-MODULE-ENTRY>
                <SHORT-NAME>Eth_ProvideTxBuffer</SHORT-NAME>
                <SERVICE-ID>0x09</SERVICE-ID>
                <IS-REENTRANT>true</IS-REENTRANT>
                <IS-SYNCHRONOUS>true</IS-SYNCHRONOUS>
                <CALL-TYPE>REGULAR</CALL-TYPE>
                <EXECUTION-CONTEXT>UNSPECIFIED</EXECUTION-CONTEXT>
                <SW-SERVICE-IMPL-POLICY>STANDARD</SW-SERVICE-IMPL-POLICY>
              </BSW-MODULE-ENTRY>
              [!IF "EthGeneral/EthVendorSpecific/EthReleaseTxBufferApi = 'true'"!][!//
              <BSW-MODULE-ENTRY>
                <SHORT-NAME>Eth_ReleaseTxBuffer</SHORT-NAME>
                <SERVICE-ID>0x2c</SERVICE-ID>
                <IS-REENTRANT>true</IS-REENTRANT>
                <IS-SYNCHRONOUS>true</IS-SYNCHRONOUS>
                <CALL-TYPE>REGULAR</CALL-TYPE>
                <EXECUTION-CONTEXT>UNSPECIFIED</EXECUTION-CONTEXT>
                <SW-SERVICE-IMPL-POLICY>STANDARD</SW-SERVICE-IMPL-POLICY>
              </BSW-MODULE-ENTRY>
              [!ENDIF!][!//
              [!IF "$AllMiiDisabled = 'false'"!][!//
              <BSW-MODULE-ENTRY>
                <SHORT-NAME>Eth_ReadMii</SHORT-NAME>
                <SERVICE-ID>0x06</SERVICE-ID>
                <IS-REENTRANT>false</IS-REENTRANT>
                <IS-SYNCHRONOUS>false</IS-SYNCHRONOUS>
                <CALL-TYPE>REGULAR</CALL-TYPE>
                <EXECUTION-CONTEXT>UNSPECIFIED</EXECUTION-CONTEXT>
                <SW-SERVICE-IMPL-POLICY>STANDARD</SW-SERVICE-IMPL-POLICY>
              </BSW-MODULE-ENTRY>
              <BSW-MODULE-ENTRY>
                <SHORT-NAME>Eth_WriteMii</SHORT-NAME>
                <SERVICE-ID>0x05</SERVICE-ID>
                <IS-REENTRANT>false</IS-REENTRANT>
                <IS-SYNCHRONOUS>false</IS-SYNCHRONOUS>
                <CALL-TYPE>REGULAR</CALL-TYPE>
                <EXECUTION-CONTEXT>UNSPECIFIED</EXECUTION-CONTEXT>
                <SW-SERVICE-IMPL-POLICY>STANDARD</SW-SERVICE-IMPL-POLICY>
              </BSW-MODULE-ENTRY>
                [!IF "EthGeneral/EthVendorSpecific/EthEnableClause45API = 'true'"!][!//
              <BSW-MODULE-ENTRY>
                <SHORT-NAME>Eth_WriteMii45</SHORT-NAME>
                <SERVICE-ID>0x1e</SERVICE-ID>
                <IS-REENTRANT>false</IS-REENTRANT>
                <IS-SYNCHRONOUS>false</IS-SYNCHRONOUS>
                <CALL-TYPE>REGULAR</CALL-TYPE>
                <EXECUTION-CONTEXT>UNSPECIFIED</EXECUTION-CONTEXT>
                <SW-SERVICE-IMPL-POLICY>STANDARD</SW-SERVICE-IMPL-POLICY>
              </BSW-MODULE-ENTRY>
              <BSW-MODULE-ENTRY>
                <SHORT-NAME>Eth_ReadMii45</SHORT-NAME>
                <SERVICE-ID>0x1f</SERVICE-ID>
                <IS-REENTRANT>false</IS-REENTRANT>
                <IS-SYNCHRONOUS>false</IS-SYNCHRONOUS>
                <CALL-TYPE>REGULAR</CALL-TYPE>
                <EXECUTION-CONTEXT>UNSPECIFIED</EXECUTION-CONTEXT>
                <SW-SERVICE-IMPL-POLICY>STANDARD</SW-SERVICE-IMPL-POLICY>
              </BSW-MODULE-ENTRY>
                [!ENDIF!][!//
              [!ENDIF!][!//
              <BSW-MODULE-ENTRY>
                <SHORT-NAME>Eth_Receive</SHORT-NAME>
                <SERVICE-ID>0xb</SERVICE-ID>
                <IS-REENTRANT>false</IS-REENTRANT>
                <IS-SYNCHRONOUS>true</IS-SYNCHRONOUS>
                <CALL-TYPE>REGULAR</CALL-TYPE>
                <EXECUTION-CONTEXT>UNSPECIFIED</EXECUTION-CONTEXT>
                <SW-SERVICE-IMPL-POLICY>STANDARD</SW-SERVICE-IMPL-POLICY>
              </BSW-MODULE-ENTRY>
              <BSW-MODULE-ENTRY>
                <SHORT-NAME>Eth_SetControllerMode</SHORT-NAME>
                <SERVICE-ID>0x03</SERVICE-ID>
                <IS-REENTRANT>false</IS-REENTRANT>
                <IS-SYNCHRONOUS>false</IS-SYNCHRONOUS>
                <CALL-TYPE>REGULAR</CALL-TYPE>
                <EXECUTION-CONTEXT>UNSPECIFIED</EXECUTION-CONTEXT>
                <SW-SERVICE-IMPL-POLICY>STANDARD</SW-SERVICE-IMPL-POLICY>
              </BSW-MODULE-ENTRY>
              <BSW-MODULE-ENTRY>
                <SHORT-NAME>Eth_SetPhysAddr</SHORT-NAME>
                <SERVICE-ID>0x13</SERVICE-ID>
                <IS-REENTRANT>false</IS-REENTRANT>
                <IS-SYNCHRONOUS>true</IS-SYNCHRONOUS>
                <CALL-TYPE>REGULAR</CALL-TYPE>
                <EXECUTION-CONTEXT>UNSPECIFIED</EXECUTION-CONTEXT>
                <SW-SERVICE-IMPL-POLICY>STANDARD</SW-SERVICE-IMPL-POLICY>
              </BSW-MODULE-ENTRY>
              <BSW-MODULE-ENTRY>
                <SHORT-NAME>Eth_Transmit</SHORT-NAME>
                <SERVICE-ID>0xa</SERVICE-ID>
                <IS-REENTRANT>false</IS-REENTRANT>
                <IS-SYNCHRONOUS>true</IS-SYNCHRONOUS>
                <CALL-TYPE>REGULAR</CALL-TYPE>
                <EXECUTION-CONTEXT>UNSPECIFIED</EXECUTION-CONTEXT>
                <SW-SERVICE-IMPL-POLICY>STANDARD</SW-SERVICE-IMPL-POLICY>
              </BSW-MODULE-ENTRY>
              <BSW-MODULE-ENTRY>
                <SHORT-NAME>Eth_TxConfirmation</SHORT-NAME>
                <SERVICE-ID>0xc</SERVICE-ID>
                <IS-REENTRANT>false</IS-REENTRANT>
                <IS-SYNCHRONOUS>true</IS-SYNCHRONOUS>
                <CALL-TYPE>REGULAR</CALL-TYPE>
                <EXECUTION-CONTEXT>UNSPECIFIED</EXECUTION-CONTEXT>
                <SW-SERVICE-IMPL-POLICY>STANDARD</SW-SERVICE-IMPL-POLICY>
              </BSW-MODULE-ENTRY>
              <BSW-MODULE-ENTRY>
                <SHORT-NAME>Eth_UpdatePhysAddrFilter</SHORT-NAME>
                <SERVICE-ID>0x12</SERVICE-ID>
                <IS-REENTRANT>false</IS-REENTRANT>
                <IS-SYNCHRONOUS>true</IS-SYNCHRONOUS>
                <CALL-TYPE>REGULAR</CALL-TYPE>
                <EXECUTION-CONTEXT>UNSPECIFIED</EXECUTION-CONTEXT>
                <SW-SERVICE-IMPL-POLICY>STANDARD</SW-SERVICE-IMPL-POLICY>
              </BSW-MODULE-ENTRY>
              [!IF "EthGeneral/EthGetPFEStatisticApi = 'true'"!][!//
              <BSW-MODULE-ENTRY>
                <SHORT-NAME>Eth_GetBmuStats</SHORT-NAME>
                <SERVICE-ID>0x24</SERVICE-ID>
                <IS-REENTRANT>false</IS-REENTRANT>
                <IS-SYNCHRONOUS>true</IS-SYNCHRONOUS>
                <CALL-TYPE>REGULAR</CALL-TYPE>
                <EXECUTION-CONTEXT>UNSPECIFIED</EXECUTION-CONTEXT>
                <SW-SERVICE-IMPL-POLICY>STANDARD</SW-SERVICE-IMPL-POLICY>
              </BSW-MODULE-ENTRY>
              <BSW-MODULE-ENTRY>
                <SHORT-NAME>Eth_GetGpiStats</SHORT-NAME>
                <SERVICE-ID>0x25</SERVICE-ID>
                <IS-REENTRANT>false</IS-REENTRANT>
                <IS-SYNCHRONOUS>true</IS-SYNCHRONOUS>
                <CALL-TYPE>REGULAR</CALL-TYPE>
                <EXECUTION-CONTEXT>UNSPECIFIED</EXECUTION-CONTEXT>
                <SW-SERVICE-IMPL-POLICY>STANDARD</SW-SERVICE-IMPL-POLICY>
              </BSW-MODULE-ENTRY>
              <BSW-MODULE-ENTRY>
                <SHORT-NAME>Eth_GetL2BridgeStats</SHORT-NAME>
                <SERVICE-ID>0x26</SERVICE-ID>
                <IS-REENTRANT>false</IS-REENTRANT>
                <IS-SYNCHRONOUS>true</IS-SYNCHRONOUS>
                <CALL-TYPE>REGULAR</CALL-TYPE>
                <EXECUTION-CONTEXT>UNSPECIFIED</EXECUTION-CONTEXT>
                <SW-SERVICE-IMPL-POLICY>STANDARD</SW-SERVICE-IMPL-POLICY>
              </BSW-MODULE-ENTRY>
              <BSW-MODULE-ENTRY>
                <SHORT-NAME>Eth_GetL2BridgeDomainStats</SHORT-NAME>
                <SERVICE-ID>0x27</SERVICE-ID>
                <IS-REENTRANT>false</IS-REENTRANT>
                <IS-SYNCHRONOUS>true</IS-SYNCHRONOUS>
                <CALL-TYPE>REGULAR</CALL-TYPE>
                <EXECUTION-CONTEXT>UNSPECIFIED</EXECUTION-CONTEXT>
                <SW-SERVICE-IMPL-POLICY>STANDARD</SW-SERVICE-IMPL-POLICY>
              </BSW-MODULE-ENTRY>
              <BSW-MODULE-ENTRY>
                <SHORT-NAME>Eth_GetWdtStats</SHORT-NAME>
                <SERVICE-ID>0x28</SERVICE-ID>
                <IS-REENTRANT>false</IS-REENTRANT>
                <IS-SYNCHRONOUS>true</IS-SYNCHRONOUS>
                <CALL-TYPE>REGULAR</CALL-TYPE>
                <EXECUTION-CONTEXT>UNSPECIFIED</EXECUTION-CONTEXT>
                <SW-SERVICE-IMPL-POLICY>STANDARD</SW-SERVICE-IMPL-POLICY>
              </BSW-MODULE-ENTRY>
              <BSW-MODULE-ENTRY>
                <SHORT-NAME>Eth_GetRtableStats</SHORT-NAME>
                <SERVICE-ID>0x29</SERVICE-ID>
                <IS-REENTRANT>false</IS-REENTRANT>
                <IS-SYNCHRONOUS>true</IS-SYNCHRONOUS>
                <CALL-TYPE>REGULAR</CALL-TYPE>
                <EXECUTION-CONTEXT>UNSPECIFIED</EXECUTION-CONTEXT>
                <SW-SERVICE-IMPL-POLICY>STANDARD</SW-SERVICE-IMPL-POLICY>
              </BSW-MODULE-ENTRY>
              <BSW-MODULE-ENTRY>
                <SHORT-NAME>Eth_GetTmuStats</SHORT-NAME>
                <SERVICE-ID>0x2a</SERVICE-ID>
                <IS-REENTRANT>false</IS-REENTRANT>
                <IS-SYNCHRONOUS>true</IS-SYNCHRONOUS>
                <CALL-TYPE>REGULAR</CALL-TYPE>
                <EXECUTION-CONTEXT>UNSPECIFIED</EXECUTION-CONTEXT>
                <SW-SERVICE-IMPL-POLICY>STANDARD</SW-SERVICE-IMPL-POLICY>
              </BSW-MODULE-ENTRY>
              [!ENDIF!][!//
              [!IF "EthGeneral/EthVendorSpecific/PfeChannelBdFlushApi = 'true'"!][!//
              <BSW-MODULE-ENTRY>
                <SHORT-NAME>Eth_ChannelBdFlushRx</SHORT-NAME>
                <SERVICE-ID>0x48</SERVICE-ID>
                <IS-REENTRANT>false</IS-REENTRANT>
                <IS-SYNCHRONOUS>true</IS-SYNCHRONOUS>
                <CALL-TYPE>REGULAR</CALL-TYPE>
                <EXECUTION-CONTEXT>UNSPECIFIED</EXECUTION-CONTEXT>
                <SW-SERVICE-IMPL-POLICY>STANDARD</SW-SERVICE-IMPL-POLICY>
              </BSW-MODULE-ENTRY>
              [!ENDIF!][!//
              <BSW-MODULE-ENTRY>
                <SHORT-NAME>Eth_HifIrqHdlr_0</SHORT-NAME>
                <SERVICE-ID>0</SERVICE-ID>
                <IS-REENTRANT>false</IS-REENTRANT>
                <IS-SYNCHRONOUS>true</IS-SYNCHRONOUS>
                <CALL-TYPE>INTERRUPT</CALL-TYPE>
                <EXECUTION-CONTEXT>INTERRUPT-CAT-2</EXECUTION-CONTEXT>
                <SW-SERVICE-IMPL-POLICY>STANDARD</SW-SERVICE-IMPL-POLICY>
              </BSW-MODULE-ENTRY>
              <BSW-MODULE-ENTRY>
                <SHORT-NAME>Eth_HifIrqHdlr_1</SHORT-NAME>
                <SERVICE-ID>0</SERVICE-ID>
                <IS-REENTRANT>false</IS-REENTRANT>
                <IS-SYNCHRONOUS>true</IS-SYNCHRONOUS>
                <CALL-TYPE>INTERRUPT</CALL-TYPE>
                <EXECUTION-CONTEXT>INTERRUPT-CAT-2</EXECUTION-CONTEXT>
                <SW-SERVICE-IMPL-POLICY>STANDARD</SW-SERVICE-IMPL-POLICY>
              </BSW-MODULE-ENTRY>
              <BSW-MODULE-ENTRY>
                <SHORT-NAME>Eth_HifIrqHdlr_2</SHORT-NAME>
                <SERVICE-ID>0</SERVICE-ID>
                <IS-REENTRANT>false</IS-REENTRANT>
                <IS-SYNCHRONOUS>true</IS-SYNCHRONOUS>
                <CALL-TYPE>INTERRUPT</CALL-TYPE>
                <EXECUTION-CONTEXT>INTERRUPT-CAT-2</EXECUTION-CONTEXT>
                <SW-SERVICE-IMPL-POLICY>STANDARD</SW-SERVICE-IMPL-POLICY>
              </BSW-MODULE-ENTRY>
              <BSW-MODULE-ENTRY>
                <SHORT-NAME>Eth_HifIrqHdlr_3</SHORT-NAME>
                <SERVICE-ID>0</SERVICE-ID>
                <IS-REENTRANT>false</IS-REENTRANT>
                <IS-SYNCHRONOUS>true</IS-SYNCHRONOUS>
                <CALL-TYPE>INTERRUPT</CALL-TYPE>
                <EXECUTION-CONTEXT>INTERRUPT-CAT-2</EXECUTION-CONTEXT>
                <SW-SERVICE-IMPL-POLICY>STANDARD</SW-SERVICE-IMPL-POLICY>
              </BSW-MODULE-ENTRY>
              <BSW-MODULE-ENTRY>
                <SHORT-NAME>Eth_HifNoCpyIrqHdlr</SHORT-NAME>
                <SERVICE-ID>0</SERVICE-ID>
                <IS-REENTRANT>false</IS-REENTRANT>
                <IS-SYNCHRONOUS>true</IS-SYNCHRONOUS>
                <CALL-TYPE>INTERRUPT</CALL-TYPE>
                <EXECUTION-CONTEXT>INTERRUPT-CAT-2</EXECUTION-CONTEXT>
                <SW-SERVICE-IMPL-POLICY>STANDARD</SW-SERVICE-IMPL-POLICY>
              </BSW-MODULE-ENTRY>
              <BSW-MODULE-ENTRY>
                <SHORT-NAME>Eth_BmuIrqHdlr</SHORT-NAME>
                <SERVICE-ID>0</SERVICE-ID>
                <IS-REENTRANT>false</IS-REENTRANT>
                <IS-SYNCHRONOUS>true</IS-SYNCHRONOUS>
                <CALL-TYPE>INTERRUPT</CALL-TYPE>
                <EXECUTION-CONTEXT>INTERRUPT-CAT-2</EXECUTION-CONTEXT>
                <SW-SERVICE-IMPL-POLICY>STANDARD</SW-SERVICE-IMPL-POLICY>
              </BSW-MODULE-ENTRY>
              [!IF "EthGeneral/EthVendorSpecific/PfeEnableFCI = 'true'"!][!//
              <BSW-MODULE-ENTRY>
                <SHORT-NAME>fci_open</SHORT-NAME>
                <SERVICE-ID>0x40</SERVICE-ID>
                <IS-REENTRANT>false</IS-REENTRANT>
                <IS-SYNCHRONOUS>true</IS-SYNCHRONOUS>
                <CALL-TYPE>REGULAR</CALL-TYPE>
                <EXECUTION-CONTEXT>UNSPECIFIED</EXECUTION-CONTEXT>
                <SW-SERVICE-IMPL-POLICY>STANDARD</SW-SERVICE-IMPL-POLICY>
              </BSW-MODULE-ENTRY>
              <BSW-MODULE-ENTRY>
                <SHORT-NAME>fci_close</SHORT-NAME>
                <SERVICE-ID>0x41</SERVICE-ID>
                <IS-REENTRANT>false</IS-REENTRANT>
                <IS-SYNCHRONOUS>true</IS-SYNCHRONOUS>
                <CALL-TYPE>REGULAR</CALL-TYPE>
                <EXECUTION-CONTEXT>UNSPECIFIED</EXECUTION-CONTEXT>
                <SW-SERVICE-IMPL-POLICY>STANDARD</SW-SERVICE-IMPL-POLICY>
              </BSW-MODULE-ENTRY>
              <BSW-MODULE-ENTRY>
                <SHORT-NAME>fci_catch</SHORT-NAME>
                <SERVICE-ID>0x42</SERVICE-ID>
                <IS-REENTRANT>false</IS-REENTRANT>
                <IS-SYNCHRONOUS>true</IS-SYNCHRONOUS>
                <CALL-TYPE>REGULAR</CALL-TYPE>
                <EXECUTION-CONTEXT>UNSPECIFIED</EXECUTION-CONTEXT>
                <SW-SERVICE-IMPL-POLICY>STANDARD</SW-SERVICE-IMPL-POLICY>
              </BSW-MODULE-ENTRY>
              <BSW-MODULE-ENTRY>
                <SHORT-NAME>fci_cmd</SHORT-NAME>
                <SERVICE-ID>0x43</SERVICE-ID>
                <IS-REENTRANT>true</IS-REENTRANT>
                <IS-SYNCHRONOUS>true</IS-SYNCHRONOUS>
                <CALL-TYPE>REGULAR</CALL-TYPE>
                <EXECUTION-CONTEXT>UNSPECIFIED</EXECUTION-CONTEXT>
                <SW-SERVICE-IMPL-POLICY>STANDARD</SW-SERVICE-IMPL-POLICY>
              </BSW-MODULE-ENTRY>
              <BSW-MODULE-ENTRY>
                <SHORT-NAME>fci_query</SHORT-NAME>
                <SERVICE-ID>0x44</SERVICE-ID>
                <IS-REENTRANT>true</IS-REENTRANT>
                <IS-SYNCHRONOUS>true</IS-SYNCHRONOUS>
                <CALL-TYPE>REGULAR</CALL-TYPE>
                <EXECUTION-CONTEXT>UNSPECIFIED</EXECUTION-CONTEXT>
                <SW-SERVICE-IMPL-POLICY>STANDARD</SW-SERVICE-IMPL-POLICY>
              </BSW-MODULE-ENTRY>
              <BSW-MODULE-ENTRY>
                <SHORT-NAME>fci_write</SHORT-NAME>
                <SERVICE-ID>0x45</SERVICE-ID>
                <IS-REENTRANT>true</IS-REENTRANT>
                <IS-SYNCHRONOUS>true</IS-SYNCHRONOUS>
                <CALL-TYPE>REGULAR</CALL-TYPE>
                <EXECUTION-CONTEXT>UNSPECIFIED</EXECUTION-CONTEXT>
                <SW-SERVICE-IMPL-POLICY>STANDARD</SW-SERVICE-IMPL-POLICY>
              </BSW-MODULE-ENTRY>
              <BSW-MODULE-ENTRY>
                <SHORT-NAME>fci_register_cb</SHORT-NAME>
                <SERVICE-ID>0x46</SERVICE-ID>
                <IS-REENTRANT>false</IS-REENTRANT>
                <IS-SYNCHRONOUS>true</IS-SYNCHRONOUS>
                <CALL-TYPE>REGULAR</CALL-TYPE>
                <EXECUTION-CONTEXT>UNSPECIFIED</EXECUTION-CONTEXT>
                <SW-SERVICE-IMPL-POLICY>STANDARD</SW-SERVICE-IMPL-POLICY>
              </BSW-MODULE-ENTRY>
              <BSW-MODULE-ENTRY>
                <SHORT-NAME>fci_fd</SHORT-NAME>
                <SERVICE-ID>0x47</SERVICE-ID>
                <IS-REENTRANT>false</IS-REENTRANT>
                <IS-SYNCHRONOUS>true</IS-SYNCHRONOUS>
                <CALL-TYPE>REGULAR</CALL-TYPE>
                <EXECUTION-CONTEXT>UNSPECIFIED</EXECUTION-CONTEXT>
                <SW-SERVICE-IMPL-POLICY>STANDARD</SW-SERVICE-IMPL-POLICY>
              </BSW-MODULE-ENTRY>
              [!ENDIF!][!//
          </ELEMENTS>
        </AR-PACKAGE>
      </AR-PACKAGES>
    </AR-PACKAGE>
    <AR-PACKAGE>
      <SHORT-NAME>Eth_43_PFE_TS_T40D11M14I0R0</SHORT-NAME>
      <AR-PACKAGES>
        <AR-PACKAGE>
        <SHORT-NAME>Implementations</SHORT-NAME>
          <ELEMENTS>
            <BSW-IMPLEMENTATION>
              <SHORT-NAME>BswImplementation_0</SHORT-NAME>

              <CODE-DESCRIPTORS>
                <CODE>
                <SHORT-NAME>Files</SHORT-NAME>
                <ARTIFACT-DESCRIPTORS>
                  <AUTOSAR-ENGINEERING-OBJECT>
                    <SHORT-LABEL>config::Eth_43_PFE.xdm</SHORT-LABEL>
                    <CATEGORY>SWCFG</CATEGORY>
                  </AUTOSAR-ENGINEERING-OBJECT>
                  <AUTOSAR-ENGINEERING-OBJECT>
                    <SHORT-LABEL>doc::AUTOSAR_MCAL_ETH_43_PFE_UM.pdf</SHORT-LABEL>
                    <CATEGORY>SWDOC</CATEGORY>
                  </AUTOSAR-ENGINEERING-OBJECT>
                  <AUTOSAR-ENGINEERING-OBJECT>
                    <SHORT-LABEL>doc::AUTOSAR_MCAL_ETH_43_PFE_IM.pdf</SHORT-LABEL>
                    <CATEGORY>SWDOC</CATEGORY>
                  </AUTOSAR-ENGINEERING-OBJECT>
                  <AUTOSAR-ENGINEERING-OBJECT>
                    <SHORT-LABEL>include::autolibc.h</SHORT-LABEL>
                    <CATEGORY>SWHDR</CATEGORY>
                  </AUTOSAR-ENGINEERING-OBJECT>
                  <AUTOSAR-ENGINEERING-OBJECT>
                    <SHORT-LABEL>include::blalloc.h</SHORT-LABEL>
                    <CATEGORY>SWHDR</CATEGORY>
                  </AUTOSAR-ENGINEERING-OBJECT>
                  <AUTOSAR-ENGINEERING-OBJECT>
                    <SHORT-LABEL>include::ct_assert.h</SHORT-LABEL>
                    <CATEGORY>SWHDR</CATEGORY>
                  </AUTOSAR-ENGINEERING-OBJECT>
                  <AUTOSAR-ENGINEERING-OBJECT>
                    <SHORT-LABEL>include::elf.h</SHORT-LABEL>
                    <CATEGORY>SWHDR</CATEGORY>
                  </AUTOSAR-ENGINEERING-OBJECT>
                  <AUTOSAR-ENGINEERING-OBJECT>
                    <SHORT-LABEL>include::elf_cfg.h</SHORT-LABEL>
                    <CATEGORY>SWHDR</CATEGORY>
                  </AUTOSAR-ENGINEERING-OBJECT>
                  <AUTOSAR-ENGINEERING-OBJECT>
                    <SHORT-LABEL>include::Eth_43_PFE.h</SHORT-LABEL>
                    <CATEGORY>SWHDR</CATEGORY>
                  </AUTOSAR-ENGINEERING-OBJECT>
                  <AUTOSAR-ENGINEERING-OBJECT>
                    <SHORT-LABEL>include::Eth_43_PFE_Irq.h</SHORT-LABEL>
                    <CATEGORY>SWHDR</CATEGORY>
                  </AUTOSAR-ENGINEERING-OBJECT>  
                  <AUTOSAR-ENGINEERING-OBJECT>
                    <SHORT-LABEL>include::Eth_PFE_LLD.h</SHORT-LABEL>
                    <CATEGORY>SWHDR</CATEGORY>
                  </AUTOSAR-ENGINEERING-OBJECT>
                  <AUTOSAR-ENGINEERING-OBJECT>
                    <SHORT-LABEL>include::fci.h</SHORT-LABEL>
                    <CATEGORY>SWHDR</CATEGORY>
                  </AUTOSAR-ENGINEERING-OBJECT>
                  <AUTOSAR-ENGINEERING-OBJECT>
                    <SHORT-LABEL>include::fci_core.h</SHORT-LABEL>
                    <CATEGORY>SWHDR</CATEGORY>
                  </AUTOSAR-ENGINEERING-OBJECT>
                  <AUTOSAR-ENGINEERING-OBJECT>
                    <SHORT-LABEL>include::fci_fp.h</SHORT-LABEL>
                    <CATEGORY>SWHDR</CATEGORY>
                  </AUTOSAR-ENGINEERING-OBJECT>  
                  <AUTOSAR-ENGINEERING-OBJECT>
                    <SHORT-LABEL>include::fci_fp_db.h</SHORT-LABEL>
                    <CATEGORY>SWHDR</CATEGORY>
                  </AUTOSAR-ENGINEERING-OBJECT>
                  <AUTOSAR-ENGINEERING-OBJECT>
                    <SHORT-LABEL>include::fci_fw_features.h</SHORT-LABEL>
                    <CATEGORY>SWHDR</CATEGORY>
                  </AUTOSAR-ENGINEERING-OBJECT>
                  <AUTOSAR-ENGINEERING-OBJECT>
                    <SHORT-LABEL>include::fci_internal.h</SHORT-LABEL>
                    <CATEGORY>SWHDR</CATEGORY>
                  </AUTOSAR-ENGINEERING-OBJECT>
                  <AUTOSAR-ENGINEERING-OBJECT>
                    <SHORT-LABEL>include::fci_mirror.h</SHORT-LABEL>
                    <CATEGORY>SWHDR</CATEGORY>
                  </AUTOSAR-ENGINEERING-OBJECT>
                  <AUTOSAR-ENGINEERING-OBJECT>
                    <SHORT-LABEL>include::fci_msg.h</SHORT-LABEL>
                    <CATEGORY>SWHDR</CATEGORY>
                  </AUTOSAR-ENGINEERING-OBJECT>
                  <AUTOSAR-ENGINEERING-OBJECT>
                    <SHORT-LABEL>include::fci_msg_autosar.h</SHORT-LABEL>
                    <CATEGORY>SWHDR</CATEGORY>
                  </AUTOSAR-ENGINEERING-OBJECT>
                  <AUTOSAR-ENGINEERING-OBJECT>
                    <SHORT-LABEL>include::fci_rt_db.h</SHORT-LABEL>
                    <CATEGORY>SWHDR</CATEGORY>
                  </AUTOSAR-ENGINEERING-OBJECT>
                  <AUTOSAR-ENGINEERING-OBJECT>
                    <SHORT-LABEL>include::fifo.h</SHORT-LABEL>
                    <CATEGORY>SWHDR</CATEGORY>
                  </AUTOSAR-ENGINEERING-OBJECT>
                  <AUTOSAR-ENGINEERING-OBJECT>
                    <SHORT-LABEL>include::fpp.h</SHORT-LABEL>
                    <CATEGORY>SWHDR</CATEGORY>
                  </AUTOSAR-ENGINEERING-OBJECT>
                  <AUTOSAR-ENGINEERING-OBJECT>
                    <SHORT-LABEL>include::fpp_ext.h</SHORT-LABEL>
                    <CATEGORY>SWHDR</CATEGORY>
                  </AUTOSAR-ENGINEERING-OBJECT>
                  <AUTOSAR-ENGINEERING-OBJECT>
                    <SHORT-LABEL>include::hal.h</SHORT-LABEL>
                    <CATEGORY>SWHDR</CATEGORY>
                  </AUTOSAR-ENGINEERING-OBJECT>
                  <AUTOSAR-ENGINEERING-OBJECT>
                    <SHORT-LABEL>include::libfci.h</SHORT-LABEL>
                    <CATEGORY>SWHDR</CATEGORY>
                  </AUTOSAR-ENGINEERING-OBJECT>
                  <AUTOSAR-ENGINEERING-OBJECT>
                    <SHORT-LABEL>include::linked_list.h</SHORT-LABEL>
                    <CATEGORY>SWHDR</CATEGORY>
                  </AUTOSAR-ENGINEERING-OBJECT>
                  <AUTOSAR-ENGINEERING-OBJECT>
                    <SHORT-LABEL>include::nxp_snprintf.h</SHORT-LABEL>
                    <CATEGORY>SWHDR</CATEGORY>
                  </AUTOSAR-ENGINEERING-OBJECT>
                  <AUTOSAR-ENGINEERING-OBJECT>
                    <SHORT-LABEL>include::nxp_snprintf_cfg.h</SHORT-LABEL>
                    <CATEGORY>SWHDR</CATEGORY>
                  </AUTOSAR-ENGINEERING-OBJECT>
                  <AUTOSAR-ENGINEERING-OBJECT>
                    <SHORT-LABEL>include::oal.h</SHORT-LABEL>
                    <CATEGORY>SWHDR</CATEGORY>
                  </AUTOSAR-ENGINEERING-OBJECT>
                  <AUTOSAR-ENGINEERING-OBJECT>
                    <SHORT-LABEL>include::oal_irq.h</SHORT-LABEL>
                    <CATEGORY>SWHDR</CATEGORY>
                  </AUTOSAR-ENGINEERING-OBJECT>
                  <AUTOSAR-ENGINEERING-OBJECT>
                    <SHORT-LABEL>include::oal_irq_autosar.h</SHORT-LABEL>
                    <CATEGORY>SWHDR</CATEGORY>
                  </AUTOSAR-ENGINEERING-OBJECT>
                  <AUTOSAR-ENGINEERING-OBJECT>
                    <SHORT-LABEL>include::oal_job.h</SHORT-LABEL>
                    <CATEGORY>SWHDR</CATEGORY>
                  </AUTOSAR-ENGINEERING-OBJECT>
                  <AUTOSAR-ENGINEERING-OBJECT>
                    <SHORT-LABEL>include::oal_mm.h</SHORT-LABEL>
                    <CATEGORY>SWHDR</CATEGORY>
                  </AUTOSAR-ENGINEERING-OBJECT>
                  <AUTOSAR-ENGINEERING-OBJECT>
                    <SHORT-LABEL>include::oal_mutex_autosar.h</SHORT-LABEL>
                    <CATEGORY>SWHDR</CATEGORY>
                  </AUTOSAR-ENGINEERING-OBJECT>
                  <AUTOSAR-ENGINEERING-OBJECT>
                    <SHORT-LABEL>include::oal_sync.h</SHORT-LABEL>
                    <CATEGORY>SWHDR</CATEGORY>
                  </AUTOSAR-ENGINEERING-OBJECT>
                  <AUTOSAR-ENGINEERING-OBJECT>
                    <SHORT-LABEL>include::oal_time.h</SHORT-LABEL>
                    <CATEGORY>SWHDR</CATEGORY>
                  </AUTOSAR-ENGINEERING-OBJECT>
                  <AUTOSAR-ENGINEERING-OBJECT>
                    <SHORT-LABEL>include::oal_types.h</SHORT-LABEL>
                    <CATEGORY>SWHDR</CATEGORY>
                  </AUTOSAR-ENGINEERING-OBJECT>
                  <AUTOSAR-ENGINEERING-OBJECT>
                    <SHORT-LABEL>include::oal_types_autosar.h</SHORT-LABEL>
                    <CATEGORY>SWHDR</CATEGORY>
                  </AUTOSAR-ENGINEERING-OBJECT>
                  <AUTOSAR-ENGINEERING-OBJECT>
                    <SHORT-LABEL>include::oal_util.h</SHORT-LABEL>
                    <CATEGORY>SWHDR</CATEGORY>
                  </AUTOSAR-ENGINEERING-OBJECT>
                  <AUTOSAR-ENGINEERING-OBJECT>
                    <SHORT-LABEL>include::oal_util_autosar.h</SHORT-LABEL>
                    <CATEGORY>SWHDR</CATEGORY>
                  </AUTOSAR-ENGINEERING-OBJECT>
                  <AUTOSAR-ENGINEERING-OBJECT>
                    <SHORT-LABEL>include::oal_util_net.h</SHORT-LABEL>
                    <CATEGORY>SWHDR</CATEGORY>
                  </AUTOSAR-ENGINEERING-OBJECT>
                  <AUTOSAR-ENGINEERING-OBJECT>
                    <SHORT-LABEL>include::oal_util_net_autosar.h</SHORT-LABEL>
                    <CATEGORY>SWHDR</CATEGORY>
                  </AUTOSAR-ENGINEERING-OBJECT>
                  <AUTOSAR-ENGINEERING-OBJECT>
                    <SHORT-LABEL>include::pfe_bmu.h</SHORT-LABEL>
                    <CATEGORY>SWHDR</CATEGORY>
                  </AUTOSAR-ENGINEERING-OBJECT>
                  <AUTOSAR-ENGINEERING-OBJECT>
                    <SHORT-LABEL>include::pfe_bmu_csr.h</SHORT-LABEL>
                    <CATEGORY>SWHDR</CATEGORY>
                  </AUTOSAR-ENGINEERING-OBJECT>
                  <AUTOSAR-ENGINEERING-OBJECT>
                    <SHORT-LABEL>include::pfe_bus_err.h</SHORT-LABEL>
                    <CATEGORY>SWHDR</CATEGORY>
                  </AUTOSAR-ENGINEERING-OBJECT>
                  <AUTOSAR-ENGINEERING-OBJECT>
                    <SHORT-LABEL>include::pfe_bus_err_csr.h</SHORT-LABEL>
                    <CATEGORY>SWHDR</CATEGORY>
                  </AUTOSAR-ENGINEERING-OBJECT>
                  <AUTOSAR-ENGINEERING-OBJECT>
                    <SHORT-LABEL>include::pfe_cbus.h</SHORT-LABEL>
                    <CATEGORY>SWHDR</CATEGORY>
                  </AUTOSAR-ENGINEERING-OBJECT>
                  <AUTOSAR-ENGINEERING-OBJECT>
                    <SHORT-LABEL>include::pfe_class.h</SHORT-LABEL>
                    <CATEGORY>SWHDR</CATEGORY>
                  </AUTOSAR-ENGINEERING-OBJECT>
                  <AUTOSAR-ENGINEERING-OBJECT>
                    <SHORT-LABEL>include::pfe_class_csr.h</SHORT-LABEL>
                    <CATEGORY>SWHDR</CATEGORY>
                  </AUTOSAR-ENGINEERING-OBJECT>
                  <AUTOSAR-ENGINEERING-OBJECT>
                    <SHORT-LABEL>include::pfe_compiler.h</SHORT-LABEL>
                    <CATEGORY>SWHDR</CATEGORY>
                  </AUTOSAR-ENGINEERING-OBJECT>
                  <AUTOSAR-ENGINEERING-OBJECT>
                    <SHORT-LABEL>include::pfe_ct.h</SHORT-LABEL>
                    <CATEGORY>SWHDR</CATEGORY>
                  </AUTOSAR-ENGINEERING-OBJECT>
                  <AUTOSAR-ENGINEERING-OBJECT>
                    <SHORT-LABEL>include::pfe_ecc_err.h</SHORT-LABEL>
                    <CATEGORY>SWHDR</CATEGORY>
                  </AUTOSAR-ENGINEERING-OBJECT>
                  <AUTOSAR-ENGINEERING-OBJECT>
                    <SHORT-LABEL>include::pfe_ecc_err_csr.h</SHORT-LABEL>
                    <CATEGORY>SWHDR</CATEGORY>
                  </AUTOSAR-ENGINEERING-OBJECT>
                  <AUTOSAR-ENGINEERING-OBJECT>
                    <SHORT-LABEL>include::pfe_emac.h</SHORT-LABEL>
                    <CATEGORY>SWHDR</CATEGORY>
                  </AUTOSAR-ENGINEERING-OBJECT>
                  <AUTOSAR-ENGINEERING-OBJECT>
                    <SHORT-LABEL>include::pfe_emac_csr.h</SHORT-LABEL>
                    <CATEGORY>SWHDR</CATEGORY>
                  </AUTOSAR-ENGINEERING-OBJECT>
                  <AUTOSAR-ENGINEERING-OBJECT>
                    <SHORT-LABEL>include::pfe_fail_stop.h</SHORT-LABEL>
                    <CATEGORY>SWHDR</CATEGORY>
                  </AUTOSAR-ENGINEERING-OBJECT>
                  <AUTOSAR-ENGINEERING-OBJECT>
                    <SHORT-LABEL>include::pfe_fail_stop_csr.h</SHORT-LABEL>
                    <CATEGORY>SWHDR</CATEGORY>
                  </AUTOSAR-ENGINEERING-OBJECT>
                  <AUTOSAR-ENGINEERING-OBJECT>
                    <SHORT-LABEL>include::pfe_feature_mgr.h</SHORT-LABEL>
                    <CATEGORY>SWHDR</CATEGORY>
                  </AUTOSAR-ENGINEERING-OBJECT>
                  <AUTOSAR-ENGINEERING-OBJECT>
                    <SHORT-LABEL>include::pfe_fp.h</SHORT-LABEL>
                    <CATEGORY>SWHDR</CATEGORY>
                  </AUTOSAR-ENGINEERING-OBJECT>
                  <AUTOSAR-ENGINEERING-OBJECT>
                    <SHORT-LABEL>include::pfe_fw_fail_stop.h</SHORT-LABEL>
                    <CATEGORY>SWHDR</CATEGORY>
                  </AUTOSAR-ENGINEERING-OBJECT>
                  <AUTOSAR-ENGINEERING-OBJECT>
                    <SHORT-LABEL>include::pfe_fw_fail_stop_csr.h</SHORT-LABEL>
                    <CATEGORY>SWHDR</CATEGORY>
                  </AUTOSAR-ENGINEERING-OBJECT>
                  <AUTOSAR-ENGINEERING-OBJECT>
                    <SHORT-LABEL>include::pfe_fw_feature.h</SHORT-LABEL>
                    <CATEGORY>SWHDR</CATEGORY>
                  </AUTOSAR-ENGINEERING-OBJECT>
                  <AUTOSAR-ENGINEERING-OBJECT>
                    <SHORT-LABEL>include::pfe_global_wsp.h</SHORT-LABEL>
                    <CATEGORY>SWHDR</CATEGORY>
                  </AUTOSAR-ENGINEERING-OBJECT>
                  <AUTOSAR-ENGINEERING-OBJECT>
                    <SHORT-LABEL>include::pfe_gpi.h</SHORT-LABEL>
                    <CATEGORY>SWHDR</CATEGORY>
                  </AUTOSAR-ENGINEERING-OBJECT>
                  <AUTOSAR-ENGINEERING-OBJECT>
                    <SHORT-LABEL>include::pfe_gpi_csr.h</SHORT-LABEL>
                    <CATEGORY>SWHDR</CATEGORY>
                  </AUTOSAR-ENGINEERING-OBJECT>
                  <AUTOSAR-ENGINEERING-OBJECT>
                    <SHORT-LABEL>include::pfe_hif.h</SHORT-LABEL>
                    <CATEGORY>SWHDR</CATEGORY>
                  </AUTOSAR-ENGINEERING-OBJECT>
                  <AUTOSAR-ENGINEERING-OBJECT>
                    <SHORT-LABEL>include::pfe_hif_chnl.h</SHORT-LABEL>
                    <CATEGORY>SWHDR</CATEGORY>
                  </AUTOSAR-ENGINEERING-OBJECT>
                  <AUTOSAR-ENGINEERING-OBJECT>
                    <SHORT-LABEL>include::pfe_hif_csr.h</SHORT-LABEL>
                    <CATEGORY>SWHDR</CATEGORY>
                  </AUTOSAR-ENGINEERING-OBJECT>
                  <AUTOSAR-ENGINEERING-OBJECT>
                    <SHORT-LABEL>include::pfe_hif_drv.h</SHORT-LABEL>
                    <CATEGORY>SWHDR</CATEGORY>
                  </AUTOSAR-ENGINEERING-OBJECT>
                  <AUTOSAR-ENGINEERING-OBJECT>
                    <SHORT-LABEL>include::pfe_hif_nocpy.h</SHORT-LABEL>
                    <CATEGORY>SWHDR</CATEGORY>
                  </AUTOSAR-ENGINEERING-OBJECT>
                  <AUTOSAR-ENGINEERING-OBJECT>
                    <SHORT-LABEL>include::pfe_hif_nocpy_csr.h</SHORT-LABEL>
                    <CATEGORY>SWHDR</CATEGORY>
                  </AUTOSAR-ENGINEERING-OBJECT>
                  <AUTOSAR-ENGINEERING-OBJECT>
                    <SHORT-LABEL>include::pfe_hif_ptp.h</SHORT-LABEL>
                    <CATEGORY>SWHDR</CATEGORY>
                  </AUTOSAR-ENGINEERING-OBJECT>
                  <AUTOSAR-ENGINEERING-OBJECT>
                    <SHORT-LABEL>include::pfe_hif_ring.h</SHORT-LABEL>
                    <CATEGORY>SWHDR</CATEGORY>
                  </AUTOSAR-ENGINEERING-OBJECT>
                  <AUTOSAR-ENGINEERING-OBJECT>
                    <SHORT-LABEL>include::pfe_hm.h</SHORT-LABEL>
                    <CATEGORY>SWHDR</CATEGORY>
                  </AUTOSAR-ENGINEERING-OBJECT>
                  <AUTOSAR-ENGINEERING-OBJECT>
                    <SHORT-LABEL>include::pfe_host_fail_stop.h</SHORT-LABEL>
                    <CATEGORY>SWHDR</CATEGORY>
                  </AUTOSAR-ENGINEERING-OBJECT>
                  <AUTOSAR-ENGINEERING-OBJECT>
                    <SHORT-LABEL>include::pfe_host_fail_stop_csr.h</SHORT-LABEL>
                    <CATEGORY>SWHDR</CATEGORY>
                  </AUTOSAR-ENGINEERING-OBJECT>
                  <AUTOSAR-ENGINEERING-OBJECT>
                    <SHORT-LABEL>include::pfe_hw_feature.h</SHORT-LABEL>
                    <CATEGORY>SWHDR</CATEGORY>
                  </AUTOSAR-ENGINEERING-OBJECT>
                  <AUTOSAR-ENGINEERING-OBJECT>
                    <SHORT-LABEL>include::pfe_idex.h</SHORT-LABEL>
                    <CATEGORY>SWHDR</CATEGORY>
                  </AUTOSAR-ENGINEERING-OBJECT>
                  <AUTOSAR-ENGINEERING-OBJECT>
                    <SHORT-LABEL>include::pfe_if_db.h</SHORT-LABEL>
                    <CATEGORY>SWHDR</CATEGORY>
                  </AUTOSAR-ENGINEERING-OBJECT>
                  <AUTOSAR-ENGINEERING-OBJECT>
                    <SHORT-LABEL>include::pfe_l2br.h</SHORT-LABEL>
                    <CATEGORY>SWHDR</CATEGORY>
                  </AUTOSAR-ENGINEERING-OBJECT>
                  <AUTOSAR-ENGINEERING-OBJECT>
                    <SHORT-LABEL>include::pfe_l2br_table.h</SHORT-LABEL>
                    <CATEGORY>SWHDR</CATEGORY>
                  </AUTOSAR-ENGINEERING-OBJECT>
                  <AUTOSAR-ENGINEERING-OBJECT>
                    <SHORT-LABEL>include::pfe_l2br_table_csr.h</SHORT-LABEL>
                    <CATEGORY>SWHDR</CATEGORY>
                  </AUTOSAR-ENGINEERING-OBJECT>
                  <AUTOSAR-ENGINEERING-OBJECT>
                    <SHORT-LABEL>include::pfe_log_if.h</SHORT-LABEL>
                    <CATEGORY>SWHDR</CATEGORY>
                  </AUTOSAR-ENGINEERING-OBJECT>
                  <AUTOSAR-ENGINEERING-OBJECT>
                    <SHORT-LABEL>include::pfe_mac_db.h</SHORT-LABEL>
                    <CATEGORY>SWHDR</CATEGORY>
                  </AUTOSAR-ENGINEERING-OBJECT>
                  <AUTOSAR-ENGINEERING-OBJECT>
                    <SHORT-LABEL>include::pfe_minihif_drv.h</SHORT-LABEL>
                    <CATEGORY>SWHDR</CATEGORY>
                  </AUTOSAR-ENGINEERING-OBJECT>
                  <AUTOSAR-ENGINEERING-OBJECT>
                    <SHORT-LABEL>include::pfe_mirror.h</SHORT-LABEL>
                    <CATEGORY>SWHDR</CATEGORY>
                  </AUTOSAR-ENGINEERING-OBJECT>
                  <AUTOSAR-ENGINEERING-OBJECT>
                    <SHORT-LABEL>include::pfe_parity.h</SHORT-LABEL>
                    <CATEGORY>SWHDR</CATEGORY>
                  </AUTOSAR-ENGINEERING-OBJECT>
                  <AUTOSAR-ENGINEERING-OBJECT>
                    <SHORT-LABEL>include::pfe_parity_csr.h</SHORT-LABEL>
                    <CATEGORY>SWHDR</CATEGORY>
                  </AUTOSAR-ENGINEERING-OBJECT>
                  <AUTOSAR-ENGINEERING-OBJECT>
                    <SHORT-LABEL>include::pfe_pe.h</SHORT-LABEL>
                    <CATEGORY>SWHDR</CATEGORY>
                  </AUTOSAR-ENGINEERING-OBJECT>
                  <AUTOSAR-ENGINEERING-OBJECT>
                    <SHORT-LABEL>include::pfe_phy_if.h</SHORT-LABEL>
                    <CATEGORY>SWHDR</CATEGORY>
                  </AUTOSAR-ENGINEERING-OBJECT>
                  <AUTOSAR-ENGINEERING-OBJECT>
                    <SHORT-LABEL>include::pfe_platform.h</SHORT-LABEL>
                    <CATEGORY>SWHDR</CATEGORY>
                  </AUTOSAR-ENGINEERING-OBJECT>
                  <AUTOSAR-ENGINEERING-OBJECT>
                    <SHORT-LABEL>include::pfe_platform_cfg.h</SHORT-LABEL>
                    <CATEGORY>SWHDR</CATEGORY>
                  </AUTOSAR-ENGINEERING-OBJECT>
                  <AUTOSAR-ENGINEERING-OBJECT>
                    <SHORT-LABEL>include::pfe_platform_rpc.h</SHORT-LABEL>
                    <CATEGORY>SWHDR</CATEGORY>
                  </AUTOSAR-ENGINEERING-OBJECT>
                  <AUTOSAR-ENGINEERING-OBJECT>
                    <SHORT-LABEL>include::pfe_rtable.h</SHORT-LABEL>
                    <CATEGORY>SWHDR</CATEGORY>
                  </AUTOSAR-ENGINEERING-OBJECT>
                  <AUTOSAR-ENGINEERING-OBJECT>
                    <SHORT-LABEL>include::pfe_tmu.h</SHORT-LABEL>
                    <CATEGORY>SWHDR</CATEGORY>
                  </AUTOSAR-ENGINEERING-OBJECT>
                  <AUTOSAR-ENGINEERING-OBJECT>
                    <SHORT-LABEL>include::pfe_tmu_csr.h</SHORT-LABEL>
                    <CATEGORY>SWHDR</CATEGORY>
                  </AUTOSAR-ENGINEERING-OBJECT>
                  <AUTOSAR-ENGINEERING-OBJECT>
                    <SHORT-LABEL>include::pfe_util.h</SHORT-LABEL>
                    <CATEGORY>SWHDR</CATEGORY>
                  </AUTOSAR-ENGINEERING-OBJECT>
                  <AUTOSAR-ENGINEERING-OBJECT>
                    <SHORT-LABEL>include::pfe_util_csr.h</SHORT-LABEL>
                    <CATEGORY>SWHDR</CATEGORY>
                  </AUTOSAR-ENGINEERING-OBJECT>
                  <AUTOSAR-ENGINEERING-OBJECT>
                    <SHORT-LABEL>include::pfe_wdt.h</SHORT-LABEL>
                    <CATEGORY>SWHDR</CATEGORY>
                  </AUTOSAR-ENGINEERING-OBJECT>
                  <AUTOSAR-ENGINEERING-OBJECT>
                    <SHORT-LABEL>include::pfe_wdt_csr.h</SHORT-LABEL>
                    <CATEGORY>SWHDR</CATEGORY>
                  </AUTOSAR-ENGINEERING-OBJECT>
                  <AUTOSAR-ENGINEERING-OBJECT>
                    <SHORT-LABEL>src::autolibc.c</SHORT-LABEL>
                    <CATEGORY>SWSRC</CATEGORY>
                  </AUTOSAR-ENGINEERING-OBJECT>
                  <AUTOSAR-ENGINEERING-OBJECT>
                    <SHORT-LABEL>src::blalloc.c</SHORT-LABEL>
                    <CATEGORY>SWSRC</CATEGORY>
                  </AUTOSAR-ENGINEERING-OBJECT>
                  <AUTOSAR-ENGINEERING-OBJECT>
                    <SHORT-LABEL>src::elf.c</SHORT-LABEL>
                    <CATEGORY>SWSRC</CATEGORY>
                  </AUTOSAR-ENGINEERING-OBJECT>
                  <AUTOSAR-ENGINEERING-OBJECT>
                    <SHORT-LABEL>src::Eth_43_PFE.c</SHORT-LABEL>
                    <CATEGORY>SWSRC</CATEGORY>
                  </AUTOSAR-ENGINEERING-OBJECT>
                  <AUTOSAR-ENGINEERING-OBJECT>
                    <SHORT-LABEL>src::Eth_43_PFE_Irq.c</SHORT-LABEL>
                    <CATEGORY>SWSRC</CATEGORY>
                  </AUTOSAR-ENGINEERING-OBJECT>
                  <AUTOSAR-ENGINEERING-OBJECT>
                    <SHORT-LABEL>src::Eth_PFE_LLD.c</SHORT-LABEL>
                    <CATEGORY>SWSRC</CATEGORY>
                  </AUTOSAR-ENGINEERING-OBJECT>
                  <AUTOSAR-ENGINEERING-OBJECT>
                    <SHORT-LABEL>src::fci.c</SHORT-LABEL>
                    <CATEGORY>SWSRC</CATEGORY>
                  </AUTOSAR-ENGINEERING-OBJECT>
                  <AUTOSAR-ENGINEERING-OBJECT>
                    <SHORT-LABEL>src::fci_connections.c</SHORT-LABEL>
                    <CATEGORY>SWSRC</CATEGORY>
                  </AUTOSAR-ENGINEERING-OBJECT>
                  <AUTOSAR-ENGINEERING-OBJECT>
                    <SHORT-LABEL>src::fci_core_autosar.c</SHORT-LABEL>
                    <CATEGORY>SWSRC</CATEGORY>
                  </AUTOSAR-ENGINEERING-OBJECT>
                  <AUTOSAR-ENGINEERING-OBJECT>
                    <SHORT-LABEL>src::fci_fp.c</SHORT-LABEL>
                    <CATEGORY>SWSRC</CATEGORY>
                  </AUTOSAR-ENGINEERING-OBJECT>
                  <AUTOSAR-ENGINEERING-OBJECT>
                    <SHORT-LABEL>src::fci_fp_db.c</SHORT-LABEL>
                    <CATEGORY>SWSRC</CATEGORY>
                  </AUTOSAR-ENGINEERING-OBJECT>
                  <AUTOSAR-ENGINEERING-OBJECT>
                    <SHORT-LABEL>src::fci_fw_features.c</SHORT-LABEL>
                    <CATEGORY>SWSRC</CATEGORY>
                  </AUTOSAR-ENGINEERING-OBJECT>
                  <AUTOSAR-ENGINEERING-OBJECT>
                    <SHORT-LABEL>src::fci_interfaces.c</SHORT-LABEL>
                    <CATEGORY>SWSRC</CATEGORY>
                  </AUTOSAR-ENGINEERING-OBJECT>
                  <AUTOSAR-ENGINEERING-OBJECT>
                    <SHORT-LABEL>src::fci_l2br.c</SHORT-LABEL>
                    <CATEGORY>SWSRC</CATEGORY>
                  </AUTOSAR-ENGINEERING-OBJECT>
                  <AUTOSAR-ENGINEERING-OBJECT>
                    <SHORT-LABEL>src::fci_l2br_domains.c</SHORT-LABEL>
                    <CATEGORY>SWSRC</CATEGORY>
                  </AUTOSAR-ENGINEERING-OBJECT>
                  <AUTOSAR-ENGINEERING-OBJECT>
                    <SHORT-LABEL>src::fci_mirror.c</SHORT-LABEL>
                    <CATEGORY>SWSRC</CATEGORY>
                  </AUTOSAR-ENGINEERING-OBJECT>
                  <AUTOSAR-ENGINEERING-OBJECT>
                    <SHORT-LABEL>src::fci_qos.c</SHORT-LABEL>
                    <CATEGORY>SWSRC</CATEGORY>
                  </AUTOSAR-ENGINEERING-OBJECT>
                  <AUTOSAR-ENGINEERING-OBJECT>
                    <SHORT-LABEL>src::fci_routes.c</SHORT-LABEL>
                    <CATEGORY>SWSRC</CATEGORY>
                  </AUTOSAR-ENGINEERING-OBJECT>
                  <AUTOSAR-ENGINEERING-OBJECT>
                    <SHORT-LABEL>src::fci_rt_db.c</SHORT-LABEL>
                    <CATEGORY>SWSRC</CATEGORY>
                  </AUTOSAR-ENGINEERING-OBJECT>
                  <AUTOSAR-ENGINEERING-OBJECT>
                    <SHORT-LABEL>src::fci_timer_owner.c</SHORT-LABEL>
                    <CATEGORY>SWSRC</CATEGORY>
                  </AUTOSAR-ENGINEERING-OBJECT>
                  <AUTOSAR-ENGINEERING-OBJECT>
                    <SHORT-LABEL>src::fifo.c</SHORT-LABEL>
                    <CATEGORY>SWSRC</CATEGORY>
                  </AUTOSAR-ENGINEERING-OBJECT>
                  <AUTOSAR-ENGINEERING-OBJECT>
                    <SHORT-LABEL>src::libfci_autosar.c</SHORT-LABEL>
                    <CATEGORY>SWSRC</CATEGORY>
                  </AUTOSAR-ENGINEERING-OBJECT>
                  <AUTOSAR-ENGINEERING-OBJECT>
                    <SHORT-LABEL>src::nxp_snprintf.c</SHORT-LABEL>
                    <CATEGORY>SWSRC</CATEGORY>
                  </AUTOSAR-ENGINEERING-OBJECT>
                  <AUTOSAR-ENGINEERING-OBJECT>
                    <SHORT-LABEL>src::oal_irq_autosar.c</SHORT-LABEL>
                    <CATEGORY>SWSRC</CATEGORY>
                  </AUTOSAR-ENGINEERING-OBJECT>
                  <AUTOSAR-ENGINEERING-OBJECT>
                    <SHORT-LABEL>src::oal_job_autosar.c</SHORT-LABEL>
                    <CATEGORY>SWSRC</CATEGORY>
                  </AUTOSAR-ENGINEERING-OBJECT>
                  <AUTOSAR-ENGINEERING-OBJECT>
                    <SHORT-LABEL>src::oal_mm_autosar.c</SHORT-LABEL>
                    <CATEGORY>SWSRC</CATEGORY>
                  </AUTOSAR-ENGINEERING-OBJECT>
                  <AUTOSAR-ENGINEERING-OBJECT>
                    <SHORT-LABEL>src::oal_time_autosar.c</SHORT-LABEL>
                    <CATEGORY>SWSRC</CATEGORY>
                  </AUTOSAR-ENGINEERING-OBJECT>
                  <AUTOSAR-ENGINEERING-OBJECT>
                    <SHORT-LABEL>src::oal_util_autosar.c</SHORT-LABEL>
                    <CATEGORY>SWSRC</CATEGORY>
                  </AUTOSAR-ENGINEERING-OBJECT>
                  <AUTOSAR-ENGINEERING-OBJECT>
                    <SHORT-LABEL>src::oal_util_net_autosar.c</SHORT-LABEL>
                    <CATEGORY>SWSRC</CATEGORY>
                  </AUTOSAR-ENGINEERING-OBJECT>
                  <AUTOSAR-ENGINEERING-OBJECT>
                    <SHORT-LABEL>src::pfe_bmu.c</SHORT-LABEL>
                    <CATEGORY>SWSRC</CATEGORY>
                  </AUTOSAR-ENGINEERING-OBJECT>
                  <AUTOSAR-ENGINEERING-OBJECT>
                    <SHORT-LABEL>src::pfe_bmu_csr.c</SHORT-LABEL>
                    <CATEGORY>SWSRC</CATEGORY>
                  </AUTOSAR-ENGINEERING-OBJECT>
                  <AUTOSAR-ENGINEERING-OBJECT>
                    <SHORT-LABEL>src::pfe_bus_err.c</SHORT-LABEL>
                    <CATEGORY>SWSRC</CATEGORY>
                  </AUTOSAR-ENGINEERING-OBJECT>
                  <AUTOSAR-ENGINEERING-OBJECT>
                    <SHORT-LABEL>src::pfe_bus_err_csr.c</SHORT-LABEL>
                    <CATEGORY>SWSRC</CATEGORY>
                  </AUTOSAR-ENGINEERING-OBJECT>
                  <AUTOSAR-ENGINEERING-OBJECT>
                    <SHORT-LABEL>src::pfe_class.c</SHORT-LABEL>
                    <CATEGORY>SWSRC</CATEGORY>
                  </AUTOSAR-ENGINEERING-OBJECT>
                  <AUTOSAR-ENGINEERING-OBJECT>
                    <SHORT-LABEL>src::pfe_class_csr.c</SHORT-LABEL>
                    <CATEGORY>SWSRC</CATEGORY>
                  </AUTOSAR-ENGINEERING-OBJECT>
                  <AUTOSAR-ENGINEERING-OBJECT>
                    <SHORT-LABEL>src::pfe_ecc_err.c</SHORT-LABEL>
                    <CATEGORY>SWSRC</CATEGORY>
                  </AUTOSAR-ENGINEERING-OBJECT>
                  <AUTOSAR-ENGINEERING-OBJECT>
                    <SHORT-LABEL>src::pfe_ecc_err_csr.c</SHORT-LABEL>
                    <CATEGORY>SWSRC</CATEGORY>
                  </AUTOSAR-ENGINEERING-OBJECT>
                  <AUTOSAR-ENGINEERING-OBJECT>
                    <SHORT-LABEL>src::pfe_emac.c</SHORT-LABEL>
                    <CATEGORY>SWSRC</CATEGORY>
                  </AUTOSAR-ENGINEERING-OBJECT>
                  <AUTOSAR-ENGINEERING-OBJECT>
                    <SHORT-LABEL>src::pfe_emac_csr.c</SHORT-LABEL>
                    <CATEGORY>SWSRC</CATEGORY>
                  </AUTOSAR-ENGINEERING-OBJECT>
                  <AUTOSAR-ENGINEERING-OBJECT>
                    <SHORT-LABEL>src::pfe_emac_slave.c</SHORT-LABEL>
                    <CATEGORY>SWSRC</CATEGORY>
                  </AUTOSAR-ENGINEERING-OBJECT>
                  <AUTOSAR-ENGINEERING-OBJECT>
                    <SHORT-LABEL>src::pfe_fail_stop.c</SHORT-LABEL>
                    <CATEGORY>SWSRC</CATEGORY>
                  </AUTOSAR-ENGINEERING-OBJECT>
                  <AUTOSAR-ENGINEERING-OBJECT>
                    <SHORT-LABEL>src::pfe_fail_stop_csr.c</SHORT-LABEL>
                    <CATEGORY>SWSRC</CATEGORY>
                  </AUTOSAR-ENGINEERING-OBJECT>
                  <AUTOSAR-ENGINEERING-OBJECT>
                    <SHORT-LABEL>src::pfe_feature_mgr.c</SHORT-LABEL>
                    <CATEGORY>SWSRC</CATEGORY>
                  </AUTOSAR-ENGINEERING-OBJECT>
                  <AUTOSAR-ENGINEERING-OBJECT>
                    <SHORT-LABEL>src::pfe_fp.c</SHORT-LABEL>
                    <CATEGORY>SWSRC</CATEGORY>
                  </AUTOSAR-ENGINEERING-OBJECT>
                  <AUTOSAR-ENGINEERING-OBJECT>
                    <SHORT-LABEL>src::pfe_fw_fail_stop.c</SHORT-LABEL>
                    <CATEGORY>SWSRC</CATEGORY>
                  </AUTOSAR-ENGINEERING-OBJECT>
                  <AUTOSAR-ENGINEERING-OBJECT>
                    <SHORT-LABEL>src::pfe_fw_fail_stop_csr.c</SHORT-LABEL>
                    <CATEGORY>SWSRC</CATEGORY>
                  </AUTOSAR-ENGINEERING-OBJECT>
                  <AUTOSAR-ENGINEERING-OBJECT>
                    <SHORT-LABEL>src::pfe_fw_feature.c</SHORT-LABEL>
                    <CATEGORY>SWSRC</CATEGORY>
                  </AUTOSAR-ENGINEERING-OBJECT>
                  <AUTOSAR-ENGINEERING-OBJECT>
                    <SHORT-LABEL>src::pfe_gpi.c</SHORT-LABEL>
                    <CATEGORY>SWSRC</CATEGORY>
                  </AUTOSAR-ENGINEERING-OBJECT>
                  <AUTOSAR-ENGINEERING-OBJECT>
                    <SHORT-LABEL>src::pfe_gpi_csr.c</SHORT-LABEL>
                    <CATEGORY>SWSRC</CATEGORY>
                  </AUTOSAR-ENGINEERING-OBJECT>
                  <AUTOSAR-ENGINEERING-OBJECT>
                    <SHORT-LABEL>src::pfe_hif_chnl.c</SHORT-LABEL>
                    <CATEGORY>SWSRC</CATEGORY>
                  </AUTOSAR-ENGINEERING-OBJECT>
                  <AUTOSAR-ENGINEERING-OBJECT>
                    <SHORT-LABEL>src::pfe_hif_csr.c</SHORT-LABEL>
                    <CATEGORY>SWSRC</CATEGORY>
                  </AUTOSAR-ENGINEERING-OBJECT>
                  <AUTOSAR-ENGINEERING-OBJECT>
                    <SHORT-LABEL>src::pfe_hif_drv.c</SHORT-LABEL>
                    <CATEGORY>SWSRC</CATEGORY>
                  </AUTOSAR-ENGINEERING-OBJECT>
                  <AUTOSAR-ENGINEERING-OBJECT>
                    <SHORT-LABEL>src::pfe_hif.c</SHORT-LABEL>
                    <CATEGORY>SWSRC</CATEGORY>
                  </AUTOSAR-ENGINEERING-OBJECT>
                  <AUTOSAR-ENGINEERING-OBJECT>
                    <SHORT-LABEL>src::pfe_hif_nocpy_csr.c</SHORT-LABEL>
                    <CATEGORY>SWSRC</CATEGORY>
                  </AUTOSAR-ENGINEERING-OBJECT>
                  <AUTOSAR-ENGINEERING-OBJECT>
                    <SHORT-LABEL>src::pfe_hif_nocpy.c</SHORT-LABEL>
                    <CATEGORY>SWSRC</CATEGORY>
                  </AUTOSAR-ENGINEERING-OBJECT>
                  <AUTOSAR-ENGINEERING-OBJECT>
                    <SHORT-LABEL>src::pfe_hif_ptp.c</SHORT-LABEL>
                    <CATEGORY>SWSRC</CATEGORY>
                  </AUTOSAR-ENGINEERING-OBJECT>
                  <AUTOSAR-ENGINEERING-OBJECT>
                    <SHORT-LABEL>src::pfe_hif_ring.c</SHORT-LABEL>
                    <CATEGORY>SWSRC</CATEGORY>
                  </AUTOSAR-ENGINEERING-OBJECT>
                  <AUTOSAR-ENGINEERING-OBJECT>
                    <SHORT-LABEL>src::pfe_hm.c</SHORT-LABEL>
                    <CATEGORY>SWSRC</CATEGORY>
                  </AUTOSAR-ENGINEERING-OBJECT>
                  <AUTOSAR-ENGINEERING-OBJECT>
                    <SHORT-LABEL>src::pfe_host_fail_stop.c</SHORT-LABEL>
                    <CATEGORY>SWSRC</CATEGORY>
                  </AUTOSAR-ENGINEERING-OBJECT>
                  <AUTOSAR-ENGINEERING-OBJECT>
                    <SHORT-LABEL>src::pfe_host_fail_stop_csr.c</SHORT-LABEL>
                    <CATEGORY>SWSRC</CATEGORY>
                  </AUTOSAR-ENGINEERING-OBJECT>
                  <AUTOSAR-ENGINEERING-OBJECT>
                    <SHORT-LABEL>src::pfe_hw_feature.c</SHORT-LABEL>
                    <CATEGORY>SWSRC</CATEGORY>
                  </AUTOSAR-ENGINEERING-OBJECT>
                  <AUTOSAR-ENGINEERING-OBJECT>
                    <SHORT-LABEL>src::pfe_idex.c</SHORT-LABEL>
                    <CATEGORY>SWSRC</CATEGORY>
                  </AUTOSAR-ENGINEERING-OBJECT>
                  <AUTOSAR-ENGINEERING-OBJECT>
                    <SHORT-LABEL>src::pfe_if_db.c</SHORT-LABEL>
                    <CATEGORY>SWSRC</CATEGORY>
                  </AUTOSAR-ENGINEERING-OBJECT>
                  <AUTOSAR-ENGINEERING-OBJECT>
                    <SHORT-LABEL>src::pfe_l2br.c</SHORT-LABEL>
                    <CATEGORY>SWSRC</CATEGORY>
                  </AUTOSAR-ENGINEERING-OBJECT>
                  <AUTOSAR-ENGINEERING-OBJECT>
                    <SHORT-LABEL>src::pfe_l2br_table.c</SHORT-LABEL>
                    <CATEGORY>SWSRC</CATEGORY>
                  </AUTOSAR-ENGINEERING-OBJECT>
                  <AUTOSAR-ENGINEERING-OBJECT>
                    <SHORT-LABEL>src::pfe_log_if.c</SHORT-LABEL>
                    <CATEGORY>SWSRC</CATEGORY>
                  </AUTOSAR-ENGINEERING-OBJECT>
                  <AUTOSAR-ENGINEERING-OBJECT>
                    <SHORT-LABEL>src::pfe_mac_db.c</SHORT-LABEL>
                    <CATEGORY>SWSRC</CATEGORY>
                  </AUTOSAR-ENGINEERING-OBJECT>
                  <AUTOSAR-ENGINEERING-OBJECT>
                    <SHORT-LABEL>src::pfe_minihif_drv.c</SHORT-LABEL>
                    <CATEGORY>SWSRC</CATEGORY>
                  </AUTOSAR-ENGINEERING-OBJECT>
                  <AUTOSAR-ENGINEERING-OBJECT>
                    <SHORT-LABEL>src::pfe_mirror.c</SHORT-LABEL>
                    <CATEGORY>SWSRC</CATEGORY>
                  </AUTOSAR-ENGINEERING-OBJECT>
                  <AUTOSAR-ENGINEERING-OBJECT>
                    <SHORT-LABEL>src::pfe_parity.c</SHORT-LABEL>
                    <CATEGORY>SWSRC</CATEGORY>
                  </AUTOSAR-ENGINEERING-OBJECT>
                  <AUTOSAR-ENGINEERING-OBJECT>
                    <SHORT-LABEL>src::pfe_parity_csr.c</SHORT-LABEL>
                    <CATEGORY>SWSRC</CATEGORY>
                  </AUTOSAR-ENGINEERING-OBJECT>
                  <AUTOSAR-ENGINEERING-OBJECT>
                    <SHORT-LABEL>src::pfe_pe.c</SHORT-LABEL>
                    <CATEGORY>SWSRC</CATEGORY>
                  </AUTOSAR-ENGINEERING-OBJECT>
                  <AUTOSAR-ENGINEERING-OBJECT>
                    <SHORT-LABEL>src::pfe_phy_if.c</SHORT-LABEL>
                    <CATEGORY>SWSRC</CATEGORY>
                  </AUTOSAR-ENGINEERING-OBJECT>
                  <AUTOSAR-ENGINEERING-OBJECT>
                    <SHORT-LABEL>src::pfe_phy_if_slave.c</SHORT-LABEL>
                    <CATEGORY>SWSRC</CATEGORY>
                  </AUTOSAR-ENGINEERING-OBJECT>
                  <AUTOSAR-ENGINEERING-OBJECT>
                    <SHORT-LABEL>src::pfe_platform_master.c</SHORT-LABEL>
                    <CATEGORY>SWSRC</CATEGORY>
                  </AUTOSAR-ENGINEERING-OBJECT>
                  <AUTOSAR-ENGINEERING-OBJECT>
                    <SHORT-LABEL>src::pfe_platform_slave.c</SHORT-LABEL>
                    <CATEGORY>SWSRC</CATEGORY>
                  </AUTOSAR-ENGINEERING-OBJECT>
                  <AUTOSAR-ENGINEERING-OBJECT>
                    <SHORT-LABEL>src::pfe_rtable.c</SHORT-LABEL>
                    <CATEGORY>SWSRC</CATEGORY>
                  </AUTOSAR-ENGINEERING-OBJECT>
                  <AUTOSAR-ENGINEERING-OBJECT>
                    <SHORT-LABEL>src::pfe_tmu.c</SHORT-LABEL>
                    <CATEGORY>SWSRC</CATEGORY>
                  </AUTOSAR-ENGINEERING-OBJECT>
                  <AUTOSAR-ENGINEERING-OBJECT>
                    <SHORT-LABEL>src::pfe_tmu_csr.c</SHORT-LABEL>
                    <CATEGORY>SWSRC</CATEGORY>
                  </AUTOSAR-ENGINEERING-OBJECT>
                  <AUTOSAR-ENGINEERING-OBJECT>
                    <SHORT-LABEL>src::pfe_util.c</SHORT-LABEL>
                    <CATEGORY>SWSRC</CATEGORY>
                  </AUTOSAR-ENGINEERING-OBJECT>
                  <AUTOSAR-ENGINEERING-OBJECT>
                    <SHORT-LABEL>src::pfe_util_csr.c</SHORT-LABEL>
                    <CATEGORY>SWSRC</CATEGORY>
                  </AUTOSAR-ENGINEERING-OBJECT>
                  <AUTOSAR-ENGINEERING-OBJECT>
                    <SHORT-LABEL>src::pfe_wdt.c</SHORT-LABEL>
                    <CATEGORY>SWSRC</CATEGORY>
                  </AUTOSAR-ENGINEERING-OBJECT>
                  <AUTOSAR-ENGINEERING-OBJECT>
                    <SHORT-LABEL>src::pfe_wdt_csr.c</SHORT-LABEL>
                    <CATEGORY>SWSRC</CATEGORY>
                  </AUTOSAR-ENGINEERING-OBJECT>  
                </ARTIFACT-DESCRIPTORS>
                </CODE>
              </CODE-DESCRIPTORS>

              <COMPILERS>
                <COMPILER>
                  <SHORT-NAME>GHS_Compiler</SHORT-NAME>
                  <NAME>Green Hills</NAME>
                  <OPTIONS>-c -cpu=cortexm7 -Osize -Wall -G -preprocess_assembly_files --no_exceptions -dual_debug --prototype_errors -Wundef -noslashcomment -Wimplicit-int -Wshadow -Wtrigraphs -nostartfile --no_commons --incorrect_pragma_warnings -list --short_enum</OPTIONS>
                  <VENDOR>Green Hills</VENDOR>
                  <VERSION>Green Hills Multi 7.1.6 / Compiler 2019.1.4</VERSION>
                </COMPILER>
                <COMPILER>
                  <SHORT-NAME>DIAB_Compiler</SHORT-NAME>
                  <NAME>Windriver Diab</NAME>
                  <OPTIONS>-c -g3 -tARMCORTEXM7MF:simple -gdwarf-3 -gstrict-dwarf -Xdebug-local-all -Xdebug-local-cie -Xdebug-struct-all -fsigned-char -fno-common -Wno-nonportable-include-path -Wno-extern-initializer -mno-global-merge -O3</OPTIONS>
                  <VENDOR>Windriver</VENDOR>
                  <VERSION>DIAB_7_0_2_0_20190618_125416</VERSION>
                </COMPILER>
                <COMPILER>
                  <SHORT-NAME>GCC_Compiler</SHORT-NAME>
                  <NAME>GNU Compiler Collection</NAME>
                  <OPTIONS>-c -Os -ggdb3 -mcpu=cortex-m7 -mthumb -mlittle-endian -fomit-frame-pointer -msoft-float -fno-common -Wall -Wextra -Wstrict-prototypes -Wno-sign-compare -DGCC -fstack-usage -fdump-ipa-all -Werror=implicit-function-declaration</OPTIONS>
                  <VENDOR>NXP</VENDOR>
                  <VERSION>GCC_6.3.1_1620_g01b30c3</VERSION>
                </COMPILER>
              </COMPILERS>
              <GENERATED-ARTIFACTS>
                <DEPENDENCY-ON-ARTIFACT>
                  <SHORT-NAME>Eth_43_PFE_Cfg_h</SHORT-NAME>
                  <ARTIFACT-DESCRIPTOR>
                    <SHORT-LABEL>generate::include::Eth_43_PFE_Cfg.h</SHORT-LABEL>
                    <CATEGORY>SWHDR</CATEGORY>
                  </ARTIFACT-DESCRIPTOR>
                  <USAGES>
                    <USAGE>COMPILE</USAGE>
                  </USAGES>
                </DEPENDENCY-ON-ARTIFACT>
                <DEPENDENCY-ON-ARTIFACT>
                  <SHORT-NAME>pfe_cfg_h</SHORT-NAME>
                  <ARTIFACT-DESCRIPTOR>
                    <SHORT-LABEL>generate::include::pfe_cfg.h</SHORT-LABEL>
                    <CATEGORY>SWHDR</CATEGORY>
                  </ARTIFACT-DESCRIPTOR>
                  <USAGES>
                    <USAGE>COMPILE</USAGE>
                  </USAGES>
                </DEPENDENCY-ON-ARTIFACT>
                <DEPENDENCY-ON-ARTIFACT>
                  <SHORT-NAME>Eth_43_PFE_Cfg_c</SHORT-NAME>
                  <ARTIFACT-DESCRIPTOR>
                    <SHORT-LABEL>generate::src::Eth_43_PFE_Cfg.c</SHORT-LABEL>
                    <CATEGORY>SWSRC</CATEGORY>
                  </ARTIFACT-DESCRIPTOR>
                  <USAGES>
                    <USAGE>COMPILE</USAGE>
                  </USAGES>
                </DEPENDENCY-ON-ARTIFACT>
                <DEPENDENCY-ON-ARTIFACT>
                  <SHORT-NAME>Eth_43_PFE_PBcfg_c</SHORT-NAME>
                  <ARTIFACT-DESCRIPTOR>
                    <SHORT-LABEL>generate::src::Eth_43_PFE_PBcfg.c</SHORT-LABEL>
                    <CATEGORY>SWSRC</CATEGORY>
                  </ARTIFACT-DESCRIPTOR>
                  <USAGES>
                    <USAGE>COMPILE</USAGE>
                  </USAGES>
                </DEPENDENCY-ON-ARTIFACT>
              </GENERATED-ARTIFACTS>

              <LINKERS>
                <LINKER>
                  <SHORT-NAME>GHS_Linker</SHORT-NAME>
                  <NAME>Green Hills</NAME>
                  <OPTIONS>-Mn -delete -v -ignore_debug_references -map -keepmap -L(/lib/thumb2) -lstartup -lsys -larch -lansi -lutf8_s32</OPTIONS>
                  <VENDOR>Green Hills</VENDOR>
                  <VERSION>Green Hills Multi 7.1.6d / Compiler 2020.1.4</VERSION>
                </LINKER>
                <LINKER>
                  <SHORT-NAME>DIAB_Linker</SHORT-NAME>
                  <NAME>Windriver Diab</NAME>
                  <OPTIONS>-tARMCORTEXM7MF:simple -Xelf -m6 -Xstack-usage -lcdinkum -lllvmc -limpl</OPTIONS>
                  <VENDOR>Windriver</VENDOR>
                  <VERSION>DIAB_7_0_3_0-FCS_20200409_160912</VERSION>
                </LINKER>
                <LINKER>
                  <SHORT-NAME>GCC_Linker</SHORT-NAME>
                  <NAME>GNU Compiler Collection</NAME>
                  <OPTIONS>--start-group</OPTIONS>
                  <VENDOR>NXP</VENDOR>
                  <VERSION>GCC_9.2.0_1649_gaf57174</VERSION>
                </LINKER>
              </LINKERS>
              <PROGRAMMING-LANGUAGE>C</PROGRAMMING-LANGUAGE>
              <RESOURCE-CONSUMPTION>
                <SHORT-NAME>ResourceConsumption</SHORT-NAME>
                <MEMORY-SECTIONS>
                  <MEMORY-SECTION>
                    <SHORT-NAME>ETH_43_PFE_CONFIG_DATA_8</SHORT-NAME>
                    <ALIGNMENT>8</ALIGNMENT>
                    <SW-ADDRMETHOD-REF DEST="SW-ADDR-METHOD">/AUTOSAR_MemMap/SwAddrMethods/CONFIG_DATA</SW-ADDRMETHOD-REF>
                    <SYMBOL>CONFIG_DATA_8</SYMBOL>
                  </MEMORY-SECTION>
                  <MEMORY-SECTION>
                    <SHORT-NAME>ETH_43_PFE_CONFIG_DATA_16</SHORT-NAME>
                    <ALIGNMENT>16</ALIGNMENT>
                    <SW-ADDRMETHOD-REF DEST="SW-ADDR-METHOD">/AUTOSAR_MemMap/SwAddrMethods/CONFIG_DATA</SW-ADDRMETHOD-REF>
                    <SYMBOL>CONFIG_DATA_16</SYMBOL>
                  </MEMORY-SECTION>        
                  <MEMORY-SECTION>
                    <SHORT-NAME>ETH_43_PFE_CONFIG_DATA_32</SHORT-NAME>
                    <ALIGNMENT>32</ALIGNMENT>
                    <SW-ADDRMETHOD-REF DEST="SW-ADDR-METHOD">/AUTOSAR_MemMap/SwAddrMethods/CONFIG_DATA</SW-ADDRMETHOD-REF>
                    <SYMBOL>CONFIG_DATA_32</SYMBOL>
                  </MEMORY-SECTION>
                  <MEMORY-SECTION>
                    <SHORT-NAME>ETH_43_PFE_CONFIG_DATA_UNSPECIFIED</SHORT-NAME>
                    <ALIGNMENT>UNSPECIFIED</ALIGNMENT>
                    <SW-ADDRMETHOD-REF DEST="SW-ADDR-METHOD">/AUTOSAR_MemMap/SwAddrMethods/CONFIG_DATA</SW-ADDRMETHOD-REF>
                    <SYMBOL>CONFIG_DATA_UNSPECIFIED</SYMBOL>
                  </MEMORY-SECTION>
                  <MEMORY-SECTION>
                    <SHORT-NAME>ETH_43_PFE_CONFIG_DATA_8_NO_CACHEABLE</SHORT-NAME>
                    <ALIGNMENT>8</ALIGNMENT>
                    <SW-ADDRMETHOD-REF DEST="SW-ADDR-METHOD">/AUTOSAR_MemMap/SwAddrMethods/CONFIG_DATA</SW-ADDRMETHOD-REF>
                    <SYMBOL>CONFIG_DATA_8_NO_CACHEABLE</SYMBOL>
                  </MEMORY-SECTION>
                  <MEMORY-SECTION>
                    <SHORT-NAME>ETH_43_PFE_CONFIG_DATA_16_NO_CACHEABLE</SHORT-NAME>
                    <ALIGNMENT>16</ALIGNMENT>
                    <SW-ADDRMETHOD-REF DEST="SW-ADDR-METHOD">/AUTOSAR_MemMap/SwAddrMethods/CONFIG_DATA</SW-ADDRMETHOD-REF>
                    <SYMBOL>CONFIG_DATA_16_NO_CACHEABLE</SYMBOL>
                  </MEMORY-SECTION>
                  <MEMORY-SECTION>
                    <SHORT-NAME>ETH_43_PFE_CONFIG_DATA_32_NO_CACHEABLE</SHORT-NAME>
                    <ALIGNMENT>32</ALIGNMENT>
                    <SW-ADDRMETHOD-REF DEST="SW-ADDR-METHOD">/AUTOSAR_MemMap/SwAddrMethods/CONFIG_DATA</SW-ADDRMETHOD-REF>
                    <SYMBOL>CONFIG_DATA_32_NO_CACHEABLE</SYMBOL>
                  </MEMORY-SECTION> 
                  <MEMORY-SECTION>
                    <SHORT-NAME>ETH_43_PFE_CONFIG_DATA_UNSPECIFIED_NO_CACHEABLE</SHORT-NAME>
                    <ALIGNMENT>UNSPECIFIED</ALIGNMENT>
                    <SW-ADDRMETHOD-REF DEST="SW-ADDR-METHOD">/AUTOSAR_MemMap/SwAddrMethods/CONFIG_DATA</SW-ADDRMETHOD-REF>
                    <SYMBOL>CONFIG_DATA_UNSPECIFIED_NO_CACHEABLE</SYMBOL>
                  </MEMORY-SECTION>
                  <MEMORY-SECTION>
                    <SHORT-NAME>ETH_43_PFE_CONST_BOOLEAN</SHORT-NAME>
                    <ALIGNMENT>BOOLEAN</ALIGNMENT>
                    <SW-ADDRMETHOD-REF DEST="SW-ADDR-METHOD">/AUTOSAR_MemMap/SwAddrMethods/CONST</SW-ADDRMETHOD-REF>
                    <SYMBOL>CONST_BOOLEAN</SYMBOL>
                  </MEMORY-SECTION>
                  <MEMORY-SECTION>
                    <SHORT-NAME>ETH_43_PFE_CONST_8</SHORT-NAME>
                    <ALIGNMENT>8</ALIGNMENT>
                    <SW-ADDRMETHOD-REF DEST="SW-ADDR-METHOD">/AUTOSAR_MemMap/SwAddrMethods/CONST</SW-ADDRMETHOD-REF>
                    <SYMBOL>CONST_8</SYMBOL>
                  </MEMORY-SECTION>
                  <MEMORY-SECTION>
                    <SHORT-NAME>ETH_43_PFE_CONST_16</SHORT-NAME>
                    <ALIGNMENT>16</ALIGNMENT>
                    <SW-ADDRMETHOD-REF DEST="SW-ADDR-METHOD">/AUTOSAR_MemMap/SwAddrMethods/CONST</SW-ADDRMETHOD-REF>
                    <SYMBOL>CONST_16</SYMBOL>
                  </MEMORY-SECTION>
                  <MEMORY-SECTION>
                    <SHORT-NAME>ETH_43_PFE_CONST_32</SHORT-NAME>
                    <ALIGNMENT>32</ALIGNMENT>
                    <SW-ADDRMETHOD-REF DEST="SW-ADDR-METHOD">/AUTOSAR_MemMap/SwAddrMethods/CONST</SW-ADDRMETHOD-REF>
                    <SYMBOL>CONST_32</SYMBOL>
                  </MEMORY-SECTION>
                  <MEMORY-SECTION>
                    <SHORT-NAME>ETH_43_PFE_CONST_UNSPECIFIED</SHORT-NAME>
                    <ALIGNMENT>UNSPECIFIED</ALIGNMENT>
                    <SW-ADDRMETHOD-REF DEST="SW-ADDR-METHOD">/AUTOSAR_MemMap/SwAddrMethods/CONST</SW-ADDRMETHOD-REF>
                    <SYMBOL>CONST_UNSPECIFIED</SYMBOL>
                  </MEMORY-SECTION>
                  <MEMORY-SECTION>
                    <SHORT-NAME>ETH_43_PFE_CODE</SHORT-NAME>
                    <ALIGNMENT>UNSPECIFIED</ALIGNMENT>
                    <SW-ADDRMETHOD-REF DEST="SW-ADDR-METHOD">/AUTOSAR_MemMap/SwAddrMethods/CODE</SW-ADDRMETHOD-REF>
                    <SYMBOL>CODE</SYMBOL>
                  </MEMORY-SECTION>
                  <MEMORY-SECTION>
                    <SHORT-NAME>ETH_43_PFE_RAMCODE</SHORT-NAME>
                    <ALIGNMENT>UNSPECIFIED</ALIGNMENT>
                    <SW-ADDRMETHOD-REF DEST="SW-ADDR-METHOD">/AUTOSAR_MemMap/SwAddrMethods/RAMCODE</SW-ADDRMETHOD-REF>
                    <SYMBOL>RAMCODE</SYMBOL>
                  </MEMORY-SECTION>     
                  <MEMORY-SECTION>
                    <SHORT-NAME>ETH_43_PFE_CODE_AC</SHORT-NAME>
                    <ALIGNMENT>UNSPECIFIED</ALIGNMENT>
                    <SW-ADDRMETHOD-REF DEST="SW-ADDR-METHOD">/AUTOSAR_MemMap/SwAddrMethods/CODE</SW-ADDRMETHOD-REF>
                    <SYMBOL>CODE_AC</SYMBOL>
                  </MEMORY-SECTION>           
                  <MEMORY-SECTION>
                    <SHORT-NAME>ETH_43_PFE_VAR_CLEARED_BOOLEAN</SHORT-NAME>
                    <ALIGNMENT>BOOLEAN</ALIGNMENT>
                    <SW-ADDRMETHOD-REF DEST="SW-ADDR-METHOD">/AUTOSAR_MemMap/SwAddrMethods/VAR_CLEARED</SW-ADDRMETHOD-REF>
                    <SYMBOL>VAR_CLEARED_BOOLEAN</SYMBOL>
                  </MEMORY-SECTION>         
                  <MEMORY-SECTION>
                    <SHORT-NAME>ETH_43_PFE_VAR_CLEARED_8</SHORT-NAME>
                    <ALIGNMENT>8</ALIGNMENT>
                    <SW-ADDRMETHOD-REF DEST="SW-ADDR-METHOD">/AUTOSAR_MemMap/SwAddrMethods/VAR_CLEARED</SW-ADDRMETHOD-REF>
                    <SYMBOL>VAR_CLEARED_8</SYMBOL>
                  </MEMORY-SECTION>
                  <MEMORY-SECTION>
                    <SHORT-NAME>ETH_43_PFE_VAR_CLEARED_16</SHORT-NAME>
                    <ALIGNMENT>16</ALIGNMENT>
                    <SW-ADDRMETHOD-REF DEST="SW-ADDR-METHOD">/AUTOSAR_MemMap/SwAddrMethods/VAR_CLEARED</SW-ADDRMETHOD-REF>
                    <SYMBOL>VAR_CLEARED_16</SYMBOL>
                  </MEMORY-SECTION>
                  <MEMORY-SECTION>
                    <SHORT-NAME>ETH_43_PFE_VAR_CLEARED_32</SHORT-NAME>
                    <ALIGNMENT>32</ALIGNMENT>
                    <SW-ADDRMETHOD-REF DEST="SW-ADDR-METHOD">/AUTOSAR_MemMap/SwAddrMethods/VAR_CLEARED</SW-ADDRMETHOD-REF>
                    <SYMBOL>VAR_CLEARED_32</SYMBOL>
                  </MEMORY-SECTION>
                  <MEMORY-SECTION>
                    <SHORT-NAME>ETH_43_PFE_VAR_CLEARED_UNSPECIFIED</SHORT-NAME>
                    <ALIGNMENT>UNSPECIFIED</ALIGNMENT>
                    <SW-ADDRMETHOD-REF DEST="SW-ADDR-METHOD">/AUTOSAR_MemMap/SwAddrMethods/VAR_CLEARED</SW-ADDRMETHOD-REF>
                    <SYMBOL>VAR_CLEARED_UNSPECIFIED</SYMBOL>
                  </MEMORY-SECTION>
                  <MEMORY-SECTION>
                    <SHORT-NAME>ETH_43_PFE_VAR_INIT_BOOLEAN</SHORT-NAME>
                    <ALIGNMENT>BOOLEAN</ALIGNMENT>
                    <SW-ADDRMETHOD-REF DEST="SW-ADDR-METHOD">/AUTOSAR_MemMap/SwAddrMethods/VAR_INIT</SW-ADDRMETHOD-REF>
                    <SYMBOL>VAR_INIT_BOOLEAN</SYMBOL>
                  </MEMORY-SECTION>
                  <MEMORY-SECTION>
                    <SHORT-NAME>ETH_43_PFE_VAR_INIT_8</SHORT-NAME>
                    <ALIGNMENT>8</ALIGNMENT>
                    <SW-ADDRMETHOD-REF DEST="SW-ADDR-METHOD">/AUTOSAR_MemMap/SwAddrMethods/VAR_INIT</SW-ADDRMETHOD-REF>
                    <SYMBOL>VAR_INIT_8</SYMBOL>
                  </MEMORY-SECTION>
                  <MEMORY-SECTION>
                    <SHORT-NAME>ETH_43_PFE_VAR_INIT_16</SHORT-NAME>
                    <ALIGNMENT>16</ALIGNMENT>
                    <SW-ADDRMETHOD-REF DEST="SW-ADDR-METHOD">/AUTOSAR_MemMap/SwAddrMethods/VAR_INIT</SW-ADDRMETHOD-REF>
                    <SYMBOL>VAR_INIT_16</SYMBOL>
                  </MEMORY-SECTION>
                  <MEMORY-SECTION>
                    <SHORT-NAME>ETH_43_PFE_VAR_INIT_32</SHORT-NAME>
                    <ALIGNMENT>32</ALIGNMENT>
                    <SW-ADDRMETHOD-REF DEST="SW-ADDR-METHOD">/AUTOSAR_MemMap/SwAddrMethods/VAR_INIT</SW-ADDRMETHOD-REF>
                    <SYMBOL>VAR_INIT_32</SYMBOL>
                  </MEMORY-SECTION>
                  <MEMORY-SECTION>
                    <SHORT-NAME>ETH_43_PFE_VAR_INIT_UNSPECIFIED</SHORT-NAME>
                    <ALIGNMENT>UNSPECIFIED</ALIGNMENT>
                    <SW-ADDRMETHOD-REF DEST="SW-ADDR-METHOD">/AUTOSAR_MemMap/SwAddrMethods/VAR_INIT</SW-ADDRMETHOD-REF>
                    <SYMBOL>VAR_INIT_UNSPECIFIED</SYMBOL>
                  </MEMORY-SECTION>
                  <MEMORY-SECTION>
                    <SHORT-NAME>ETH_43_PFE_VAR_CLEARED_BOOLEAN_NO_CACHEABLE</SHORT-NAME>
                    <ALIGNMENT>BOOLEAN</ALIGNMENT>
                    <SW-ADDRMETHOD-REF DEST="SW-ADDR-METHOD">/AUTOSAR_MemMap/SwAddrMethods/VAR_CLEARED_NO_CACHEABLE</SW-ADDRMETHOD-REF>
                    <SYMBOL>VAR_CLEARED_BOOLEAN_NO_CACHEABLE</SYMBOL>
                  </MEMORY-SECTION>
                  <MEMORY-SECTION>
                    <SHORT-NAME>ETH_43_PFE_VAR_CLEARED_8_NO_CACHEABLE</SHORT-NAME>
                    <ALIGNMENT>8</ALIGNMENT>
                    <SW-ADDRMETHOD-REF DEST="SW-ADDR-METHOD">/AUTOSAR_MemMap/SwAddrMethods/VAR_CLEARED_NO_CACHEABLE</SW-ADDRMETHOD-REF>
                    <SYMBOL>VAR_CLEARED_8_NO_CACHEABLE</SYMBOL>
                  </MEMORY-SECTION>
                  <MEMORY-SECTION>
                    <SHORT-NAME>ETH_43_PFE_VAR_CLEARED_16_NO_CACHEABLE</SHORT-NAME>
                    <ALIGNMENT>16</ALIGNMENT>
                    <SW-ADDRMETHOD-REF DEST="SW-ADDR-METHOD">/AUTOSAR_MemMap/SwAddrMethods/VAR_CLEARED_NO_CACHEABLE</SW-ADDRMETHOD-REF>
                    <SYMBOL>VAR_CLEARED_16_NO_CACHEABLE</SYMBOL>
                  </MEMORY-SECTION>
                  <MEMORY-SECTION>
                    <SHORT-NAME>ETH_43_PFE_VAR_CLEARED_32_NO_CACHEABLE</SHORT-NAME>
                    <ALIGNMENT>32</ALIGNMENT>
                    <SW-ADDRMETHOD-REF DEST="SW-ADDR-METHOD">/AUTOSAR_MemMap/SwAddrMethods/VAR_CLEARED_NO_CACHEABLE</SW-ADDRMETHOD-REF>
                    <SYMBOL>VAR_CLEARED_32_NO_CACHEABLE</SYMBOL>
                  </MEMORY-SECTION>
                  <MEMORY-SECTION>
                    <SHORT-NAME>ETH_43_PFE_VAR_CLEARED_UNSPECIFIED_NO_CACHEABLE</SHORT-NAME>
                    <ALIGNMENT>UNSPECIFIED</ALIGNMENT>
                    <SW-ADDRMETHOD-REF DEST="SW-ADDR-METHOD">/AUTOSAR_MemMap/SwAddrMethods/VAR_CLEARED_NO_CACHEABLE</SW-ADDRMETHOD-REF>
                    <SYMBOL>VAR_CLEARED_UNSPECIFIED_NO_CACHEABLE</SYMBOL>
                  </MEMORY-SECTION>
                  <MEMORY-SECTION>
                    <SHORT-NAME>ETH_43_PFE_VAR_INIT_BOOLEAN_NO_CACHEABLE</SHORT-NAME>
                    <ALIGNMENT>BOOLEAN</ALIGNMENT>
                    <SW-ADDRMETHOD-REF DEST="SW-ADDR-METHOD">/AUTOSAR_MemMap/SwAddrMethods/VAR_INIT_NO_CACHEABLE</SW-ADDRMETHOD-REF>
                    <SYMBOL>VAR_INIT_BOOLEAN_NO_CACHEABLE</SYMBOL>
                  </MEMORY-SECTION>
                  <MEMORY-SECTION>
                    <SHORT-NAME>ETH_43_PFE_VAR_INIT_8_NO_CACHEABLE</SHORT-NAME>
                    <ALIGNMENT>8</ALIGNMENT>
                    <SW-ADDRMETHOD-REF DEST="SW-ADDR-METHOD">/AUTOSAR_MemMap/SwAddrMethods/VAR_INIT_NO_CACHEABLE</SW-ADDRMETHOD-REF>
                    <SYMBOL>VAR_INIT_8_NO_CACHEABLE</SYMBOL>
                  </MEMORY-SECTION>
                  <MEMORY-SECTION>
                    <SHORT-NAME>ETH_43_PFE_VAR_INIT_16_NO_CACHEABLE</SHORT-NAME>
                    <ALIGNMENT>16</ALIGNMENT>
                    <SW-ADDRMETHOD-REF DEST="SW-ADDR-METHOD">/AUTOSAR_MemMap/SwAddrMethods/VAR_INIT_NO_CACHEABLE</SW-ADDRMETHOD-REF>
                    <SYMBOL>VAR_INIT_16_NO_CACHEABLE</SYMBOL>
                  </MEMORY-SECTION>                
                  <MEMORY-SECTION>
                    <SHORT-NAME>ETH_43_PFE_VAR_INIT_32_NO_CACHEABLE</SHORT-NAME>
                    <ALIGNMENT>32</ALIGNMENT>
                    <SW-ADDRMETHOD-REF DEST="SW-ADDR-METHOD">/AUTOSAR_MemMap/SwAddrMethods/VAR_INIT_NO_CACHEABLE</SW-ADDRMETHOD-REF>
                    <SYMBOL>VAR_INIT_32_NO_CACHEABLE</SYMBOL>
                  </MEMORY-SECTION>
                  <MEMORY-SECTION>
                    <SHORT-NAME>ETH_43_PFE_VAR_INIT_UNSPECIFIED_NO_CACHEABLE</SHORT-NAME>
                    <ALIGNMENT>UNSPECIFIED</ALIGNMENT>
                    <SW-ADDRMETHOD-REF DEST="SW-ADDR-METHOD">/AUTOSAR_MemMap/SwAddrMethods/VAR_INIT_NO_CACHEABLE</SW-ADDRMETHOD-REF>
                    <SYMBOL>VAR_INIT_UNSPECIFIED_NO_CACHEABLE</SYMBOL>
                  </MEMORY-SECTION>
                  <MEMORY-SECTION>
                    <SHORT-NAME>ETH_43_PFE_VAR_CLEARED_UNSPECIFIED_AE_NO_CACHEABLE</SHORT-NAME>
                    <ALIGNMENT>UNSPECIFIED</ALIGNMENT>
                    <SW-ADDRMETHOD-REF DEST="SW-ADDR-METHOD">/AUTOSAR_MemMap/SwAddrMethods/VAR_CLEARED_NO_CACHEABLE</SW-ADDRMETHOD-REF>
                    <SYMBOL>VAR_CLEARED_UNSPECIFIED_AE_NO_CACHEABLE</SYMBOL>
                  </MEMORY-SECTION>
                  <MEMORY-SECTION>
                    <SHORT-NAME>ETH_43_PFE_VAR_INIT_UNSPECIFIED_AE_NO_CACHEABLE</SHORT-NAME>
                    <ALIGNMENT>UNSPECIFIED</ALIGNMENT>
                    <SW-ADDRMETHOD-REF DEST="SW-ADDR-METHOD">/AUTOSAR_MemMap/SwAddrMethods/VAR_INIT_NO_CACHEABLE</SW-ADDRMETHOD-REF>
                    <SYMBOL>VAR_INIT_UNSPECIFIED_AE_NO_CACHEABLE</SYMBOL>
                  </MEMORY-SECTION>
                  <MEMORY-SECTION>
                    <SHORT-NAME>ETH_43_PFE_VAR_SHARED_INIT_UNSPECIFIED_NO_CACHEABLE</SHORT-NAME>
                    <ALIGNMENT>UNSPECIFIED</ALIGNMENT>
                    <SW-ADDRMETHOD-REF DEST="SW-ADDR-METHOD">/AUTOSAR_MemMap/SwAddrMethods/VAR_INIT_NO_CACHEABLE</SW-ADDRMETHOD-REF>
                    <SYMBOL>VAR_SHARED_INIT_UNSPECIFIED_NO_CACHEABLE</SYMBOL>
                  </MEMORY-SECTION>
                  <MEMORY-SECTION>
                    <SHORT-NAME>ETH_43_PFE_VAR_SHARED_CLEARED_UNSPECIFIED_NO_CACHEABLE</SHORT-NAME>
                    <ALIGNMENT>UNSPECIFIED</ALIGNMENT>
                    <SW-ADDRMETHOD-REF DEST="SW-ADDR-METHOD">/AUTOSAR_MemMap/SwAddrMethods/VAR_CLEARED_NO_CACHEABLE</SW-ADDRMETHOD-REF>
                    <SYMBOL>VAR_SHARED_CLEARED_UNSPECIFIED_NO_CACHEABLE</SYMBOL>
                  </MEMORY-SECTION>
                  <MEMORY-SECTION>
                    <SHORT-NAME>ETH_43_PFE_VAR_CLEARED_UNSPECIFIED_BMU_MEM</SHORT-NAME>
                    <!--Note that 2MiB alignment is here just to be on the safe side, for maximum value of VarEthBmu2BufCnt option.
                        It can be changed, it shall be >= (2048 * VarEthBmu2BufCnt), where VarEthBmu2BufCnt is value of the
                        configuration option.
                    -->
                    <ALIGNMENT>2097152</ALIGNMENT>
                    <SW-ADDRMETHOD-REF DEST="SW-ADDR-METHOD">/AUTOSAR_MemMap/SwAddrMethods/VAR_CLEARED</SW-ADDRMETHOD-REF>
                    <SYMBOL>VAR_CLEARED_UNSPECIFIED_BMU_MEM</SYMBOL>
                  </MEMORY-SECTION>
                  <MEMORY-SECTION>
                    <SHORT-NAME>ETH_43_PFE_VAR_CLEARED_UNSPECIFIED_BUF_MEM</SHORT-NAME>
                    <ALIGNMENT>4</ALIGNMENT>
                    <SW-ADDRMETHOD-REF DEST="SW-ADDR-METHOD">/AUTOSAR_MemMap/SwAddrMethods/VAR_CLEARED</SW-ADDRMETHOD-REF>
                    <SYMBOL>VAR_CLEARED_UNSPECIFIED_BUF_MEM</SYMBOL>
                  </MEMORY-SECTION>
                  <MEMORY-SECTION>
                    <SHORT-NAME>ETH_43_PFE_VAR_CLEARED_UNSPECIFIED_BD_MEM</SHORT-NAME>
                    <ALIGNMENT>4</ALIGNMENT>
                    <SW-ADDRMETHOD-REF DEST="SW-ADDR-METHOD">/AUTOSAR_MemMap/SwAddrMethods/VAR_CLEARED</SW-ADDRMETHOD-REF>
                    <SYMBOL>VAR_CLEARED_UNSPECIFIED_BD_MEM</SYMBOL>
                  </MEMORY-SECTION>
                </MEMORY-SECTIONS>
              </RESOURCE-CONSUMPTION>
              <SW-VERSION>1.4.0</SW-VERSION>
              <VENDOR-ID>43</VENDOR-ID>
              <AR-RELEASE-VERSION>4.4.0</AR-RELEASE-VERSION>
              <BEHAVIOR-REF DEST="BSW-INTERNAL-BEHAVIOR">/AUTOSAR_Eth_43_PFE/BswModuleDescriptions/Eth/InternalBehavior_0</BEHAVIOR-REF>
              <PRECONFIGURED-CONFIGURATION-REFS>
              </PRECONFIGURED-CONFIGURATION-REFS>
              <RECOMMENDED-CONFIGURATION-REFS>
              </RECOMMENDED-CONFIGURATION-REFS>
              <VENDOR-API-INFIX>PFE</VENDOR-API-INFIX>
              <VENDOR-SPECIFIC-MODULE-DEF-REFS>
                <VENDOR-SPECIFIC-MODULE-DEF-REF DEST="ECUC-MODULE-DEF">/Eth_43_PFE_TS_T40D11M14I0R0/Eth</VENDOR-SPECIFIC-MODULE-DEF-REF>
              </VENDOR-SPECIFIC-MODULE-DEF-REFS>
            </BSW-IMPLEMENTATION>
          </ELEMENTS>
        </AR-PACKAGE>
      </AR-PACKAGES>
    </AR-PACKAGE>
  </AR-PACKAGES>
</AUTOSAR>
